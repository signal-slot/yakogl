## CMakeLists.txt
```
# SPDX-License-Identifier: Apache-2.0
# SPDX-FileCopyrightText: 2026 Signal Slot, Inc.
# rpi5_wdog: the Raspberry Pi 5's first board fact (docs/notes/pre-study-rpi5.md,
# section 6): does the BCM2712 PM watchdog reset the board? The smallest image
# that shows it. See README.md.
#
#   west build -p always -b rpi_5 -d build/rpi5_wdog yakogl/tools/probes/rpi_5/rpi5_wdog
cmake_minimum_required(VERSION 3.20.0)

# driver/ is a Zephyr module (the board layer, with the watchdog).
get_filename_component(PVR_REPO "${CMAKE_CURRENT_SOURCE_DIR}/../../../../driver" ABSOLUTE)
list(APPEND ZEPHYR_EXTRA_MODULES "${PVR_REPO}")

find_package(Zephyr REQUIRED HINTS $ENV{ZEPHYR_BASE})
project(rpi5_wdog)

# The build prints its own commit first (a result row names its build).
execute_process(COMMAND git -C "${PVR_REPO}" describe --always --dirty
                OUTPUT_VARIABLE RPI5_WDOG_BUILD OUTPUT_STRIP_TRAILING_WHITESPACE
                ERROR_QUIET RESULT_VARIABLE describe_rc)
if(NOT describe_rc EQUAL 0 OR RPI5_WDOG_BUILD STREQUAL "")
  set(RPI5_WDOG_BUILD "unknown")
endif()
target_compile_definitions(app PRIVATE RPI5_WDOG_BUILD="${RPI5_WDOG_BUILD}")
message(STATUS "rpi5_wdog build: ${RPI5_WDOG_BUILD}")

target_sources(app PRIVATE src/main.c)

# Zero warnings in our C files (-DYAKOGL_WERROR=ON, the "zephyr" rows).
if(YAKOGL_WERROR)
  target_compile_options(app PRIVATE -Werror)
endif()
```

## prj.conf
```kconfig
# SPDX-License-Identifier: Apache-2.0
# SPDX-FileCopyrightText: 2026 Signal Slot, Inc.
# The board defconfig has the console (uart10). The watchdog is the board
# layer's (driver/zephyr/lib/board/rpi4/rpi_wdog.c), armed before anything else.
CONFIG_PRINTK=y
CONFIG_YAKOGL_RPI5_WDOG=y
CONFIG_YAKOGL_RPI5_WDOG_HOLD_S=30
```

## boards/rpi_5.overlay
```dts
/* SPDX-License-Identifier: Apache-2.0 */
/* SPDX-FileCopyrightText: 2026 Signal Slot, Inc. */
/*
 * Zephyr's rpi_5 takes zephyr,sram from the SoC's sram0
 * (dts/arm64/broadcom/bcm2712.dtsi: 512 KiB at 0x200000, two address cells).
 * The Pi 5 GPU images carry their carve-out as statics, so sram0 is sized the
 * way the Pi 4 images do (driver/samples/zephyr/gl_test/boards/rpi_4b.overlay).
 * The watchdog probe needs no carve-out; it is linked into the same 32 MiB from
 * 0x200000 as tools/probes/rpi_5/rpi5_hello, so every Pi 5 image has one RAM.
 * Nothing in this overlay was run.
 */
&sram0 {
	reg = <0x0 0x200000 0x2000000>;
};
```

## src/main.c
```c
/* SPDX-License-Identifier: Apache-2.0 */
/* SPDX-FileCopyrightText: 2026 Signal Slot, Inc. */
/*
 * rpi5_wdog: does the BCM2712 PM watchdog reset the Raspberry Pi 5? The
 * watchdog is armed by the board layer in the first PRE_KERNEL_1 hook and fed
 * from a timer for CONFIG_YAKOGL_RPI5_WDOG_HOLD_S seconds; this image prints
 * the build, a line per feed interval, and when the feeding has stopped. The
 * reset (tryboot then brings Linux back) follows within one watchdog period;
 * the console going quiet and the boot loader's log after it are the proof.
 * If the image is still alive well past that, it says so and spins: nothing
 * resets the board then, a person must power-cycle it.
 */
#include <zephyr/kernel.h>
#include <zephyr/sys/printk.h>

#define HOLD_S       CONFIG_YAKOGL_RPI5_WDOG_HOLD_S
#define PERIOD_S     10 /* WDOG_PERIOD_S of rpi_wdog.c: one arm */
#define FEED_EVERY_S 3  /* FEED_EVERY_MS of rpi_wdog.c */
#define GRACE_S      15 /* alive this long past the period: the watchdog failed */

int main(void)
{
	printk("rpi5_wdog: build %s\n", RPI5_WDOG_BUILD);
	printk("rpi5_wdog: %s, watchdog armed at boot, fed for %d s\n", CONFIG_BOARD, HOLD_S);

	/* The feeder (rpi_wdog.c) stops at its first tick at or after HOLD_S. */
	while (k_uptime_get() < (int64_t)(HOLD_S + FEED_EVERY_S) * 1000) {
		printk("rpi5_wdog: feeding, uptime %lld ms\n", (long long)k_uptime_get());
		k_sleep(K_SECONDS(FEED_EVERY_S));
	}

	int64_t stopped = k_uptime_get();

	printk("rpi5_wdog: feeding stopped, reset expected within %d s\n", PERIOD_S);
	while (k_uptime_get() < stopped + (int64_t)(PERIOD_S + GRACE_S) * 1000) {
		k_sleep(K_SECONDS(1));
	}
	printk("rpi5_wdog: FAIL no reset\n");
	for (;;) {
		k_sleep(K_SECONDS(10));
	}
	return 0;
}
```
