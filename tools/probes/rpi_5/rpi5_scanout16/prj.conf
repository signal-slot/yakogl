## CMakeLists.txt
```
# SPDX-License-Identifier: Apache-2.0
# SPDX-FileCopyrightText: 2026 Signal Slot, Inc.
# rpi5_scanout16: frame 1 of the Pi 5 display (adopt the firmware's RGB565
# plane, fbcon text and a pattern, read back, long hold, read back). See
# README.md.
#
#   west build -p always -b rpi_5 -d build/rpi5_scanout16 yakogl/tools/probes/rpi_5/rpi5_scanout16 \
#     -- -DYAKOGL_WERROR=ON [-DRPI5_SCANOUT16_HOLD_MS=<ms>]
cmake_minimum_required(VERSION 3.20.0)

# driver/ is a Zephyr module (the board layer: the watchdog).
get_filename_component(PVR_REPO "${CMAKE_CURRENT_SOURCE_DIR}/../../../../driver" ABSOLUTE)
list(APPEND ZEPHYR_EXTRA_MODULES "${PVR_REPO}")

find_package(Zephyr REQUIRED HINTS $ENV{ZEPHYR_BASE})
project(rpi5_scanout16)

# The build prints its own commit first (a result row names its build).
execute_process(COMMAND git -C "${PVR_REPO}" describe --always --dirty
                OUTPUT_VARIABLE RPI5_SCANOUT16_BUILD OUTPUT_STRIP_TRAILING_WHITESPACE
                ERROR_QUIET RESULT_VARIABLE describe_rc)
if(NOT describe_rc EQUAL 0 OR RPI5_SCANOUT16_BUILD STREQUAL "")
  set(RPI5_SCANOUT16_BUILD "unknown")
endif()
target_compile_definitions(app PRIVATE RPI5_SCANOUT16_BUILD="${RPI5_SCANOUT16_BUILD}")
message(STATUS "rpi5_scanout16 build: ${RPI5_SCANOUT16_BUILD}")

# The hold (Q2) in ms. The image's end line must come before tools/board.sh's
# pi5 RUN_BOUND (420 s from the reboot, firmware and Linux shutdown included),
# and before the watchdog stops being fed: main.c clamps the hold to
# CONFIG_YAKOGL_RPI5_WDOG_HOLD_S * 1000 - 10000 ms since boot (hold_check.h's
# hold_clamp_end) and says so. 240 s with prj.conf's 280 s hold ends the image
# at about 245 s since boot.
set(RPI5_SCANOUT16_HOLD_MS 240000 CACHE STRING "rpi5_scanout16: hold length in ms")
if(NOT RPI5_SCANOUT16_HOLD_MS MATCHES "^[0-9]+$" OR RPI5_SCANOUT16_HOLD_MS GREATER 360000)
  message(FATAL_ERROR "RPI5_SCANOUT16_HOLD_MS=${RPI5_SCANOUT16_HOLD_MS}: a whole number of ms, "
                      "at most 360000 (board.sh pi5's RUN_BOUND is 420 s from the reboot)")
endif()
target_compile_definitions(app PRIVATE RPI5_SCANOUT16_HOLD_MS=${RPI5_SCANOUT16_HOLD_MS}u)
message(STATUS "rpi5_scanout16 hold: ${RPI5_SCANOUT16_HOLD_MS} ms")

target_sources(app PRIVATE src/main.c)
# rpi_wdog.h lives with the rpi4 board code; the rpi5_scanout headers (adopt.h,
# fb_flush.h, hvs6_dlist.h, scanout_alive.h, ...) have no source of their own;
# plane_match.h (iommu4's pass-through) is rpi5_display's, used as it is.
target_include_directories(app PRIVATE
  ${PVR_REPO}/zephyr/lib/board/rpi5_scanout
  ${PVR_REPO}/zephyr/lib/board/rpi4
  ${CMAKE_CURRENT_SOURCE_DIR}/../../rpi5_display/src
  src)

# Zero warnings in our C files (-DYAKOGL_WERROR=ON, the "zephyr" rows).
if(YAKOGL_WERROR)
  target_compile_options(app PRIVATE -Werror)
endif()
```

## prj.conf
```kconfig
# SPDX-License-Identifier: Apache-2.0
# SPDX-FileCopyrightText: 2026 Signal Slot, Inc.
# The board defconfig has the console (uart10). The watchdog is the board
# layer's, armed before anything else; the image stops feeding it after its
# result line (rpi_wdog_alive in src/main.c) and the board returns to Linux.
CONFIG_PRINTK=y
CONFIG_YAKOGL_RPI5_WDOG=y
# Fed at most 280 s: the hold (RPI5_SCANOUT16_HOLD_MS, 240 s by default) is
# clamped to 280 - 10 s since boot, and the reset follows the result line
# within one watchdog period, well inside board.sh pi5's RUN_BOUND of 420 s.
CONFIG_YAKOGL_RPI5_WDOG_HOLD_S=280
CONFIG_CACHE_MANAGEMENT=y
CONFIG_LOG=y
CONFIG_LOG_MODE_IMMEDIATE=y
# device_map() of the HVS, the pixel valves, iommu4 and the adopted plane (a
# few MiB at an address the firmware chose): the arm64 MMU code k_panic()s
# when its translation tables run out. rpi5_display maps the same and more with
# 64; the usage report's "peak N of M" line says what the run needed.
CONFIG_MAX_XLAT_TABLES=64
CONFIG_ARM64_MMU_REPORT_XLAT_TABLES_USAGE=y
```

## boards/rpi_5.overlay
```dts
/* SPDX-License-Identifier: Apache-2.0 */
/* SPDX-FileCopyrightText: 2026 Signal Slot, Inc. */
/*
 * The same sram0 as every Pi 5 image: 32 MiB from 0x200000, below 4 GiB.
 *
 * The register blocks the dump reads are mapped in src/dump.h with
 * device_map() (as rpi5_display does); they have no node here.
 */
&sram0 {
	reg = <0x0 0x200000 0x2000000>;
};
```

## src/dump.h
```c
/* SPDX-License-Identifier: Apache-2.0 */
/* SPDX-FileCopyrightText: 2026 Signal Slot, Inc. */
/*
 * rpi5_scanout16: the read-only register dump of the build skeleton. It maps
 * the HVS and pixel valves 0 and 1 with device_map() and prints, one line per
 * step, the HVS VERSION word and its stepping (C0/D0), CTRL0, STATUS (FRCNT,
 * MODE) and DL (LACT) of channels 0..2, and PV_CONTROL.EN and
 * PV_V_CONTROL.VIDEN of each valve. A block that did not map still prints its
 * lines: a read of an unmapped block returns 0xffffffff. No register is
 * written. The mappings are kept (dump_hvs, dump_pv_va[]) for main.c's reads.
 */
#ifndef RPI5_SCANOUT16_DUMP_H
#define RPI5_SCANOUT16_DUMP_H

#include <zephyr/kernel.h>
#include <zephyr/sys/device_mmio.h>
#include <zephyr/sys/printk.h>
#include <zephyr/sys/sys_io.h>

#include <stdint.h>

#include "pv_hdmi.h"
#include "scanout_alive.h"

#define DUMP_HVS_BASE 0x107c580000ull /* rpi:arch/arm64/boot/dts/broadcom/bcm2712.dtsi:612-617 */
#define DUMP_HVS_SIZE 0x1a000u
#define DUMP_ALL_ONES 0xffffffffu
/* PV_V_CONTROL.VIDEN, bit 0: rpi:vc4_regs.h:180 (scanout_alive.h names the
 * same bit SA_PV_VCONTROL_VIDEN; the dump keeps its own). */
#define DUMP_PV_VIDEN (1u << 0)

/* The blocks dump_all() mapped: 0 when one did not map. */
static mm_reg_t dump_hvs;
static mm_reg_t dump_pv_va[2];

static inline uint32_t dump_rd(mm_reg_t base, uint32_t size, uint32_t off)
{
	return base != 0 && off < size ? sys_read32(base + off) : DUMP_ALL_ONES;
}

static inline int dump_pv(unsigned int n, uint64_t pa, uint32_t size)
{
	mm_reg_t va = 0;
	uint32_t ctl, vctl;

	device_map(&va, (uintptr_t)pa, size, K_MEM_CACHE_NONE);
	dump_pv_va[n & 1u] = va;
	ctl = dump_rd(va, size, SA_PV_CONTROL);
	vctl = dump_rd(va, size, SA_PV_V_CONTROL);
	printk("rpi5_scanout16: dump pv%u %s at 0x%llx: PV_CONTROL 0x%08x EN %u "
	       "PV_V_CONTROL 0x%08x VIDEN %u\n",
	       n, va != 0 ? "mapped" : "NOT mapped", (unsigned long long)pa, ctl,
	       (ctl & SA_PV_CONTROL_EN) != 0, vctl, (vctl & DUMP_PV_VIDEN) != 0);
	return va == 0 ? 1 : 0;
}

/* Returns the number of blocks (HVS, pixel valve 0, pixel valve 1) that did
 * not map: 0 when all did. */
static inline int dump_all(void)
{
	mm_reg_t hvs = 0;
	uint32_t version;
	int d0, rc;
	unsigned int ch;

	device_map(&hvs, (uintptr_t)DUMP_HVS_BASE, DUMP_HVS_SIZE, K_MEM_CACHE_NONE);
	dump_hvs = hvs;
	rc = hvs == 0 ? 1 : 0;
	printk("rpi5_scanout16: dump hvs %s at 0x%llx, %u bytes\n",
	       hvs != 0 ? "mapped" : "NOT mapped", (unsigned long long)DUMP_HVS_BASE,
	       DUMP_HVS_SIZE);
	version = dump_rd(hvs, DUMP_HVS_SIZE, SA_HVS_VERSION);
	d0 = sa_is_d0(version);
	printk("rpi5_scanout16: dump HVS VERSION 0x%08x stepping %s\n", version,
	       version == DUMP_ALL_ONES ? "unreadable" :
	       (version & SA_HVS_VERSION_MASK) == SA_HVS_VERSION_D0 ? "D0" :
	       (version & SA_HVS_VERSION_MASK) == SA_HVS_VERSION_C0 ? "C0" : "unknown");
	for (ch = 0; ch < SA_NUM_CHANNELS; ch++) {
		uint32_t c = dump_rd(hvs, DUMP_HVS_SIZE, sa_reg_ctrl0(d0, ch));
		uint32_t s = dump_rd(hvs, DUMP_HVS_SIZE, sa_reg_status(d0, ch));
		uint32_t dl = dump_rd(hvs, DUMP_HVS_SIZE, sa_reg_dl(d0, ch));

		printk("rpi5_scanout16: dump ch%u CTRL0 0x%08x ENB %u STATUS 0x%08x "
		       "FRCNT %u MODE %u DL 0x%08x LACT %u\n",
		       ch, c, (c & SA_CTRL0_ENB) != 0, s,
		       (s >> SA_STATUS_FRCNT_SHIFT) & SA_STATUS_FRCNT_MASK,
		       (s >> SA_STATUS_MODE_SHIFT) & SA_STATUS_MODE_MASK, dl,
		       dl & SA_DL_LACT_MASK);
	}
	rc += dump_pv(0, PV0_BASE, PV0_SIZE);
	rc += dump_pv(1, PV1_BASE, PV1_SIZE);
	return rc;
}

#endif /* RPI5_SCANOUT16_DUMP_H */
```

## src/frame16.h
```c
/* SPDX-License-Identifier: Apache-2.0 */
/* SPDX-FileCopyrightText: 2026 Signal Slot, Inc. */
/*
 * rpi5_scanout16: the frame's hardware-independent logic (docs/notes/
 * rpi5-display.md section 3): fbcon 16 bpp text rows, the RGB565 pattern
 * band, the byte-equal readback and the formatters of the console lines
 * [4]..[11] that verdicts.sh parses. C11, static inline, no Zephyr, no I/O;
 * host-tested by test/frame16_test.c and frame16_selftest.sh (which pipes
 * the formatted lines through verdicts.sh).
 *
 * Layout: the text band is rows 0 .. n*16-1 (scale 1, 16 pixel rows per text
 * row); the pattern band is pattern.h's split_layout() bottom band. The text
 * must end at or above the pattern band's first row (frame16_text_max_rows).
 *
 * Readback choice: BYTE-EQUAL against an expected image of the same
 * geometry (the caller renders the same frame into a second buffer with
 * frame16_render). Only the w*2 visible bytes of each row are compared; the
 * pitch padding is never written by us and is ignored. The result counts
 * differing bytes and names the first one (row-major) as x (pixel), y and
 * the byte offset. No hash and no pattern_check grid: a hash cannot name a
 * mismatch, and a grid can miss a corrupted pixel.
 */
#ifndef RPI5_SCANOUT16_FRAME16_H
#define RPI5_SCANOUT16_FRAME16_H

#include <stdbool.h>
#include <stddef.h>
#include <stdint.h>
#include <stdio.h> /* snprintf: the formatters only */

#include "../../../../../driver/zephyr/lib/board/rpi5_scanout/fbcon565.h"
#include "../../../../../driver/zephyr/lib/board/rpi5_scanout/pattern.h"
#include "hold_check.h"

#define FRAME16_TEXT_SCALE 1u
#define FRAME16_TEXT_ROW_PX (GC_FONT_H * FRAME16_TEXT_SCALE)
#define FRAME16_FG 0xffffu /* white */
#define FRAME16_BG 0x0000u

#define FRAME16_E_PLANE (-100) /* not an adopted RGB565 plane */
#define FRAME16_E_FIT (-101)   /* the text rows do not fit above the pattern */

/* An adopted plane: base, pitch in bytes, size in pixels, format. */
struct frame16_plane {
	void *base;
	uint32_t pitch;
	uint32_t w, h;
	enum pattern_fmt fmt;
};

static inline bool frame16_plane_ok(const struct frame16_plane *p)
{
	return p && p->base && p->fmt == PATTERN_RGB565 && p->w > 0 && p->h > 0 &&
	       p->pitch >= p->w * 2u && !(p->pitch & 1u);
}

static inline struct yd5_fc565 frame16_fc(const struct frame16_plane *p)
{
	struct yd5_fc565 f = { (uint16_t *)p->base, p->w, p->pitch, p->h };

	return f;
}

/* Number of text rows that fit above the pattern band (0 for a bad plane). */
static inline uint32_t frame16_text_max_rows(const struct frame16_plane *p)
{
	if (!frame16_plane_ok(p))
		return 0;
	return split_layout(p->w, p->h).pattern.y / FRAME16_TEXT_ROW_PX;
}

/* The text of row i: a fixed, row-unique string. */
static inline void frame16_text_line(uint32_t i, char *buf, size_t n)
{
	snprintf(buf, n, "rpi5_scanout16 text row %02u: the quick brown fox 0123456789",
		 (unsigned int)i);
}

/* Hash of the visible bytes of the pixel rows y0 .. y0+h-1. */
static inline uint32_t frame16_band_hash(const struct frame16_plane *p, uint32_t y0, uint32_t h)
{
	uint32_t acc = HOLD_FNV_BASIS;

	for (uint32_t y = y0; y < y0 + h && y < p->h; y++)
		acc = hold_fnv1a_n(acc, (const volatile uint8_t *)p->base + (size_t)y * p->pitch,
				   (size_t)p->w * 2u);
	return acc;
}

/*
 * (a) Draw n text rows; *changed receives the number of rows whose plane
 * bytes differ after the draw (line [4]). Returns 0, a YD5_FC565_E_* code,
 * FRAME16_E_PLANE or FRAME16_E_FIT. *changed is 0 on any error.
 */
static inline int frame16_draw_text(const struct frame16_plane *p, uint32_t n, uint32_t *changed)
{
	uint32_t hits = 0;
	struct yd5_fc565 f;

	if (changed)
		*changed = 0;
	if (!frame16_plane_ok(p))
		return FRAME16_E_PLANE;
	if (n > frame16_text_max_rows(p))
		return FRAME16_E_FIT;
	f = frame16_fc(p);
	for (uint32_t i = 0; i < n; i++) {
		char line[96];
		uint32_t y0 = i * FRAME16_TEXT_ROW_PX;
		uint32_t before = frame16_band_hash(p, y0, FRAME16_TEXT_ROW_PX);
		int e;

		frame16_text_line(i, line, sizeof(line));
		e = yd5_fc565_puts(&f, y0, FRAME16_TEXT_ROW_PX, 0, 0, line, FRAME16_TEXT_SCALE,
				   FRAME16_FG, FRAME16_BG, NULL);
		if (e)
			return e;
		hits += frame16_band_hash(p, y0, FRAME16_TEXT_ROW_PX) != before;
	}
	if (changed)
		*changed = hits;
	return 0;
}

/*
 * (b) Draw the pattern in the bottom band of split_layout(), below every
 * text row. Returns true when drawn; else false with *why a static reason.
 * A plane that is not RGB565, or smaller than 64x64, is not drawn.
 */
static inline bool frame16_draw_pattern(const struct frame16_plane *p, const char **why)
{
	const char *r = NULL;

	if (!p || !p->base)
		r = "no plane";
	else if (p->fmt != PATTERN_RGB565)
		r = "plane is not RGB565";
	else if (p->w < 64 || p->h < 64)
		r = "plane too small";
	else if (p->pitch < p->w * 2u || (p->pitch & 1u))
		r = "pitch too small";
	if (!r) {
		struct pattern_layout l = split_layout(p->w, p->h);

		if (pattern_fill_rect(p->base, p->w, p->h, p->pitch, 16, PATTERN_RGB565,
				      l.pattern) != 0)
			r = "pattern_fill_rect refused";
	}
	if (why)
		*why = r;
	return r == NULL;
}

/* The whole frame: text rows, then the pattern (attempted even when the text
 * failed). Used for the expected image too. Returns draw_text's code. */
static inline int frame16_render(const struct frame16_plane *p, uint32_t text_rows,
				 uint32_t *changed, bool *drawn, const char **why)
{
	int e = frame16_draw_text(p, text_rows, changed);
	bool d = frame16_draw_pattern(p, why);

	if (drawn)
		*drawn = d;
	return e;
}

/* (c) Byte-equal readback of the whole plane (visible bytes) against expected. */
struct frame16_rb {
	bool pass;
	uint32_t bytes;            /* bytes compared */
	uint32_t mismatch;         /* differing bytes */
	uint32_t first_x, first_y; /* of the first: pixel x, row y */
	uint32_t first_off;        /* its byte offset in the row */
	uint8_t want, got;         /* its two values */
	bool bad_arg;              /* geometry differs, or a plane is not RGB565 */
};

static inline struct frame16_rb frame16_readback(const struct frame16_plane *p,
						 const struct frame16_plane *exp)
{
	struct frame16_rb r = { false, 0, 0, 0, 0, 0, 0, 0, false };

	if (!frame16_plane_ok(p) || !frame16_plane_ok(exp) || p->w != exp->w || p->h != exp->h) {
		r.bad_arg = true;
		return r;
	}
	for (uint32_t y = 0; y < p->h; y++) {
		const volatile uint8_t *a = (const volatile uint8_t *)p->base + (size_t)y * p->pitch;
		const volatile uint8_t *b =
			(const volatile uint8_t *)exp->base + (size_t)y * exp->pitch;

		for (uint32_t i = 0; i < p->w * 2u; i++) {
			uint8_t g = a[i], w = b[i];

			if (g == w)
				continue;
			if (r.mismatch == 0) {
				r.first_x = i / 2u;
				r.first_y = y;
				r.first_off = i;
				r.want = w;
				r.got = g;
			}
			r.mismatch++;
		}
	}
	r.bytes = p->w * 2u * p->h;
	r.pass = r.mismatch == 0;
	return r;
}

/* ---- formatters: each writes the payload of one console line (no newline)
 * and returns snprintf's value. ---- */

/* [4] */
static inline int frame16_fmt_text_rows(char *b, size_t n, uint32_t changed)
{
	return snprintf(b, n, "rpi5_scanout16: text rows %u changed", (unsigned int)changed);
}

/* [5] */
static inline int frame16_fmt_pattern(char *b, size_t n, bool drawn, const char *why)
{
	if (drawn)
		return snprintf(b, n,
				"rpi5_scanout16: pattern drawn (8 colour bars below the text)");
	return snprintf(b, n, "rpi5_scanout16: pattern not drawn (%s)", why ? why : "unknown");
}

/* [6] (which = 1) and [7] (which = 2) */
static inline int frame16_fmt_readback(char *b, size_t n, int which, const struct frame16_rb *r)
{
	if (r->bad_arg)
		return snprintf(b, n,
				"u3 readback %d: FAIL (not comparable: plane or expected image invalid)",
				which);
	if (r->pass)
		return snprintf(b, n, "u3 readback %d: PASS (%u bytes read back byte-equal)", which,
				(unsigned int)r->bytes);
	return snprintf(b, n,
			"u3 readback %d: FAIL (%u of %u bytes differ, first at x=%u y=%u byte %u: want 0x%02x got 0x%02x)",
			which, (unsigned int)r->mismatch, (unsigned int)r->bytes,
			(unsigned int)r->first_x, (unsigned int)r->first_y,
			(unsigned int)r->first_off, r->want, r->got);
}

/* [8]: FRCNT values (0..63; the caller passes hold_frcnt() of STATUS). */
static inline int frame16_fmt_frcnt(char *b, size_t n, uint32_t before, uint32_t after)
{
	return snprintf(b, n, "u3 frcnt: before %u after %u", (unsigned int)before,
			(unsigned int)after);
}

/* [9] */
static inline int frame16_fmt_pv(char *b, size_t n, uint32_t pv_control, uint32_t pv_vcontrol)
{
	return snprintf(b, n, "u3 pv: control=0x%x en=%u viden=%u", (unsigned int)pv_control,
			(unsigned int)(pv_control & HOLD_PV_CONTROL_EN),
			(unsigned int)(pv_vcontrol & HOLD_PV_VCONTROL_VIDEN));
}

/* [10]: from hold_judge's verdict. plane=redrawn when its redraw is not NO or
 * its reason is plane-changed; list=changed when the reason is list-changed
 * or pointer-changed. bytes and words are the caller's counts (printed as 0
 * when kept). */
static inline int frame16_fmt_hold(char *b, size_t n, uint32_t ms, const struct hold_verdict *v,
				   uint32_t bytes, uint32_t words)
{
	bool redrawn = v->redraw != HOLD_REDRAW_NO || v->reason == HOLD_PLANE_CHANGED;
	bool changed = v->reason == HOLD_LIST_CHANGED || v->reason == HOLD_POINTER_CHANGED;

	return snprintf(b, n, "u3 hold: %u ms plane=%s bytes=%u list=%s words=%u", (unsigned int)ms,
			redrawn ? "redrawn" : "kept", (unsigned int)(redrawn ? bytes : 0),
			changed ? "changed" : "kept", (unsigned int)(changed ? words : 0));
}

/* Q2 list-word lines. entry_off < 0 prints 'none'. */
static inline int frame16_fmt_q2_word(char *b, size_t n, uint32_t index, uint32_t head, int entry_off,
				      uint32_t was, uint32_t now)
{
	if (entry_off < 0)
		return snprintf(b, n, "rpi5_scanout16: q2 word %u off %u entry-off none was 0x%08x "
				"now 0x%08x", (unsigned int)index, (unsigned int)(index - head),
				(unsigned int)was, (unsigned int)now);
	return snprintf(b, n, "rpi5_scanout16: q2 word %u off %u entry-off %d was 0x%08x now 0x%08x",
			(unsigned int)index, (unsigned int)(index - head), entry_off,
			(unsigned int)was, (unsigned int)now);
}

static inline int frame16_fmt_q2_more(char *b, size_t n, uint32_t left)
{
	return snprintf(b, n, "rpi5_scanout16: q2 %u more changed words left out", (unsigned int)left);
}

/* The entry the offsets refer to: its length and the POS3 context offset. */
static inline int frame16_fmt_q2_entry(char *b, size_t n, uint32_t nwords, uint32_t ctx_off)
{
	return snprintf(b, n, "rpi5_scanout16: q2 entry words %u ctx-off %u", (unsigned int)nwords,
			(unsigned int)ctx_off);
}

/* u3 q2 summary: changed (word given) or none. */
static inline int frame16_fmt_q2(char *b, size_t n, bool changed, uint32_t index, int entry_off,
				 uint32_t was, uint32_t now, bool per_frame)
{
	if (!changed)
		return snprintf(b, n, "u3 q2: no list word changed");
	if (entry_off < 0)
		return snprintf(b, n, "u3 q2: word %u entry-off none was 0x%08x now 0x%08x per-frame %s",
				(unsigned int)index, (unsigned int)was, (unsigned int)now,
				per_frame ? "yes" : "no");
	return snprintf(b, n, "u3 q2: word %u entry-off %d was 0x%08x now 0x%08x per-frame %s",
			(unsigned int)index, entry_off, (unsigned int)was, (unsigned int)now,
			per_frame ? "yes" : "no");
}

/* [11]: a result line; reason is free text (PASS: what held; FAIL: why). */
static inline int frame16_fmt_terminal(char *b, size_t n, bool pass, const char *reason)
{
	return snprintf(b, n, "rpi5_scanout16: %s (%s)", pass ? "PASS" : "FAIL",
			reason ? reason : "");
}

/* The planned watchdog ending, printed after [11]; not a verdict line. */
static inline int frame16_fmt_feeding_stopped(char *b, size_t n)
{
	return snprintf(b, n, "rpi5_scanout16: feeding stopped, reset expected");
}

#endif /* RPI5_SCANOUT16_FRAME16_H */
```

## src/hold_check.h
```c
/* SPDX-License-Identifier: Apache-2.0 */
/* SPDX-FileCopyrightText: 2026 Signal Slot, Inc. */
/*
 * rpi5_scanout16: the long hold's decision logic (docs/notes/rpi5-display.md
 * section 4, Q2: does the firmware redraw into its plane or change its display
 * list while we hold without writing?). Pure functions, no I/O, no Zephyr:
 * stdint/stddef/stdbool only, host-tested by test/hold_check_test.c.
 *
 * Register layout is that of driver/zephyr/lib/board/rpi5_scanout/
 * scanout_alive.h (STATUS.FRCNT 21:16, PV_CONTROL.EN bit 0, PV_V_CONTROL.VIDEN
 * bit 0); the constants are repeated here so this header stands alone.
 * pattern.h has no hash function (only a checksum field that names FNV-1a),
 * so the FNV-1a 32-bit hash is defined here.
 */
#ifndef RPI5_SCANOUT16_HOLD_CHECK_H
#define RPI5_SCANOUT16_HOLD_CHECK_H

#include <stdbool.h>
#include <stddef.h>
#include <stdint.h>

#define HOLD_FNV_BASIS 0x811c9dc5u
#define HOLD_FNV_PRIME 0x01000193u

#define HOLD_FRCNT_SHIFT 16u /* scanout_alive.h:61 */
#define HOLD_FRCNT_MASK 0x3fu
#define HOLD_PV_CONTROL_EN (1u << 0)
#define HOLD_PV_VCONTROL_VIDEN (1u << 0)
#define HOLD_UNCLOCKED 0xffffffffu /* scanout_alive.h:19 */
#define HOLD_WDOG_MARGIN_MS 10000u

/* (a) FNV-1a 32-bit, continuing from h (start with HOLD_FNV_BASIS). */
static inline uint32_t hold_fnv1a_n(uint32_t h, const volatile uint8_t *p, size_t n)
{
	for (size_t i = 0; i < n; i++) {
		h ^= p[i];
		h *= HOLD_FNV_PRIME;
	}
	return h;
}

static inline uint32_t hold_fnv1a(const volatile void *buf, size_t n)
{
	return hold_fnv1a_n(HOLD_FNV_BASIS, (const volatile uint8_t *)buf, n);
}

/* The row index of the i-th of n rows spread evenly over h rows. */
static inline uint32_t hold_row_at(uint32_t i, uint32_t n, uint32_t h)
{
	return n ? (uint32_t)(((uint64_t)i * h) / n) : 0u;
}

/* (b) Hash of n whole rows (pitch bytes each) spread evenly over h rows. */
static inline uint32_t hold_rows_hash(const volatile void *plane, uint32_t pitch,
				      uint32_t h, uint32_t n)
{
	const volatile uint8_t *b = (const volatile uint8_t *)plane;
	uint32_t acc = HOLD_FNV_BASIS;

	if (n > h)
		n = h;
	for (uint32_t i = 0; i < n; i++)
		acc = hold_fnv1a_n(acc, b + (size_t)hold_row_at(i, n, h) * pitch, pitch);
	return acc;
}

/* (c) Mismatches of a plane against an expected-pixel callback. */
typedef uint32_t (*hold_expect_fn)(uint32_t x, uint32_t y, void *ctx);

struct hold_mismatch {
	uint32_t count;   /* pixels differing */
	uint32_t first_x; /* of the first (row-major); valid if count > 0 */
	uint32_t first_y;
	uint32_t rows;    /* distinct rows with at least one mismatch */
};

static inline uint32_t hold_load_px(const volatile uint8_t *p, uint32_t bpp)
{
	uint32_t v = 0;

	for (uint32_t i = 0; i < bpp; i++)
		v |= (uint32_t)p[i] << (8u * i);
	return v;
}

/* bpp is 2 or 4 bytes; pixels little-endian; bpp 2 compares the low 16 bits. */
static inline struct hold_mismatch hold_mismatch_scan(const volatile void *plane,
						      uint32_t pitch, uint32_t w, uint32_t h,
						      uint32_t bpp, hold_expect_fn expect,
						      void *ctx)
{
	const volatile uint8_t *b = (const volatile uint8_t *)plane;
	struct hold_mismatch m = { 0, 0, 0, 0 };

	for (uint32_t y = 0; y < h; y++) {
		bool hit = false;

		for (uint32_t x = 0; x < w; x++) {
			uint32_t got = hold_load_px(b + (size_t)y * pitch + (size_t)x * bpp, bpp);
			uint32_t want = expect(x, y, ctx);

			if (bpp < 4)
				want &= (1u << (8u * bpp)) - 1u;
			if (got == want)
				continue;
			if (m.count == 0) {
				m.first_x = x;
				m.first_y = y;
			}
			m.count++;
			hit = true;
		}
		if (hit)
			m.rows++;
	}
	return m;
}

/* (d) FRCNT of a STATUS value. */
static inline uint32_t hold_frcnt(uint32_t status)
{
	return (status >> HOLD_FRCNT_SHIFT) & HOLD_FRCNT_MASK;
}

/* FRCNT must advance (mod 64) between every two samples. Returns -1 when it
 * does, else the index of the first sample equal to its predecessor's. */
static inline int hold_frcnt_stall(const uint32_t *status, unsigned int n)
{
	for (unsigned int i = 1; i < n; i++)
		if (hold_frcnt(status[i]) == hold_frcnt(status[i - 1]))
			return (int)i;
	return -1;
}

/* (e) An all-ones read is an unclocked or unpowered block. */
static inline bool hold_unclocked(uint32_t reg)
{
	return reg == HOLD_UNCLOCKED;
}

/* (f) PV enabled and its video enable set. */
static inline bool hold_pv_enabled(uint32_t pv_control, uint32_t pv_vcontrol)
{
	return (pv_control & HOLD_PV_CONTROL_EN) && (pv_vcontrol & HOLD_PV_VCONTROL_VIDEN);
}

/* (g) hold_end_ms = min(start + want, hold_s*1000 - 10000), the watchdog
 * deadline being counted from boot. *clamped is set when shorter than wanted.
 * A deadline at or before start gives start (no hold). */
static inline uint32_t hold_clamp_end(uint32_t start_ms, uint32_t want_ms, uint32_t hold_s,
				      bool *clamped)
{
	uint64_t want_end = (uint64_t)start_ms + want_ms;
	uint64_t wd = (uint64_t)hold_s * 1000u;
	uint64_t limit = wd > HOLD_WDOG_MARGIN_MS ? wd - HOLD_WDOG_MARGIN_MS : 0u;
	uint64_t end = want_end < limit ? want_end : limit;

	if (end < start_ms)
		end = start_ms;
	if (clamped)
		*clamped = end < want_end;
	return (uint32_t)end;
}

/* ---- Q2's list half: which list word changed, where it sits, and whether it
 * follows the frame. Grounds (driver/zephyr/lib/board/rpi5_scanout/
 * hvs6_dlist.h, the entry layout "CTL0, POS0, CTL2, POS1 only when not unity,
 * POS2, POS3 context, then the pointer words", and driver/docs/
 * rpi5-v3d71-facts.md section 10): a plane entry's POS3 word is the context
 * word, the one the HVS keeps its per-plane state in. ---- */
#define HOLD_Q2_CAP 8u    /* changed words named per sample */
#define HOLD_BURST_FRAMES 16u
#define HOLD_BURST_MS 2000u /* the budget of one burst: 16 frames of 60 Hz plus slack */

/* Word index of the POS3 context word in an entry: 4 when unity, else 5. */
static inline uint32_t hold_ctx_off(bool unity)
{
	return unity ? 4u : 5u;
}

/* Offset of list word rel (counted from the list head) inside the first
 * entry (entry_n words), or -1 when it lies outside it. */
static inline int hold_entry_off(uint32_t rel, uint32_t entry_n)
{
	return rel < entry_n ? (int)rel : -1;
}

/* The words of cur that differ from ref (n words): up to cap indexes into idx;
 * returns the total number that differ (may exceed cap). */
static inline uint32_t hold_diff_words(const uint32_t *ref, const uint32_t *cur, uint32_t n,
				       uint32_t *idx, uint32_t cap)
{
	uint32_t total = 0;

	for (uint32_t i = 0; i < n; i++) {
		if (cur[i] == ref[i])
			continue;
		if (total < cap)
			idx[total] = i;
		total++;
	}
	return total;
}

/* Changes between consecutive values of one word read once per frame. */
static inline uint32_t hold_transitions(const uint32_t *v, uint32_t n)
{
	uint32_t t = 0;

	for (uint32_t i = 1; i < n; i++)
		t += v[i] != v[i - 1];
	return t;
}

/* A word follows the frame when it changed in at least half the frame steps. */
static inline bool hold_per_frame(const uint32_t *v, uint32_t n)
{
	return n >= 2 && hold_transitions(v, n) * 2u >= n - 1u;
}

/* (h) The combined verdict. */
enum hold_reason {
	HOLD_PASS = 0,
	HOLD_UNCLOCKED_FAIL,  /* a register read all ones */
	HOLD_PV_DISABLED,     /* PV EN or VIDEN clear */
	HOLD_FRCNT_STALLED,   /* FRCNT did not advance */
	HOLD_POINTER_CHANGED, /* the channel's list pointer register moved */
	HOLD_LIST_CHANGED,    /* the display list's words changed */
	HOLD_PLANE_CHANGED,   /* the plane's bytes changed */
};

enum hold_redraw {
	HOLD_REDRAW_NO = 0,
	HOLD_REDRAW_A, /* the plane changed before our write */
	HOLD_REDRAW_B, /* the plane changed during the hold */
};

struct hold_sample {
	uint32_t status;       /* DISPx_STATUS */
	uint32_t dl_ptr;       /* the list pointer register read */
	uint32_t list_hash;    /* FNV-1a over the list words */
	uint32_t plane_hash;   /* hold_rows_hash of the plane */
	uint32_t rows_touched; /* rows differing from the reference, when plane_hash does */
	uint32_t pv_control;
	uint32_t pv_vcontrol;
};

struct hold_verdict {
	bool pass;
	enum hold_reason reason;
	int index;             /* failing sample, -1 for none */
	uint32_t rows_touched; /* for HOLD_PLANE_CHANGED */
	enum hold_redraw redraw;
};

static inline const char *hold_reason_name(enum hold_reason r)
{
	switch (r) {
	case HOLD_PASS:
		return "pass";
	case HOLD_UNCLOCKED_FAIL:
		return "unclocked";
	case HOLD_PV_DISABLED:
		return "pv-disabled";
	case HOLD_FRCNT_STALLED:
		return "frcnt-stalled";
	case HOLD_POINTER_CHANGED:
		return "pointer-changed";
	case HOLD_LIST_CHANGED:
		return "list-changed";
	case HOLD_PLANE_CHANGED:
		return "plane-changed";
	}
	return "?";
}

static inline const char *hold_redraw_name(enum hold_redraw r)
{
	return r == HOLD_REDRAW_A ? "yes-A" : r == HOLD_REDRAW_B ? "yes-B" : "no";
}

/* ref is the state right after our write; s[0..n) the hold's samples. Per
 * sample the checks run in the order unclocked, PV, FRCNT (against the
 * previous sample, the reference for sample 0), pointer, list, plane; the
 * first sample and check that fails name the verdict. before_write_changed:
 * the plane already differed from what the firmware left before our write
 * (redraw phase A). The redraw verdict is independent of the reason: A when
 * set, else B when any sample's plane hash differs from ref. */
static inline struct hold_verdict hold_judge(const struct hold_sample *ref,
					     const struct hold_sample *s, unsigned int n,
					     bool before_write_changed)
{
	struct hold_verdict v = { true, HOLD_PASS, -1, 0, HOLD_REDRAW_NO };
	bool plane_moved = false;

	for (unsigned int i = 0; i < n; i++) {
		const struct hold_sample *prev = i ? &s[i - 1] : ref;
		enum hold_reason r = HOLD_PASS;

		if (s[i].plane_hash != ref->plane_hash)
			plane_moved = true;
		if (!v.pass)
			continue;
		if (hold_unclocked(s[i].status) || hold_unclocked(s[i].pv_control) ||
		    hold_unclocked(s[i].pv_vcontrol) || hold_unclocked(s[i].dl_ptr))
			r = HOLD_UNCLOCKED_FAIL;
		else if (!hold_pv_enabled(s[i].pv_control, s[i].pv_vcontrol))
			r = HOLD_PV_DISABLED;
		else if (hold_frcnt(s[i].status) == hold_frcnt(prev->status))
			r = HOLD_FRCNT_STALLED;
		else if (s[i].dl_ptr != ref->dl_ptr)
			r = HOLD_POINTER_CHANGED;
		else if (s[i].list_hash != ref->list_hash)
			r = HOLD_LIST_CHANGED;
		else if (s[i].plane_hash != ref->plane_hash)
			r = HOLD_PLANE_CHANGED;
		if (r != HOLD_PASS) {
			v.pass = false;
			v.reason = r;
			v.index = (int)i;
			v.rows_touched = s[i].rows_touched;
		}
	}
	v.redraw = before_write_changed ? HOLD_REDRAW_A
		   : plane_moved       ? HOLD_REDRAW_B
				       : HOLD_REDRAW_NO;
	return v;
}

#endif /* RPI5_SCANOUT16_HOLD_CHECK_H */
```
