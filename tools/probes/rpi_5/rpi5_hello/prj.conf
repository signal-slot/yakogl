## CMakeLists.txt
```
# SPDX-License-Identifier: Apache-2.0
# SPDX-FileCopyrightText: 2026 Signal Slot, Inc.
# rpi5_hello: item H9 of docs/notes/pre-study-rpi5.md. A no-GPU image for the
# Raspberry Pi 5: the build line, the board, the console and the memory the
# image was linked into, then a few seconds counted on the system timer, with
# the board layer's PM watchdog so tools/board.sh pi5 can run it.
# tools/check.sh builds it with -DYAKOGL_WERROR=ON.
#
#   west build -p always -b rpi_5 -d build/rpi5_hello yakogl/tools/probes/rpi_5/rpi5_hello
cmake_minimum_required(VERSION 3.20.0)

# driver/ is a Zephyr module (the board layer, with the watchdog).
get_filename_component(PVR_REPO "${CMAKE_CURRENT_SOURCE_DIR}/../../../../driver" ABSOLUTE)
list(APPEND ZEPHYR_EXTRA_MODULES "${PVR_REPO}")

find_package(Zephyr REQUIRED HINTS $ENV{ZEPHYR_BASE})
project(rpi5_hello)

# The build prints its own commit first (a result row names its build).
execute_process(COMMAND git -C "${PVR_REPO}" describe --always --dirty
                OUTPUT_VARIABLE RPI5_HELLO_BUILD OUTPUT_STRIP_TRAILING_WHITESPACE
                ERROR_QUIET RESULT_VARIABLE describe_rc)
if(NOT describe_rc EQUAL 0 OR RPI5_HELLO_BUILD STREQUAL "")
  set(RPI5_HELLO_BUILD "unknown")
endif()
target_compile_definitions(app PRIVATE RPI5_HELLO_BUILD="${RPI5_HELLO_BUILD}")
message(STATUS "rpi5_hello build: ${RPI5_HELLO_BUILD}")

target_sources(app PRIVATE src/main.c)

# Zero warnings in our C files: tools/check.sh builds this probe with
# -DYAKOGL_WERROR=ON (the "zephyr" rows); off by default.
if(YAKOGL_WERROR)
  target_compile_options(app PRIVATE -Werror)
endif()
```

## prj.conf
```kconfig
# SPDX-License-Identifier: Apache-2.0
# SPDX-FileCopyrightText: 2026 Signal Slot, Inc.
# The board defconfig has the console (uart10). The watchdog is the board
# layer's (driver/zephyr/lib/board/rpi4/rpi_wdog.c), armed before anything
# else and fed until 30 s after boot: the image ends at ~3 s, the board then
# resets itself back into Linux, the way every other tools/probes/rpi_5 probe
# is carried. Nothing else is needed.
CONFIG_PRINTK=y
CONFIG_YAKOGL_RPI5_WDOG=y
CONFIG_YAKOGL_RPI5_WDOG_HOLD_S=30
```

## boards/rpi_5.overlay
```dts
/* SPDX-License-Identifier: Apache-2.0 */
/* SPDX-FileCopyrightText: 2026 Signal Slot, Inc. */
/*
 * Zephyr's rpi_5 takes zephyr,sram from the SoC's sram0
 * (dts/arm64/broadcom/bcm2712.dtsi: 512 KiB at 0x200000, two address cells).
 * A GPU image carries its carve-out as statics, so sram0 is sized here, the
 * way the Pi 4 images do (driver/samples/zephyr/gl_test/boards/rpi_4b.overlay).
 * 32 MiB from 0x200000: the size the Pi 4's first clear and triangle ran with,
 * and pre-study-rpi5.md (U10) says to keep the carve-out low until measured.
 * That this much RAM is free on a Pi 5 is what only the board answers.
 * Nothing in this overlay was run.
 * The same file sizes Zephyr's own hello_world in the gate row
 * (-DEXTRA_DTC_OVERLAY_FILE).
 */
&sram0 {
	reg = <0x0 0x200000 0x2000000>;
};
```

## src/main.c
```c
/* SPDX-License-Identifier: Apache-2.0 */
/* SPDX-FileCopyrightText: 2026 Signal Slot, Inc. */
/*
 * rpi5_hello: a no-GPU image for the Raspberry Pi 5 (item H9 of
 * docs/notes/pre-study-rpi5.md), built and not run. It prints the build, the
 * board, the console's speed and the RAM the image was linked into (from the
 * overlay's sram0), then counts three seconds on the system timer.
 */
#include <zephyr/kernel.h>
#include <zephyr/devicetree.h>
#include <zephyr/sys/printk.h>

#define RPI5_HELLO_SECONDS 3

int main(void)
{
	int64_t start = k_uptime_get();

	printk("rpi5_hello: build %s\n", RPI5_HELLO_BUILD);
	printk("rpi5_hello: %s, console at %u baud, image RAM 0x%lx + 0x%lx\n", CONFIG_BOARD,
	       (unsigned int)DT_PROP(DT_CHOSEN(zephyr_console), current_speed),
	       (unsigned long)CONFIG_SRAM_BASE_ADDRESS, (unsigned long)CONFIG_SRAM_SIZE * 1024UL);
	for (int i = 1; i <= RPI5_HELLO_SECONDS; i++) {
		k_sleep(K_SECONDS(1));
		printk("rpi5_hello: %d s (uptime %lld ms)\n", i, (long long)k_uptime_get());
	}
	printk("rpi5_hello: counted %d s in %lld ms\n", RPI5_HELLO_SECONDS,
	       (long long)(k_uptime_get() - start));
	return 0;
}
```
