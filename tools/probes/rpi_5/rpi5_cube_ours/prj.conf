## CMakeLists.txt
```
# SPDX-License-Identifier: Apache-2.0
# SPDX-FileCopyrightText: 2026 Signal Slot, Inc.
# rpi5_cube_ours: one seamless cube-map draw through the driver's V3D 7.1 job
# builder (v3d_job71.c) and a level-1 mip of a cube by the 7.1 TFU, on the
# Raspberry Pi 5 (roadmap P10, pre-study U8). See README.md. rpi5_clear's
# configuration and board overlay, no copies.
#
#   west build -p always -b rpi_5 -d build/rpi5_cube_ours yakogl/tools/probes/rpi_5/rpi5_cube_ours -- -DYAKOGL_WERROR=ON
cmake_minimum_required(VERSION 3.20.0)

get_filename_component(RPI5_CLEAR_DIR "${CMAKE_CURRENT_SOURCE_DIR}/../rpi5_clear" ABSOLUTE)
# rpi5_clear's prj.conf first, then this directory's (empty) fragment; its
# overlay (sram0: the 32 MiB low window the GPU's statics live in)
set(CONF_FILE "${RPI5_CLEAR_DIR}/prj.conf;${CMAKE_CURRENT_SOURCE_DIR}/prj.conf")
set(DTC_OVERLAY_FILE "${RPI5_CLEAR_DIR}/boards/rpi_5.overlay")

# driver/ is a Zephyr module (the board layer: the watchdog and the mailbox).
get_filename_component(PVR_REPO "${CMAKE_CURRENT_SOURCE_DIR}/../../../../driver" ABSOLUTE)
get_filename_component(YAKOGL_ROOT "${PVR_REPO}/.." ABSOLUTE)
list(APPEND ZEPHYR_EXTRA_MODULES "${PVR_REPO}")

find_package(Zephyr REQUIRED HINTS $ENV{ZEPHYR_BASE})
project(rpi5_cube_ours)

# The build prints its own commit first (a result row names its build).
execute_process(COMMAND git -C "${PVR_REPO}" describe --always --dirty
                OUTPUT_VARIABLE RPI5_CUBE_BUILD OUTPUT_STRIP_TRAILING_WHITESPACE
                ERROR_QUIET RESULT_VARIABLE describe_rc)
if(NOT describe_rc EQUAL 0 OR RPI5_CUBE_BUILD STREQUAL "")
  set(RPI5_CUBE_BUILD "unknown")
endif()
target_compile_definitions(app PRIVATE RPI5_CUBE_BUILD="${RPI5_CUBE_BUILD}")
message(STATUS "rpi5_cube_ours build: ${RPI5_CUBE_BUILD}")

# The driver's, unchanged: the V3D sequences (v3d_hw.c, the BCM2712 path),
# the 7.1 job builder (v3d_job71.c, with v3d_frame.c for the tiling and the
# viewport), the 7.1 texture and sampler records (v3d_tex71.c, its own 7.1
# unit), the 7.1 TFU fill (v3d_tfu71.c) and Mesa's level layout and texel
# tiling with the P0/P1 words (v3d_tex.c, v3d_tiling_mesa.c: version-neutral,
# built at the default 4.2 as rpi5_tex and rpi5_tfu build them). main.c, the
# hardware sequences and the job builder are built at V3D_CL_VER 71.
set(rpi5_cube_v71
  src/main.c
  ${PVR_REPO}/src/v3d/v3d_hw.c
  ${PVR_REPO}/src/v3d/v3d_frame.c
  ${PVR_REPO}/src/v3d/v3d_job71.c)
target_sources(app PRIVATE
  ${rpi5_cube_v71}
  ${PVR_REPO}/src/v3d/v3d_tex71.c
  ${PVR_REPO}/src/v3d/v3d_tfu71.c
  ${PVR_REPO}/src/v3d/v3d_tex.c
  ${PVR_REPO}/src/v3d/v3d_tiling_mesa.c)
set_source_files_properties(${rpi5_cube_v71} PROPERTIES COMPILE_DEFINITIONS V3D_CL_VER=71)
target_include_directories(app PRIVATE
  src
  ${PVR_REPO}/src/v3d
  ${PVR_REPO}/src/v3d/generated
  ${PVR_REPO}/zephyr/lib/board/rpi4
  ${YAKOGL_ROOT}/third_party/mesa-26.2.1/src/broadcom
  ${YAKOGL_ROOT}/third_party/mesa-26.2.1/src
  ${YAKOGL_ROOT}/third_party/mesa-26.2.1/include)

# Zero warnings in our C files (-DYAKOGL_WERROR=ON, the "zephyr" rows).
if(YAKOGL_WERROR)
  target_compile_options(app PRIVATE -Werror)
endif()
```

## prj.conf
```kconfig
# SPDX-License-Identifier: Apache-2.0
# SPDX-FileCopyrightText: 2026 Signal Slot, Inc.
# rpi5_cube_ours: rpi5_clear's configuration (CMakeLists.txt merges
# ../rpi5_clear/prj.conf first: the watchdog, the mailbox, the cache
# management, the log and the translation tables). Nothing of its own.
```

## src/shaders_ours.h
```c
/* SPDX-License-Identifier: Apache-2.0 */
/* SPDX-FileCopyrightText: 2026 Signal Slot, Inc. */
/*
 * GENERATED by tools/probes/rpi_5/rpi5_cube_ours/gen/gen_shaders.sh: do not edit.
 * rpi5_cube_ours's program (shaders/cube.*) compiled by our
 * V3D 7.1 online compiler (src/shaderc/online/v3d/chain71.rs
 * compile_program71, triangles, VPM 65536) for the Raspberry Pi 5's
 * V3D 7.1.10. Uniform contents are Mesa's quniform_contents (40/41: TMU
 * config P0/P1, data = sampler binding << 24 | the packed bits;
 * v3d_job71 ORs in the records' addresses of the binding). Code
 * addresses are 0: the probe places the code. One translation unit
 * includes this header.
 */
#ifndef RPI5_CUBE_SHADERS_OURS_H
#define RPI5_CUBE_SHADERS_OURS_H

#include <stdint.h>

#include "v3d_frame.h"

/* ---- cube ---- */
static const uint64_t rpi5_cube_cube_fs_code[20] = {
	0x39013186bb03f000ull,
	0x54001106bb103000ull,
	0x390161840503f004ull,
	0x54001146bb143000ull,
	0x3901a1850503f005ull,
	0x5640018780183144ull,
	0x3a4021860503f006ull,
	0x380021878403f1c6ull,
	0x38002187bc03f1e0ull,
	0x38003186bb03f000ull,
	0x54001106bb107000ull,
	0x54001146bb147000ull,
	0x54001186bb187000ull,
	0x38203886bb143000ull,
	0x382038c6bb183000ull,
	0x38003a06bb103000ull,
	0x38813186bb03f000ull,
	0x38a171873b03f104ull,
	0x380031873b03f145ull,
	0x38003186bb03f000ull,
};
static const struct v3d_uniform rpi5_cube_cube_fs_uniforms[2] = {
	{ 40u, 0x00000003u },
	{ 41u, 0x00000004u },
};
static const uint64_t rpi5_cube_cube_vs_code[21] = {
	0x39813186bb03f000ull,
	0x39816184bc03f100ull,
	0x3981a185bc03f140ull,
	0x3981e186bc03f180ull,
	0x39822187bc03f1c0ull,
	0x39826188bc03f200ull,
	0x3982a189bc03f240ull,
	0x3982e18abc03f280ull,
	0x5582c1cabc1cb2a0ull,
	0x39833186bb03f000ull,
	0x558351c6bb1ca000ull,
	0x55830207f520c1c7ull,
	0x558201c0be20a2c7ull,
	0x5582c247f524c1c7ull,
	0x558241c0be24a347ull,
	0x398221870503f1c8ull,
	0x3981e180be03f2c7ull,
	0x39826180be03f24aull,
	0x38202180be03f204ull,
	0x38002180be03f1c5ull,
	0x38002180be03f246ull,
};
static const struct v3d_uniform rpi5_cube_cube_vs_uniforms[18] = {
	{ 0u, 0x00000004u },
	{ 0u, 0x00000005u },
	{ 0u, 0x00000006u },
	{ 0u, 0x00000000u },
	{ 0u, 0x00000001u },
	{ 0u, 0x00000002u },
	{ 0u, 0x00000003u },
	{ 2u, 0x00000000u },
	{ 0u, 0x00000000u },
	{ 3u, 0x00000000u },
	{ 0u, 0x00000001u },
	{ 5u, 0x00000000u },
	{ 4u, 0x00000000u },
	{ 0u, 0x00000002u },
	{ 0u, 0x00000003u },
	{ 0u, 0x00000004u },
	{ 0u, 0x00000005u },
	{ 0u, 0x00000006u },
};
static const uint64_t rpi5_cube_cube_cs_code[18] = {
	0x39813186bb03f000ull,
	0x39816184bc03f100ull,
	0x3981a185bc03f140ull,
	0x3981e186bc03f180ull,
	0x39822187bc03f1c0ull,
	0x39822180be03f204ull,
	0x39822180be03f205ull,
	0x3981a180be03f206ull,
	0x3981a180be03f187ull,
	0x55818107bc1061e0ull,
	0x39823186bb03f000ull,
	0x55825106bb107000ull,
	0x54000144f5148107ull,
	0x54000100be147184ull,
	0x38002184f503f107ull,
	0x38202180be03f244ull,
	0x38003186bb03f000ull,
	0x38003186bb03f000ull,
};
static const struct v3d_uniform rpi5_cube_cube_cs_uniforms[12] = {
	{ 0u, 0x00000000u },
	{ 0u, 0x00000001u },
	{ 0u, 0x00000002u },
	{ 0u, 0x00000003u },
	{ 0u, 0x00000000u },
	{ 0u, 0x00000001u },
	{ 0u, 0x00000002u },
	{ 0u, 0x00000003u },
	{ 2u, 0x00000000u },
	{ 0u, 0x00000004u },
	{ 3u, 0x00000000u },
	{ 0u, 0x00000005u },
};
static const struct v3d_fs_prog rpi5_cube_cube_fs = {
	.threads = 4,
	.single_seg = false,
	.num_inputs = 3,
	.flat_shade_flags = 0x0,
	.noperspective_flags = 0x0,
	.centroid_flags = 0x0,
	.writes_z = false,
	.disable_ez = false,
	.uses_center_w = true,
	.lock_scoreboard_on_first_thrsw = false,
	.uses_implicit_point_line_varyings = false,
	.uses_pid = false,
	.uniforms = rpi5_cube_cube_fs_uniforms,
	.num_uniforms = 2,
};
static const struct v3d_vs_prog rpi5_cube_cube_vs = {
	.threads = 4,
	.single_seg = true,
	.vpm_input_size = 0,
	.vpm_output_size = 1,
	.separate_segments = false,
	.vcm_cache_size = 4,
	.uses_vid = false,
	.uses_iid = false,
	.uses_biid = false,
	.vattr_sizes = { 4, 3, 0, 0, 0, 0, 0, 0, 0, 0, 0, 0, 0, 0, 0, 0 },
	.uniforms = rpi5_cube_cube_vs_uniforms,
	.num_uniforms = 18,
};
static const struct v3d_vs_prog rpi5_cube_cube_cs = {
	.threads = 4,
	.single_seg = true,
	.vpm_input_size = 0,
	.vpm_output_size = 1,
	.separate_segments = false,
	.vcm_cache_size = 4,
	.uses_vid = false,
	.uses_iid = false,
	.uses_biid = false,
	.vattr_sizes = { 4, 0, 0, 0, 0, 0, 0, 0, 0, 0, 0, 0, 0, 0, 0, 0 },
	.uniforms = rpi5_cube_cube_cs_uniforms,
	.num_uniforms = 12,
};
#define RPI5_CUBE_CUBE_ATTRS 2u /* records: a_pos, a_dir */

#endif
```
