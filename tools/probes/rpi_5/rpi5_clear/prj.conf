## CMakeLists.txt
```
# SPDX-License-Identifier: Apache-2.0
# SPDX-FileCopyrightText: 2026 Signal Slot, Inc.
# rpi5_clear: the first clear on the Raspberry Pi 5's V3D 7.1, M1 to M4
# (docs/notes/pre-study-rpi5.md, section 6). See README.md.
#
#   west build -p always -b rpi_5 -d build/rpi5_clear yakogl/tools/probes/rpi_5/rpi5_clear
cmake_minimum_required(VERSION 3.20.0)

# driver/ is a Zephyr module (the board layer: the watchdog and the mailbox).
get_filename_component(PVR_REPO "${CMAKE_CURRENT_SOURCE_DIR}/../../../../driver" ABSOLUTE)
get_filename_component(YAKOGL_ROOT "${PVR_REPO}/.." ABSOLUTE)
list(APPEND ZEPHYR_EXTRA_MODULES "${PVR_REPO}")

find_package(Zephyr REQUIRED HINTS $ENV{ZEPHYR_BASE})
project(rpi5_clear)

# The build prints its own commit first (a result row names its build).
execute_process(COMMAND git -C "${PVR_REPO}" describe --always --dirty
                OUTPUT_VARIABLE RPI5_CLEAR_BUILD OUTPUT_STRIP_TRAILING_WHITESPACE
                ERROR_QUIET RESULT_VARIABLE describe_rc)
if(NOT describe_rc EQUAL 0 OR RPI5_CLEAR_BUILD STREQUAL "")
  set(RPI5_CLEAR_BUILD "unknown")
endif()
target_compile_definitions(app PRIVATE RPI5_CLEAR_BUILD="${RPI5_CLEAR_BUILD}")
message(STATUS "rpi5_clear build: ${RPI5_CLEAR_BUILD}")

# The V3D sequences (v3d_hw.c, the BCM2712 path) and the 7.1 tile size
# (v3d_frame.c's v3d_frame_tiling_gen) are the driver's; the 7.1 packets are
# the probe's own (src/frame71.c). v3d_frame.h brings Mesa's 4.2 packers in:
# the include directories are the ones zephyr/CMakeLists.txt gives gl_test.
target_sources(app PRIVATE
  src/main.c
  src/frame71.c
  ${PVR_REPO}/src/v3d/v3d_hw.c
  ${PVR_REPO}/src/v3d/v3d_frame.c)
target_include_directories(app PRIVATE
  src
  ${PVR_REPO}/src/v3d
  ${PVR_REPO}/src/v3d/generated
  ${PVR_REPO}/zephyr/lib/board/rpi4
  ${YAKOGL_ROOT}/third_party/mesa-26.2.1/src/broadcom
  ${YAKOGL_ROOT}/third_party/mesa-26.2.1/src
  ${YAKOGL_ROOT}/third_party/mesa-26.2.1/include)

# Zero warnings in our C files (-DYAKOGL_WERROR=ON, the "zephyr" rows).
if(YAKOGL_WERROR)
  target_compile_options(app PRIVATE -Werror)
endif()
```

## prj.conf
```kconfig
# SPDX-License-Identifier: Apache-2.0
# SPDX-FileCopyrightText: 2026 Signal Slot, Inc.
# The board defconfig has the console (uart10). The watchdog is the board
# layer's, armed before anything else; the mailbox switches the V3D clock.
CONFIG_PRINTK=y
CONFIG_YAKOGL_RPI5_WDOG=y
CONFIG_YAKOGL_RPI5_WDOG_HOLD_S=30
CONFIG_YAKOGL_RPI5_MBOX=y
# The GPU's buffers are statics written through the data cache:
# sys_cache_data_*() is -ENOTSUP and does nothing without this, and the BCM2712
# SoC does not turn it on (the BCM2711's Kconfig.defconfig does).
CONFIG_CACHE_MANAGEMENT=y
# v3d_hw.c reports its timeouts and faults with LOG_ERR, in order with printk.
CONFIG_LOG=y
CONFIG_LOG_MODE_IMMEDIATE=y
# device_map() of the hub, the core, pm, the SMS and the mailbox above 4 GiB;
# the arm64 MMU code k_panic()s when its translation tables run out.
CONFIG_MAX_XLAT_TABLES=16
```

## boards/rpi_5.overlay
```dts
/* SPDX-License-Identifier: Apache-2.0 */
/* SPDX-FileCopyrightText: 2026 Signal Slot, Inc. */
/*
 * Zephyr's rpi_5 takes zephyr,sram from the SoC's sram0
 * (dts/arm64/broadcom/bcm2712.dtsi: 512 KiB at 0x200000, two address cells).
 * The probe's GPU buffers (page table, lists, tile memory, target) are statics,
 * so sram0 is the 32 MiB from 0x200000 every Pi 5 image has
 * (tools/probes/rpi_5/rpi5_hello): low, below 4 GiB, so the V3D's page table
 * entries and the mailbox's buffer address fit (pre-study-rpi5.md, U10).
 * Zephyr's own mailbox driver (mbox0) stays disabled, as bcm2712.dtsi has it:
 * the board layer's rpi_mbox.c owns the mailbox.
 * Nothing in this overlay was run.
 */
&sram0 {
	reg = <0x0 0x200000 0x2000000>;
};
```

## src/main.c
```c
/* SPDX-License-Identifier: Apache-2.0 */
/* SPDX-FileCopyrightText: 2026 Signal Slot, Inc. */
/*
 * rpi5_clear: the first clear on the Raspberry Pi 5's V3D 7.1, milestones M1
 * to M4 of docs/notes/pre-study-rpi5.md section 6, the Pi 4's v3d_clear
 * (docs/notes/v3d71-clear-frame.md section 3) carried over:
 *
 *   M1  the V3D clock through the firmware mailbox, the power-on
 *       (v3d_power_on, BCM2712: pm's reset and the SMS), the identity read
 *       and printed raw (hub and core IDENT, MMU_DEBUG_INFO) to compare with
 *       Linux's debugfs v3d_ident;
 *   M2  one page table over the probe's static buffers, the MMU on;
 *   M3  the clear-only frame (frame71.c: binning list, render list, generic
 *       tile list) binned and rendered, FLDONE and FRDONE polled;
 *   M4  the 128x64 raster target read back: every pixel the clear colour,
 *       the guard row above it unchanged.
 *
 * One line per step with its raw result, then a single verdict line,
 * `v3d_clear: PASS (...)` or `v3d_clear: FAIL (reason)`, which
 * tools/board.sh pi5 ends the run on. Nothing runs afterwards: the board
 * layer's PM watchdog (armed in the first PRE_KERNEL_1 hook, before main)
 * resets the SoC and tryboot brings Linux back.
 *
 * Every buffer the GPU reads or writes is a static in the image, written
 * through the CPU's cache: each is cleaned and invalidated before the GPU
 * sees it, and the target invalidated again before the CPU reads it back.
 * A cache operation that fails ends the run (CONFIG_CACHE_MANAGEMENT off
 * makes them all -ENOTSUP, and the GPU would read stale memory).
 */
#include <zephyr/kernel.h>
#include <zephyr/cache.h>
#include <zephyr/kernel/internal/mm.h>
#include <zephyr/sys/device_mmio.h>
#include <zephyr/sys/printk.h>

#include <errno.h>
#include <string.h>

#include "v3d.h"
#include "v3d_regs.h"
#include "rpi_mbox.h"
#include "frame71.h"

#define PAGE 4096u

/* The GPU's view: one page table of PT_ENTRIES 4 KiB pages from VA 0 (16 MiB);
 * VA 0 is never mapped, so a null GPU address faults. */
#define PT_ENTRIES 4096u
#define VA_FIRST   0x00100000u

/* The target: 128x64 RGBA8888 (two 64x64 tiles side by side), one guard row
 * in the same buffer right above its first row. */
#define TGT_W      128u
#define TGT_H      64u
#define TGT_STRIDE (TGT_W * 4u)
#define TGT_BYTES  ROUND_UP((TGT_H + 1u) * TGT_STRIDE, PAGE)

#define SENTINEL 0xffff00ffu /* magenta: what the CPU writes, the GPU must overwrite */
#define GUARD    0xff0000ffu /* red: the row above, the GPU must not touch */
#define CLEAR    0xff00ff00u /* green: R in the low byte */

#define CL_BYTES         PAGE
#define TILE_ALLOC_BYTES (64u * 1024u)
#define TILE_STATE_BYTES (64u * 1024u)
#define WAIT_US          1000000u

static uint32_t pt[PT_ENTRIES] __aligned(PAGE);
static uint8_t scratch[PAGE] __aligned(PAGE);
static uint8_t cls[3][CL_BYTES] __aligned(PAGE); /* binning, render, tile list */
static uint8_t tile_alloc[TILE_ALLOC_BYTES] __aligned(PAGE);
static uint8_t tile_state[TILE_STATE_BYTES] __aligned(PAGE);
static uint32_t target[TGT_BYTES / 4] __aligned(PAGE);

static uint32_t va_next = VA_FIRST;

/* The cache path the run used, printed at the start and with the verdict:
 * every sys_cache_data_*() below is this one. */
#define CACHE_OPT                                                                                  \
	"CONFIG_CACHE_MANAGEMENT=" STRINGIFY(IS_ENABLED(CONFIG_CACHE_MANAGEMENT)) " CONFIG_DCACHE="  \
	STRINGIFY(IS_ENABLED(CONFIG_DCACHE)) " sys_cache_data_flush_and_invd_range"

/* VA pages mapped so far, with the page table and the scratch page. */
static unsigned int pages_used(void)
{
	return (va_next - VA_FIRST) / PAGE + 2u;
}

static void verdict(bool pass, const char *what)
{
	printk("v3d_clear: %s (%s; %u pages used incl. page table and scratch, cache: %s)\n",
	       pass ? "PASS" : "FAIL", what, pages_used(), CACHE_OPT);
}

static void print_stall(const char *step, const struct v3d_stall *st)
{
	printk("%s: core_sts 0x%08x hub_sts 0x%08x ct0 0x%08x..0x%08x ct1 0x%08x..0x%08x\n", step,
	       st->core_int_sts, st->hub_int_sts, st->ct0ca, st->ct0ra, st->ct1ca, st->ct1ra);
	printk("%s: err_stat 0x%08x mmu_ctl 0x%08x vio_addr 0x%08x vio_id 0x%08x\n", step, st->err_stat,
	       st->mmu_ctl, st->mmu_vio_addr, st->mmu_vio_id);
}

/* Map `bytes` at `cpu` at the next free GPU VA; 0 when refused. */
static uint32_t gpu_map(void *cpu, uint32_t bytes)
{
	uint32_t va = va_next;
	uint64_t pa = k_mem_phys_addr(cpu);
	int rc = v3d_pte_map(pt, PT_ENTRIES, va, pa, bytes, true);

	if (rc) {
		printk("gpu_map: refused %u bytes at PA 0x%llx (VA 0x%08x): %d\n", bytes,
		       (unsigned long long)pa, va, rc);
		return 0;
	}
	va_next = va + ROUND_UP(bytes, PAGE);
	return va;
}

/* The CPU's writes out to memory and the lines dropped, so that the GPU reads
 * what the CPU wrote and no dirty line is later written over the GPU's. */
static int clean(void *p, size_t bytes, const char *name)
{
	int rc = sys_cache_data_flush_and_invd_range(p, bytes);

	if (rc)
		printk("cache clean of %s (%u bytes): %d\n", name, (unsigned int)bytes, rc);
	return rc;
}

static int clock_set(void *ctx, bool on)
{
	ARG_UNUSED(ctx);
	return rpi_clock_state(RPI_FW_CLK_V3D, on);
}

int main(void)
{
	struct v3d_regs r = { .soc = V3D_SOC_BCM2712 };
	struct v3d_clock_ops clk = { .set = clock_set, .ctx = NULL };
	struct v3d_identity id;
	struct v3d_stall st;
	uint32_t hz = 0;
	int rc;

	printk("v3d_clear: build %s\n", RPI5_CLEAR_BUILD);
	printk("v3d_clear: cache: %s, data line %u bytes\n", CACHE_OPT,
	       (unsigned int)sys_cache_data_line_size_get());
	printk("v3d_clear: %s, V3D 7.1, target %ux%u raster RGBA8888, watchdog armed at boot\n", CONFIG_BOARD,
	       TGT_W, TGT_H);

	/* M1 */
	rc = rpi_mbox_init();
	printk("M1 mailbox: %d\n", rc);
	if (rc) {
		verdict(false, "M1 mailbox");
		goto out;
	}
	device_map(&r.hub, BCM2712_V3D_HUB_BASE, 0x4000, K_MEM_CACHE_NONE);
	device_map(&r.core, BCM2712_V3D_CORE0_BASE, 0x6000, K_MEM_CACHE_NONE);
	device_map(&r.pm, BCM2712_PM_BASE, 0x1000, K_MEM_CACHE_NONE);
	device_map(&r.sms, BCM2712_V3D_SMS_BASE, 0x700, K_MEM_CACHE_NONE);
	printk("M1 before power-on: PM_GRAFX 0x%08x\n", sys_read32(r.pm + BCM2712_PM_GRAFX));

	rc = v3d_power_on(&r, &clk);
	printk("M1 power_on: %d, PM_GRAFX 0x%08x, SMS REE_CS 0x%08x TEE_CS 0x%08x\n", rc,
	       sys_read32(r.pm + BCM2712_PM_GRAFX), sys_read32(r.sms + V3D_SMS_REE_CS),
	       sys_read32(r.sms + V3D_SMS_TEE_CS));
	if (rc) {
		verdict(false, "M1 power-on");
		goto out;
	}
	rc = rpi_clock_rate(RPI_FW_CLK_V3D, &hz);
	printk("M1 V3D clock: rate %d (%u Hz)\n", rc, hz);

	rc = v3d_identify(&r, &id);
	printk("M1 identity: HUB_IDENT0..3 0x%08x 0x%08x 0x%08x 0x%08x\n", id.hub_ident[0], id.hub_ident[1],
	       id.hub_ident[2], id.hub_ident[3]);
	printk("M1 identity: CTL_IDENT0..2 0x%08x 0x%08x 0x%08x MMU_DEBUG_INFO 0x%08x\n", id.ctl_ident[0],
	       id.ctl_ident[1], id.ctl_ident[2], id.mmu_debug_info);
	printk("M1 identity: V3D %u.%u, %u core(s), %u QPUs, VPM %u bytes, PA %u / VA %u bits, MMU %s: %d\n",
	       id.ver / 10, id.ver % 10, id.ncores, id.qpu_count, id.vpm_size, id.pa_width, id.va_width,
	       id.has_mmu ? "yes" : "no", rc);
	if (rc) {
		verdict(false, "M1 identity");
		goto out;
	}

	/* M2 */
	memset(pt, 0, sizeof(pt));
	memset(scratch, 0, sizeof(scratch));
	uint32_t va_cl[3];
	for (int i = 0; i < 3; i++)
		va_cl[i] = gpu_map(cls[i], CL_BYTES);
	uint32_t va_ta = gpu_map(tile_alloc, TILE_ALLOC_BYTES);
	uint32_t va_ts = gpu_map(tile_state, TILE_STATE_BYTES);
	uint32_t va_tgt = gpu_map(target, TGT_BYTES);
	if (!va_cl[0] || !va_cl[1] || !va_cl[2] || !va_ta || !va_ts || !va_tgt) {
		verdict(false, "M2 page table");
		goto out;
	}
	uint64_t pt_pa = k_mem_phys_addr(pt), scratch_pa = k_mem_phys_addr(scratch);
	printk("M2 page table: PA 0x%llx, %u entries, scratch PA 0x%llx, VA 0x%08x..0x%08x mapped\n",
	       (unsigned long long)pt_pa, PT_ENTRIES, (unsigned long long)scratch_pa, VA_FIRST, va_next);
	if (clean(pt, sizeof(pt), "page table") || clean(scratch, sizeof(scratch), "scratch page")) {
		verdict(false, "M2 cache clean");
		goto out;
	}
	v3d_irq_quiesce(&r);
	v3d_caches_init(&r);
	rc = v3d_mmu_init(&r, pt_pa, scratch_pa);
	printk("M2 mmu_init: %d\n", rc);
	if (rc) {
		verdict(false, "M2 MMU");
		goto out;
	}

	/* the frame */
	struct frame71 f = {
		.width = TGT_W,
		.height = TGT_H,
		.clear_rgba8 = CLEAR,
		.target = va_tgt + TGT_STRIDE, /* row 0 of the buffer is the guard row */
		.stride = TGT_STRIDE,
		.tile_alloc = va_ta,
	};
	struct v3d_tiling t;
	uint32_t ta_size, ts_size;
	frame71_tiling(&f, &t);
	v3d_frame_alloc_sizes(&t, 0, PAGE, &ta_size, &ts_size);
	if (ta_size > TILE_ALLOC_BYTES || ts_size > TILE_STATE_BYTES) {
		printk("frame: tile allocation %u bytes, tile state %u bytes\n", ta_size, ts_size);
		verdict(false, "frame sizes");
		goto out;
	}
	struct cl71 bcl, rcl, tl;
	cl71_init(&bcl, cls[0], va_cl[0], CL_BYTES);
	cl71_init(&rcl, cls[1], va_cl[1], CL_BYTES);
	cl71_init(&tl, cls[2], va_cl[2], CL_BYTES);
	if (!frame71_build_clear(&f, &bcl, &rcl, &tl)) {
		verdict(false, "frame build");
		goto out;
	}
	printk("frame %ux%u: tile %ux%u, %ux%u tiles, lists %u / %u / %u bytes, tile alloc %u, state %u\n",
	       f.width, f.height, t.tile_w, t.tile_h, t.tiles_x, t.tiles_y, bcl.len, rcl.len, tl.len, ta_size,
	       ts_size);

	/* the target pre-filled: the guard row, then the sentinel the clear
	 * must replace */
	for (uint32_t x = 0; x < TGT_W; x++)
		target[x] = GUARD;
	for (uint32_t i = TGT_W; i < TGT_BYTES / 4u; i++)
		target[i] = SENTINEL;
	memset(tile_state, 0, sizeof(tile_state));
	if (clean(cls, sizeof(cls), "lists") || clean(tile_alloc, sizeof(tile_alloc), "tile allocation") ||
	    clean(tile_state, sizeof(tile_state), "tile state") || clean(target, sizeof(target), "target")) {
		verdict(false, "M3 cache clean");
		goto out;
	}

	/* M3 */
	v3d_submit_bin(&r, va_cl[0], cl71_end(&bcl), va_ta, ta_size, va_ts);
	rc = v3d_wait(&r, V3D_CTL_0_INT_STS_INT_FLDONE_SET, WAIT_US, &st);
	printk("M3 bin: %d\n", rc);
	if (rc) {
		print_stall("M3 bin", &st);
		verdict(false, rc == -ENOMEM ? "M3 bin: out of memory"
			       : rc == -EFAULT ? "M3 bin: MMU fault"
					       : "M3 bin: timeout");
		goto out;
	}
	v3d_submit_render(&r, va_cl[1], cl71_end(&rcl));
	rc = v3d_wait(&r, V3D_CTL_0_INT_STS_INT_FRDONE_SET, WAIT_US, &st);
	printk("M3 render: %d\n", rc);
	if (rc) {
		print_stall("M3 render", &st);
		verdict(false, rc == -EFAULT ? "M3 render: MMU fault" : "M3 render: timeout");
		goto out;
	}
	rc = v3d_caches_clean(&r);
	printk("M3 caches_clean: %d\n", rc);
	if (rc) {
		verdict(false, "M3 GPU cache clean");
		goto out;
	}

	/* M4: what the GPU wrote, not a line the CPU still holds */
	rc = sys_cache_data_invd_range(target, sizeof(target));
	if (rc) {
		printk("cache invalidate of the target: %d\n", rc);
		verdict(false, "M4 cache invalidate");
		goto out;
	}
	uint32_t bad = 0, guard_bad = 0, first_x = 0, first_y = 0, first_v = 0;
	for (uint32_t y = 0; y < TGT_H; y++) {
		for (uint32_t x = 0; x < TGT_W; x++) {
			uint32_t v = target[(y + 1) * TGT_W + x];
			if (v != CLEAR && bad++ == 0) {
				first_x = x;
				first_y = y;
				first_v = v;
			}
		}
	}
	for (uint32_t x = 0; x < TGT_W; x++)
		guard_bad += target[x] != GUARD;
	if (bad)
		printk("M4: %u of %u target pixels wrong (first at %u,%u: 0x%08x), guard row %u of %u changed\n",
		       bad, TGT_W * TGT_H, first_x, first_y, first_v, guard_bad, TGT_W);
	else
		printk("M4: %u of %u target pixels wrong, guard row %u of %u changed\n", bad, TGT_W * TGT_H,
		       guard_bad, TGT_W);
	if (bad)
		verdict(false, "M4 pixels");
	else if (guard_bad)
		verdict(false, "M4 guard row");
	else
		verdict(true, "M1 to M4, 128x64 cleared");

out:
	/* nothing more: the watchdog resets the SoC, tryboot brings Linux back */
	for (;;)
		k_sleep(K_SECONDS(10));
	return 0;
}
```

## src/frame71.c
```c
/* SPDX-License-Identifier: Apache-2.0 */
/* SPDX-FileCopyrightText: 2026 Signal Slot, Inc. */
/*
 * The V3D 7.1 clear-only frame (frame71.h). The sequence is
 * docs/notes/v3d71-clear-frame.md section 1 (Mesa 26.2.1's v3dX(start_binning),
 * v3dX(bcl_epilogue), v3dX(emit_rcl), emit_render_layer and
 * v3d_rcl_emit_generic_per_tile_list at V3D_VERSION 71), with the 4.2 frame
 * builder's own choices kept (driver/src/v3d/v3d_frame.c): a raster store of
 * render target 0, early Z disabled. Bit positions are the packet's, counted
 * from bit 0 of the opcode byte, as Mesa's unpack functions name them.
 */
#include <string.h>

#include "frame71.h"

/* Opcodes and lengths: v3d_packet.xml, the 7.1 column (the note, 1.1 to 1.3). */
#define OP_FLUSH                      4
#define OP_START_TILE_BINNING         6
#define OP_END_OF_RENDERING           13
#define OP_RETURN_FROM_SUB_LIST       18
#define OP_FLUSH_VCD_CACHE            19
#define OP_GENERIC_TILE_LIST          20
#define OP_BRANCH_TO_IMPLICIT_TILE    21
#define OP_SUPERTILE_COORDINATES      23
#define OP_CLEAR_RENDER_TARGETS       25
#define OP_END_OF_LOADS               26
#define OP_END_OF_TILE_MARKER         27
#define OP_STORE_TILE_BUFFER_GENERAL  29
#define OP_SET_INSTANCEID             54
#define OP_PRIM_LIST_FORMAT           56
#define OP_OCCLUSION_QUERY_COUNTER    92
#define OP_NUMBER_OF_LAYERS           119
#define OP_TILE_BINNING_MODE_CFG      120
#define OP_TILE_RENDERING_MODE_CFG    121 /* sub-id 0 common, 1 Z/S clear, 2 RT part 1 */
#define OP_SUPERTILE_CFG              122
#define OP_TILE_LIST_SET_BASE         123
#define OP_TILE_COORDINATES           124
#define OP_TILE_COORDINATES_IMPLICIT  125
#define OP_TILE_LIST_INITIAL_BLOCK    126

#define SUB_COMMON          0
#define SUB_ZS_CLEAR_VALUES 1
#define SUB_RT_PART1        2

#define TILE_ALLOC_BLOCK_64B  0
#define TILE_ALLOC_BLOCK_128B 1
#define STORE_BUFFER_RT0      0
#define STORE_BUFFER_NONE     8
#define MEMORY_FORMAT_RASTER  0
#define OUTPUT_FORMAT_RGBA8   27 /* Output Image Format rgba8 */
#define INTERNAL_BPP_32       0
#define RT_TYPE_CLAMP_8       8  /* Render Target Type Clamp "8" (X:154-175) */
#define INTERNAL_DEPTH_32F    0  /* Internal Depth Type depth_32f */
#define PRIM_LIST_TRIANGLES   2

void cl71_init(struct cl71 *cl, void *buf, uint32_t gpu, uint32_t cap)
{
	cl->p = buf;
	cl->gpu = gpu;
	cl->len = 0;
	cl->cap = cap;
	cl->ok = true;
}

/* One packet being written: its bytes, zeroed, and whether every field fit. */
struct pkt {
	uint8_t *b;
	bool ok;
};

static struct pkt begin(struct cl71 *cl, uint8_t opcode, uint32_t len)
{
	static uint8_t sink[16]; /* where a packet that does not fit is written */
	struct pkt k = { sink, true };

	if (cl->ok && len <= cl->cap - cl->len) {
		k.b = cl->p + cl->len;
		cl->len += len;
	} else {
		cl->ok = false;
	}
	memset(k.b, 0, len);
	k.b[0] = opcode;
	return k;
}

static void end(struct cl71 *cl, const struct pkt *k)
{
	if (!k->ok)
		cl->ok = false;
}

/* `v` into bits [start, start + width) of the packet, little-endian. */
static void put(struct pkt *k, uint32_t start, uint32_t width, uint64_t v)
{
	if (width < 64 && (v >> width) != 0) {
		k->ok = false;
		return;
	}
	for (uint32_t i = 0; i < width; i++) {
		if (v & ((uint64_t)1 << i))
			k->b[(start + i) / 8] |= (uint8_t)(1u << ((start + i) % 8));
	}
}

static uint32_t log2_tile(uint32_t edge)
{
	return edge == 64 ? 3 : edge == 32 ? 2 : edge == 16 ? 1 : 0;
}

void frame71_tiling(const struct frame71 *f, struct v3d_tiling *t)
{
	v3d_frame_tiling_gen(71, f->width, f->height, 1, false, 0, 4, t);
}

static void op_only(struct cl71 *cl, uint8_t opcode)
{
	struct pkt k = begin(cl, opcode, 1);
	end(cl, &k);
}

static void store_general(struct cl71 *cl, uint32_t buffer, uint32_t format, uint32_t stride, uint32_t address)
{
	struct pkt k = begin(cl, OP_STORE_TILE_BUFFER_GENERAL, 13);
	put(&k, 8, 4, buffer);
	put(&k, 12, 3, MEMORY_FORMAT_RASTER);
	/* flip Y (15), dither (16..17), decimate sample 0 (18..19): 0 */
	put(&k, 20, 6, format);
	/* clear buffer being stored (26), channel reverse (27), R/B swap (28): 0 */
	put(&k, 36, 20, stride); /* height in UB or stride: the byte stride for raster */
	/* height (56..71): 0, as Mesa's raster store */
	put(&k, 72, 32, address);
	end(cl, &k);
}

/* v3dX(start_binning) and the FLUSH of v3dX(bcl_epilogue): 19 bytes. */
static void emit_bcl(const struct frame71 *f, const struct v3d_tiling *t, struct cl71 *bcl)
{
	struct pkt k = begin(bcl, OP_NUMBER_OF_LAYERS, 2);
	put(&k, 8, 8, 1 - 1);
	end(bcl, &k);

	k = begin(bcl, OP_TILE_BINNING_MODE_CFG, 9);
	put(&k, 10, 2, TILE_ALLOC_BLOCK_128B); /* initial block size */
	put(&k, 12, 2, TILE_ALLOC_BLOCK_64B);  /* block size */
	put(&k, 16, 3, log2_tile(t->tile_w));
	put(&k, 19, 3, log2_tile(t->tile_h));
	put(&k, 40, 16, f->width - 1);
	put(&k, 56, 16, f->height - 1);
	end(bcl, &k);

	op_only(bcl, OP_FLUSH_VCD_CACHE);
	k = begin(bcl, OP_OCCLUSION_QUERY_COUNTER, 5); /* address 0: no query */
	end(bcl, &k);
	op_only(bcl, OP_START_TILE_BINNING);
	/* no draws: FLUSH caps every tile list with a return */
	op_only(bcl, OP_FLUSH);
}

/* v3d_rcl_emit_generic_per_tile_list: 27 bytes. */
static void emit_tile_list(const struct frame71 *f, struct cl71 *tl)
{
	op_only(tl, OP_TILE_COORDINATES_IMPLICIT);
	op_only(tl, OP_END_OF_LOADS); /* no loads: the whole target is cleared */

	struct pkt k = begin(tl, OP_PRIM_LIST_FORMAT, 2);
	put(&k, 8, 6, PRIM_LIST_TRIANGLES);
	end(tl, &k);
	k = begin(tl, OP_SET_INSTANCEID, 5); /* instance 0 */
	end(tl, &k);
	k = begin(tl, OP_BRANCH_TO_IMPLICIT_TILE, 2); /* tile list set 0 */
	end(tl, &k);

	store_general(tl, STORE_BUFFER_RT0, OUTPUT_FORMAT_RGBA8, f->stride, f->target);
	op_only(tl, OP_CLEAR_RENDER_TARGETS); /* job->clear_tlb: ready for the next tile */
	op_only(tl, OP_END_OF_TILE_MARKER);
	op_only(tl, OP_RETURN_FROM_SUB_LIST);
}

/* v3dX(emit_rcl) and emit_render_layer, layer 0: 96 bytes for one tile. */
static void emit_rcl(const struct frame71 *f, const struct v3d_tiling *t, uint32_t tl_start,
		     uint32_t tl_end, struct cl71 *rcl)
{
	struct pkt k = begin(rcl, OP_TILE_RENDERING_MODE_CFG, 9);
	put(&k, 8, 3, SUB_COMMON);
	put(&k, 12, 4, 1 - 1); /* one render target */
	put(&k, 16, 16, f->width);
	put(&k, 32, 16, f->height);
	/* 4x (50), double buffer (51), depth-buffer disable (52; Mesa leaves it
	 * 0), early Z direction LT/LE (53): 0 */
	put(&k, 54, 1, 1); /* early Z disable: no depth buffer */
	put(&k, 55, 4, INTERNAL_DEPTH_32F);
	/* early depth/stencil clear (59): 0 */
	put(&k, 60, 3, log2_tile(t->tile_w));
	put(&k, 63, 3, log2_tile(t->tile_h));
	end(rcl, &k);

	/* render target 0: TLB base 0, stride tile_w * words / 2 (one word at
	 * 32 bpp; v3d_util.c v3d_compute_rt_row_row_stride_128_bits) */
	k = begin(rcl, OP_TILE_RENDERING_MODE_CFG, 9);
	put(&k, 8, 3, SUB_RT_PART1);
	put(&k, 11, 3, 0);  /* render target number */
	put(&k, 15, 11, 0); /* base address */
	put(&k, 26, 7, t->tile_w / 2 - 1);
	put(&k, 33, 2, INTERNAL_BPP_32);
	put(&k, 35, 5, RT_TYPE_CLAMP_8);
	put(&k, 40, 32, f->clear_rgba8);
	end(rcl, &k);

	k = begin(rcl, OP_TILE_RENDERING_MODE_CFG, 9);
	put(&k, 8, 4, SUB_ZS_CLEAR_VALUES);
	/* stencil 0 (16..23), Z 0.0f (24..55) */
	end(rcl, &k);

	k = begin(rcl, OP_TILE_LIST_INITIAL_BLOCK, 2);
	put(&k, 8, 2, TILE_ALLOC_BLOCK_128B);
	put(&k, 10, 1, 1); /* auto-chained tile lists */
	end(rcl, &k);

	/* the set number shares the low address bits: 64-byte alignment */
	k = begin(rcl, OP_TILE_LIST_SET_BASE, 5);
	if (f->tile_alloc & 63)
		k.ok = false;
	put(&k, 8, 32, f->tile_alloc); /* tile list set 0 */
	end(rcl, &k);

	k = begin(rcl, OP_SUPERTILE_CFG, 9);
	put(&k, 8, 8, t->supertile_w - 1);
	put(&k, 16, 8, t->supertile_h - 1);
	put(&k, 24, 8, t->frame_w_supertiles);
	put(&k, 32, 8, t->frame_h_supertiles);
	put(&k, 40, 12, t->tiles_x);
	put(&k, 52, 12, t->tiles_y);
	/* multicore (64), raster order (68): 0; one bin tile list (69..71) */
	end(rcl, &k);

	/* the initial clear and GFXH-1742's two dummy tiles, the clear only in
	 * the first (no double buffer) */
	for (int i = 0; i < 2; i++) {
		k = begin(rcl, OP_TILE_COORDINATES, 4); /* column 0, row 0 */
		end(rcl, &k);
		op_only(rcl, OP_END_OF_LOADS);
		store_general(rcl, STORE_BUFFER_NONE, 0, 0, 0);
		if (i == 0)
			op_only(rcl, OP_CLEAR_RENDER_TARGETS);
		op_only(rcl, OP_END_OF_TILE_MARKER);
	}
	op_only(rcl, OP_FLUSH_VCD_CACHE);

	k = begin(rcl, OP_GENERIC_TILE_LIST, 9);
	put(&k, 8, 32, tl_start);
	put(&k, 40, 32, tl_end);
	end(rcl, &k);

	/* every supertile covering the frame (the draw area of a clear) */
	uint32_t stw = t->tile_w * t->supertile_w, sth = t->tile_h * t->supertile_h;
	for (uint32_t y = 0; y <= (f->height - 1) / sth; y++) {
		for (uint32_t x = 0; x <= (f->width - 1) / stw; x++) {
			k = begin(rcl, OP_SUPERTILE_COORDINATES, 3);
			put(&k, 8, 8, x);
			put(&k, 16, 8, y);
			end(rcl, &k);
		}
	}
	op_only(rcl, OP_END_OF_RENDERING);
}

bool frame71_build_clear(const struct frame71 *f, struct cl71 *bcl, struct cl71 *rcl, struct cl71 *tl)
{
	/* the binning packet's 16-bit minus-one size; the common packet's
	 * 16-bit size without the minus one */
	if (f->width == 0 || f->height == 0 || f->width > 0xffff || f->height > 0xffff)
		return false;

	struct v3d_tiling t;
	frame71_tiling(f, &t);

	emit_bcl(f, &t, bcl);
	uint32_t tl_start = cl71_end(tl);
	emit_tile_list(f, tl);
	uint32_t tl_end = cl71_end(tl);
	emit_rcl(f, &t, tl_start, tl_end, rcl);
	return bcl->ok && rcl->ok && tl->ok;
}
```

## src/frame71.h
```c
/* SPDX-License-Identifier: Apache-2.0 */
/* SPDX-FileCopyrightText: 2026 Signal Slot, Inc. */
/*
 * The V3D 7.1 clear-only frame of rpi5_clear: the binning list, the render
 * list and the generic tile list of docs/notes/v3d71-clear-frame.md section 1,
 * packet by packet, for one RGBA8888 render target stored to a raster buffer.
 *
 * The 7.1 packers of H4 (driver/src/v3d/generated/v3d_packet_v71_pack.h) are
 * not in the tree yet, so the probe writes its packets itself: each field is
 * put at the bit position Mesa's generated 7.1 packer uses (gen_pack_header.py
 * on third_party/mesa-26.2.1/src/broadcom/cle/v3d_packet.xml, version 71).
 * tools/v3d/check71.d/clear71.sh compares the bytes with Mesa's own packers.
 *
 * No OS calls: the caller owns the memory and the GPU addresses.
 */
#ifndef FRAME71_H
#define FRAME71_H

#include <stdbool.h>
#include <stdint.h>

#include "v3d_frame.h" /* struct v3d_tiling, v3d_frame_tiling_gen */

/* A list being written: `cap` bytes at CPU `p`, GPU address `gpu`. A packet
 * that does not fit is not written and clears `ok`. */
struct cl71 {
	uint8_t *p;
	uint32_t gpu, len, cap;
	bool ok;
};

void cl71_init(struct cl71 *cl, void *buf, uint32_t gpu, uint32_t cap);

/* The GPU address one past the last byte written. */
static inline uint32_t cl71_end(const struct cl71 *cl)
{
	return cl->gpu + cl->len;
}

struct frame71 {
	uint32_t width, height;    /* pixels */
	uint32_t clear_rgba8;      /* R in bits 0..7, A in 24..31 */
	uint32_t target;           /* GPU address of the raster RGBA8888 buffer */
	uint32_t stride;           /* its row stride in bytes */
	uint32_t tile_alloc;       /* GPU address, 64-byte aligned */
};

/* The tile size and counts of the frame: v3d_frame_tiling_gen at 71 for one
 * 32 bpp render target (4 bytes a pixel), no multisampling. */
void frame71_tiling(const struct frame71 *f, struct v3d_tiling *t);

/*
 * Write the three lists. The generic tile list goes into `tl` (Mesa keeps it
 * in the job's indirect buffer); the render list branches to it. Returns
 * false, and nothing may be submitted, when a list overflowed or a value does
 * not fit its field (a zero or too large size, a misaligned tile allocation).
 */
bool frame71_build_clear(const struct frame71 *f, struct cl71 *bcl, struct cl71 *rcl, struct cl71 *tl);

#endif
```
