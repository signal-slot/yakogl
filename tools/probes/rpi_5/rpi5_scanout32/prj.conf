## CMakeLists.txt
```
# SPDX-License-Identifier: Apache-2.0
# SPDX-FileCopyrightText: 2026 Signal Slot, Inc.
# rpi5_scanout32: stage 2 of docs/notes/rpi5-display.md (our own 32 bpp
# XRGB8888 plane after word 32 of the firmware's display list, swapped in at
# vblank between buffers A and B, then the firmware's list restored
# byte-equal). See README.md.
#
#   west build -p always -b rpi_5 -d build/rpi5_scanout32 yakogl/tools/probes/rpi_5/rpi5_scanout32 \
#     -- -DYAKOGL_WERROR=ON
cmake_minimum_required(VERSION 3.20.0)

# driver/ is a Zephyr module (the board layer: the watchdog).
get_filename_component(PVR_REPO "${CMAKE_CURRENT_SOURCE_DIR}/../../../../driver" ABSOLUTE)
list(APPEND ZEPHYR_EXTRA_MODULES "${PVR_REPO}")

find_package(Zephyr REQUIRED HINTS $ENV{ZEPHYR_BASE})
project(rpi5_scanout32)

# The build prints its own commit first (a result row names its build).
execute_process(COMMAND git -C "${PVR_REPO}" describe --always --dirty
                OUTPUT_VARIABLE RPI5_SCANOUT32_BUILD OUTPUT_STRIP_TRAILING_WHITESPACE
                ERROR_QUIET RESULT_VARIABLE describe_rc)
if(NOT describe_rc EQUAL 0 OR RPI5_SCANOUT32_BUILD STREQUAL "")
  set(RPI5_SCANOUT32_BUILD "unknown")
endif()
target_compile_definitions(app PRIVATE RPI5_SCANOUT32_BUILD="${RPI5_SCANOUT32_BUILD}")
message(STATUS "rpi5_scanout32 build: ${RPI5_SCANOUT32_BUILD}")

# Hardware-written words of a plane entry (README "Hardware-written words"):
# "<off>:skip|expect" items joined by ',', offsets 0..62 from an entry's
# start, at most 4, each once; "" compares every word. The default is the one
# word the board showed changing (rpi5_scanout16 README "Q2's list word").
#   -DRPI5_SCANOUT32_HW_WORDS="4:skip"
set(RPI5_SCANOUT32_HW_WORDS "4:skip" CACHE STRING
    "hardware-written plane-entry words, e.g. 4:skip or 4:skip,7:expect (empty: none)")
if(NOT RPI5_SCANOUT32_HW_WORDS STREQUAL "")
  if(NOT RPI5_SCANOUT32_HW_WORDS MATCHES "^[0-9]+:(skip|expect)(,[0-9]+:(skip|expect))*$")
    message(FATAL_ERROR "RPI5_SCANOUT32_HW_WORDS '${RPI5_SCANOUT32_HW_WORDS}': "
                        "want <off>:skip|expect[,<off>:skip|expect...]")
  endif()
  string(REPLACE "," ";" hw_items "${RPI5_SCANOUT32_HW_WORDS}")
  list(LENGTH hw_items hw_n)
  if(hw_n GREATER 4)
    message(FATAL_ERROR "RPI5_SCANOUT32_HW_WORDS: ${hw_n} items, at most 4")
  endif()
  set(hw_seen "")
  foreach(it IN LISTS hw_items)
    string(REGEX REPLACE ":.*" "" hw_off "${it}")
    if(hw_off GREATER 62)
      message(FATAL_ERROR "RPI5_SCANOUT32_HW_WORDS: offset ${hw_off} over 62")
    endif()
    math(EXPR hw_off "${hw_off}")
    if(hw_off IN_LIST hw_seen)
      message(FATAL_ERROR "RPI5_SCANOUT32_HW_WORDS: offset ${hw_off} twice")
    endif()
    list(APPEND hw_seen ${hw_off})
  endforeach()
endif()
target_compile_definitions(app PRIVATE RPI5_SCANOUT32_HW_WORDS="${RPI5_SCANOUT32_HW_WORDS}")
message(STATUS "rpi5_scanout32 hardware-written words: '${RPI5_SCANOUT32_HW_WORDS}'")

target_sources(app PRIVATE src/main.c)
# rpi_wdog.h lives with the rpi4 board code; the header-only decoders in
# rpi5_scanout (hvs6_dlist.h, ...) have no source of their own.
target_include_directories(app PRIVATE
  src
  ${PVR_REPO}/zephyr/lib/board/rpi4
  ${PVR_REPO}/zephyr/lib/board/rpi5_scanout)

# Zero warnings in our C files (-DYAKOGL_WERROR=ON, the "zephyr" rows).
if(YAKOGL_WERROR)
  target_compile_options(app PRIVATE -Werror)
endif()
```

## prj.conf
```kconfig
# SPDX-License-Identifier: Apache-2.0
# SPDX-FileCopyrightText: 2026 Signal Slot, Inc.
# The board defconfig has the console (uart10). The watchdog is the board
# layer's, armed before anything else; the image stops feeding it after its
# end line (rpi_wdog_alive in src/main.c) and the board returns to Linux.
CONFIG_PRINTK=y
CONFIG_YAKOGL_RPI5_WDOG=y
CONFIG_YAKOGL_RPI5_WDOG_HOLD_S=45
# The later display-list and buffer writes need the clean/invalidate calls to
# work (without this every sys_cache_data_*() is -ENOTSUP and does nothing).
CONFIG_CACHE_MANAGEMENT=y
CONFIG_LOG=y
CONFIG_LOG_MODE_IMMEDIATE=y
# device_map() of the HVS (and later the pixel valve): the arm64 MMU code
# k_panic()s when its translation tables run out.
CONFIG_MAX_XLAT_TABLES=16
# s32-nullfix: main()'s record lines (hvs6s_lines -> printk through the
# immediate-mode log) go deeper than the default 4096-byte main stack; on the
# board it overflowed into the idle stack below it and the idle thread
# returned to address 0x20 (src/swap_check.h section (h)). INIT_STACKS and
# THREAD_STACK_INFO let the probe print its high-water mark (S11); the
# sentinel stops the image at a context switch if the stack ever runs out.
CONFIG_MAIN_STACK_SIZE=16384
CONFIG_INIT_STACKS=y
CONFIG_THREAD_STACK_INFO=y
CONFIG_STACK_SENTINEL=y
```

## boards/rpi_5.overlay
```dts
/* SPDX-License-Identifier: Apache-2.0 */
/* SPDX-FileCopyrightText: 2026 Signal Slot, Inc. */
/*
 * The same sram0 as every Pi 5 image: 32 MiB from 0x200000, below 4 GiB.
 *
 * The blocks this probe touches are mapped in src/main.c with device_map()
 * (as rpi5_display does) and are named here so the addresses sit in one
 * place. They have no compatible: no Zephyr driver binds to them.
 *   hvs: ARM 0x10_7c580000, 0x1a000 bytes; the display-list memory is the
 *        words from byte 0x4000 of it (rpi:bcm2712.dtsi:612-617)
 *   pv0: pixelvalve0, HDMI0's, 0x10_7c410000, 0x100 bytes
 *        (rpi:bcm2712.dtsi:294)
 */
&sram0 {
	reg = <0x0 0x200000 0x2000000>;
};

/ {
	yakogl_hvs: yakogl-hvs@107c580000 {
		reg = <0x10 0x7c580000 0x1a000>;
		status = "reserved";
	};

	yakogl_pv0: yakogl-pv0@107c410000 {
		reg = <0x10 0x7c410000 0x100>;
		status = "reserved";
	};
};
```

## src/io_filter.h
```c
/* SPDX-License-Identifier: Apache-2.0 */
/* SPDX-FileCopyrightText: 2026 Signal Slot, Inc. */
/*
 * io_filter.h: the one rule of what rpi5_scanout32 may write to the HVS.
 *
 * Only list memory at word >= HVS6S_KEPT (the firmware's first words stay
 * untouched) and channel 0's LPTRS register. Every other HVS offset
 * (DISPCTRL, the channel CTRL/STAT/DL registers, other channels' LPTRS,
 * list words below HVS6S_KEPT) is refused. Pure, header-only; included by
 * main.c's io_write32 and by io_filter_selftest.sh. The includer defines
 * HVS_SIZE and CHAN first (main.c does; the selftest does).
 */
#ifndef RPI5_SCANOUT32_IO_FILTER_H
#define RPI5_SCANOUT32_IO_FILTER_H

#include <stdbool.h>
#include <stdint.h>

#include "hvs6_dlist_swap.h"

static inline bool scanout32_write_ok(uint32_t off)
{
	return off == hvs6s_lptrs_reg(CHAN) ||
	       (off >= hvs6s_word_off(HVS6S_KEPT) && off < HVS_SIZE);
}

#endif /* RPI5_SCANOUT32_IO_FILTER_H */
```
