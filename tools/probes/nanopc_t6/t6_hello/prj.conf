## CMakeLists.txt
```
# SPDX-License-Identifier: Apache-2.0
# SPDX-FileCopyrightText: 2026 Signal Slot, Inc.
# t6_hello: milestone Z1 on the NanoPC-T6 (driver/docs/nanopc-t6-mali.md):
# the build line and the watchdog arming on uart2, ten seconds counted on the
# system timer, then the reset back into Armbian.
#
#   west build -p always -b nanopc_t6 -d build/t6_hello yakogl/tools/probes/nanopc_t6/t6_hello
cmake_minimum_required(VERSION 3.20.0)

# driver/ is a Zephyr module (the board, the board glue, the Rust crate).
get_filename_component(PVR_REPO "${CMAKE_CURRENT_SOURCE_DIR}/../../../../driver" ABSOLUTE)
list(APPEND ZEPHYR_EXTRA_MODULES "${PVR_REPO}")

find_package(Zephyr REQUIRED HINTS $ENV{ZEPHYR_BASE})
project(t6_hello)

# The build prints its own commit first (a result row names its build).
execute_process(COMMAND git -C "${PVR_REPO}" describe --always --dirty
                OUTPUT_VARIABLE T6_HELLO_BUILD OUTPUT_STRIP_TRAILING_WHITESPACE
                ERROR_QUIET RESULT_VARIABLE describe_rc)
if(NOT describe_rc EQUAL 0 OR T6_HELLO_BUILD STREQUAL "")
  set(T6_HELLO_BUILD "unknown")
endif()
target_compile_definitions(app PRIVATE T6_HELLO_BUILD="${T6_HELLO_BUILD}")
message(STATUS "t6_hello build: ${T6_HELLO_BUILD}")

target_sources(app PRIVATE src/main.c)

# Zero warnings in our C files: tools/check.sh builds this sample with
# -DYAKOGL_WERROR=ON (the "zephyr" rows); off by default.
if(YAKOGL_WERROR)
  target_compile_options(app PRIVATE -Werror)
endif()
```

## prj.conf
```kconfig
# SPDX-License-Identifier: Apache-2.0
# SPDX-FileCopyrightText: 2026 Signal Slot, Inc.
# The board defconfig has the console; the board glue (nanopc_t6.c) arms the
# watchdog. Nothing else is needed for Z1.
CONFIG_PRINTK=y
CONFIG_EARLY_CONSOLE=y
```

## src/main.c
```c
/* SPDX-License-Identifier: Apache-2.0 */
/* SPDX-FileCopyrightText: 2026 Signal Slot, Inc. */
/*
 * t6_hello: Z1 on the NanoPC-T6 (driver/docs/nanopc-t6-mali.md). Before
 * main() the board glue has reset the GIC EOI mode, armed WDT0 and printed
 * the arming (nanopc_t6.c). This prints the build, counts T6_HELLO_SECONDS
 * on the system timer (each second a k_sleep: it needs the timer interrupt,
 * which a GIC left in Linux's EOI mode delivers once only), feeding the
 * watchdog, and resets the board back into Armbian.
 */
#include <zephyr/kernel.h>
#include <zephyr/devicetree.h>
#include <zephyr/sys/printk.h>

#include <nanopc_t6.h>

#define T6_HELLO_SECONDS 10

BUILD_ASSERT(T6_HELLO_SECONDS + 5 < CONFIG_YAKOGL_NANOPC_T6_LIFETIME_S,
	     "the run ends well inside the watchdog's lifetime");

int main(void)
{
	int64_t start = k_uptime_get();

	printk("t6_hello: build %s\n", T6_HELLO_BUILD);
	printk("t6_hello: %s, console uart2 at %u baud, image at 0x%lx\n", CONFIG_BOARD,
	       (unsigned int)DT_PROP(DT_CHOSEN(zephyr_console), current_speed),
	       (unsigned long)CONFIG_SRAM_BASE_ADDRESS);
	printk("t6_hello: WDT0 period %u ms, fed until %u ms of uptime\n", t6_watchdog_period_ms(),
	       t6_watchdog_deadline_ms());
	for (int i = 1; i <= T6_HELLO_SECONDS; i++) {
		k_sleep(K_SECONDS(1));
		t6_watchdog_feed();
		printk("t6_hello: %d s (uptime %lld ms)\n", i, (long long)k_uptime_get());
	}
	printk("t6_hello: PASS: counted %d s in %lld ms\n", T6_HELLO_SECONDS,
	       (long long)(k_uptime_get() - start));
	t6_reset_to_linux("t6_hello done");
}
```
