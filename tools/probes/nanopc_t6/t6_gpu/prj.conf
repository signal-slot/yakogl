## CMakeLists.txt
```
# SPDX-License-Identifier: Apache-2.0
# SPDX-FileCopyrightText: 2026 Signal Slot, Inc.
# t6_gpu: the second half of Z1 on the NanoPC-T6 (driver/docs/nanopc-t6-mali.md):
# the GPU's power at hand-over, PD_GPU on, GPU_ID read, soft reset and the
# L2 on, then the reset back into Armbian.
#
#   west build -p always -b nanopc_t6 -d build/t6_gpu yakogl/tools/probes/nanopc_t6/t6_gpu
cmake_minimum_required(VERSION 3.20.0)

# driver/ is a Zephyr module (the board, the board glue, the Rust crate).
get_filename_component(PVR_REPO "${CMAKE_CURRENT_SOURCE_DIR}/../../../../driver" ABSOLUTE)
list(APPEND ZEPHYR_EXTRA_MODULES "${PVR_REPO}")

find_package(Zephyr REQUIRED HINTS $ENV{ZEPHYR_BASE})
project(t6_gpu)

# The build prints its own commit first (a result row names its build).
execute_process(COMMAND git -C "${PVR_REPO}" describe --always --dirty
                OUTPUT_VARIABLE T6_GPU_BUILD OUTPUT_STRIP_TRAILING_WHITESPACE
                ERROR_QUIET RESULT_VARIABLE describe_rc)
if(NOT describe_rc EQUAL 0 OR T6_GPU_BUILD STREQUAL "")
  set(T6_GPU_BUILD "unknown")
endif()
target_compile_definitions(app PRIVATE T6_GPU_BUILD="${T6_GPU_BUILD}")
message(STATUS "t6_gpu build: ${T6_GPU_BUILD}")

# The GPU QoS policy gpu_up applies after the PD_GPU power-on, chosen at build
# time; the record names the one that ran:
#   west build ... -- -DT6_GPU_QOS=reset      (the reset values)
#   west build ... -- -DT6_GPU_QOS=linux-zero (the default)
set(T6_GPU_QOS "linux-zero" CACHE STRING "GPU QoS policy: linux-zero or reset")
if(T6_GPU_QOS STREQUAL "reset")
  set(T6_GPU_QOS_ID 1)
elseif(T6_GPU_QOS STREQUAL "linux-zero")
  set(T6_GPU_QOS_ID 2)
else()
  message(FATAL_ERROR "T6_GPU_QOS must be reset or linux-zero, not '${T6_GPU_QOS}'")
endif()
target_compile_definitions(app PRIVATE T6_GPU_QOS_POLICY=${T6_GPU_QOS_ID})
message(STATUS "t6_gpu QoS policy: ${T6_GPU_QOS}")

# Z1's record, shared by the probes that run Z1's power-on.
target_sources(app PRIVATE src/main.c ../common/t6_z1.c)
target_include_directories(app PRIVATE ../common)

# Zero warnings in our C files: tools/check.sh builds this sample with
# -DYAKOGL_WERROR=ON (the "zephyr" rows); off by default.
if(YAKOGL_WERROR)
  target_compile_options(app PRIVATE -Werror)
endif()
```

## prj.conf
```kconfig
# SPDX-License-Identifier: Apache-2.0
# SPDX-FileCopyrightText: 2026 Signal Slot, Inc.
# The board defconfig has the console; the board glue (nanopc_t6.c) arms the
# watchdog. The five device_map()s of the sample (CRU, PMU, SPI2, the GPU QoS,
# the GPU) come on top of the glue's three; the arm64 MMU code k_panic()s when
# its translation tables run out, so this gives it twice the default 8.
CONFIG_PRINTK=y
CONFIG_EARLY_CONSOLE=y
CONFIG_MAX_XLAT_TABLES=16
```

## src/main.c
```c
/* SPDX-License-Identifier: Apache-2.0 */
/* SPDX-FileCopyrightText: 2026 Signal Slot, Inc. */
/*
 * t6_gpu: the second half of Z1 on the NanoPC-T6 (driver/docs/nanopc-t6-mali.md).
 * Before main() the board glue has armed WDT0 (nanopc_t6.c). This prints
 * the build, then yd_t6_gpu_up (board::nanopc_t6_gpu in the drivers crate)
 * reads what the kexec from Linux handed over -- PD_GPU in the PMU, the
 * GPU's clock in the CRU, vdd_gpu_s0 in the RK806 over SPI2, read only --
 * and this prints it before anything is written; then PD_GPU on, the GPU's
 * identity, a soft reset and the L2 on. The lines are Z1's record
 * (../common/t6_z1.c, which the later probes print on a Z1 stop). The last
 * line is PASS or FAIL with the step that stopped; the board then resets back
 * into Armbian.
 */
#include <zephyr/kernel.h>
#include <zephyr/sys/device_mmio.h>
#include <zephyr/sys/printk.h>
#include <zephyr/kernel/mm.h>

#include <stdbool.h>

#include <nanopc_t6.h>
#include <yakogl_drivers.h>

#include "t6_z1.h"

#define CRU_PHYS  0xfd7c0000UL
#define PMU_PHYS  0xfd8d8000UL
#define SPI2_PHYS 0xfeb20000UL
#define QOS_PHYS  0xfdf35000UL
#define GPU_PHYS  0xfb000000UL

static bool handed_over;

static void delay_us(uint32_t us)
{
	k_busy_wait(us);
}

static void on_handover(const struct yd_t6_gpu_up *h)
{
	t6_z1_print_handover("t6_gpu", h);
	handed_over = true;
	t6_watchdog_feed();
}

int main(void)
{
	mm_reg_t cru, pmu, spi2, qos, gpu;
	struct yd_t6_gpu_up o;
	int64_t t0;
	int rc;

	printk("t6_gpu: build %s\n", T6_GPU_BUILD);
	printk("t6_gpu: WDT0 period %u ms, fed until %u ms of uptime\n", t6_watchdog_period_ms(),
	       t6_watchdog_deadline_ms());
	device_map(&cru, CRU_PHYS, 0x1000, K_MEM_CACHE_NONE);
	device_map(&pmu, PMU_PHYS, 0x1000, K_MEM_CACHE_NONE);
	device_map(&spi2, SPI2_PHYS, 0x1000, K_MEM_CACHE_NONE);
	device_map(&qos, QOS_PHYS, 0x1000, K_MEM_CACHE_NONE);
	device_map(&gpu, GPU_PHYS, 0x1000, K_MEM_CACHE_NONE);
	t6_watchdog_feed();

	/* -DT6_GPU_QOS=reset|linux-zero at build time (CMakeLists.txt) */
	if (yd_t6_gpu_qos_policy(T6_GPU_QOS_POLICY) != 0) {
		printk("t6_gpu: FAIL: QoS policy %d unknown\n", T6_GPU_QOS_POLICY);
		t6_reset_to_linux("t6_gpu done");
	}

	t0 = k_uptime_get();
	rc = yd_t6_gpu_up(cru, pmu, spi2, qos, gpu, delay_us, on_handover, &o);
	t6_watchdog_feed();
	if (rc == -EINVAL) {
		printk("t6_gpu: FAIL: yd_t6_gpu_up refused its arguments\n");
		t6_reset_to_linux("t6_gpu done");
	}
	t6_z1_print_record("t6_gpu", &o, handed_over);
	if (o.stop == YD_T6_GPU_STOP_NONE) {
		printk("t6_gpu: PASS: GPU_ID 0x%08x, L2 ready, %lld ms\n", o.ident[0],
		       (long long)(k_uptime_get() - t0));
	} else {
		printk("t6_gpu: FAIL: stop %u (%s), refusal %u, detail 0x%08x%08x\n", o.stop,
		       t6_z1_stop_name(o.stop), o.refusal, o.detail[1], o.detail[0]);
	}
	t6_reset_to_linux("t6_gpu done");
}
```
