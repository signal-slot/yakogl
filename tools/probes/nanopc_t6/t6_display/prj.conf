## CMakeLists.txt
```
# SPDX-License-Identifier: Apache-2.0
# SPDX-FileCopyrightText: 2026 Signal Slot, Inc.
# t6_display: step D2 on the NanoPC-T6 (driver/docs/nanopc-t6-display.md,
# section 2 route (a)): after a crash kexec, adopt the display Linux left
# running, show a CPU-drawn pattern in Esmart0, hold the picture, print
# the section 5 read-backs, then the reset back into Armbian.
#
#   west build -p always -b nanopc_t6 -d build/t6_display yakogl/tools/probes/nanopc_t6/t6_display
#
# The picture's hold is a build option, 30 s by default
# (-DT6_PICTURE_HOLD_S=N, ../common/t6_picture.cmake); a longer hold needs
# the board's watchdog lifetime raised with it
# (-DCONFIG_YAKOGL_NANOPC_T6_LIFETIME_S).
cmake_minimum_required(VERSION 3.20.0)

# driver/ is a Zephyr module (the board, the board glue, the Rust crate).
get_filename_component(PVR_REPO "${CMAKE_CURRENT_SOURCE_DIR}/../../../../driver" ABSOLUTE)
list(APPEND ZEPHYR_EXTRA_MODULES "${PVR_REPO}")

find_package(Zephyr REQUIRED HINTS $ENV{ZEPHYR_BASE})
project(t6_display)

# The build prints its own commit first (a result row names its build).
execute_process(COMMAND git -C "${PVR_REPO}" describe --always --dirty
                OUTPUT_VARIABLE T6_DISPLAY_BUILD OUTPUT_STRIP_TRAILING_WHITESPACE
                ERROR_QUIET RESULT_VARIABLE describe_rc)
if(NOT describe_rc EQUAL 0 OR T6_DISPLAY_BUILD STREQUAL "")
  set(T6_DISPLAY_BUILD "unknown")
endif()
target_compile_definitions(app PRIVATE T6_DISPLAY_BUILD="${T6_DISPLAY_BUILD}")
message(STATUS "t6_display build: ${T6_DISPLAY_BUILD}")

# The picture, the hold (T6_PICTURE_HOLD_S) and the read-backs, shared
# with t6_cold.
target_sources(app PRIVATE src/main.c)
include(${CMAKE_CURRENT_SOURCE_DIR}/../common/t6_picture.cmake)

# Zero warnings in our C files: tools/check.sh builds this sample with
# -DYAKOGL_WERROR=ON (the "zephyr" rows); off by default.
if(YAKOGL_WERROR)
  target_compile_options(app PRIVATE -Werror)
endif()
```

## prj.conf
```kconfig
# SPDX-License-Identifier: Apache-2.0
# SPDX-FileCopyrightText: 2026 Signal Slot, Inc.
# The board defconfig has the console and CACHE_MANAGEMENT; the board glue
# arms the watchdog. The probe's seven device_map()s (VOP, vop_mmu, PMU, CRU,
# sys_grf, the PHY GRF, the HDMI controller) come on top of the glue's two
# (WDT0, the CRU: nanopc_t6.c) and the drivers' own (the console UART, the
# GIC); the arm64 MMU code k_panic()s when its translation tables run out,
# so this gives it twice the default 8 (t6_cold's prj.conf counts them).
# The 3 MiB frame buffer is in the image's .bss, not a device_map().
CONFIG_PRINTK=y
CONFIG_EARLY_CONSOLE=y
CONFIG_MAX_XLAT_TABLES=16
```

## src/main.c
```c
/* SPDX-License-Identifier: Apache-2.0 */
/* SPDX-FileCopyrightText: 2026 Signal Slot, Inc. */
/*
 * t6_display: step D2 on the NanoPC-T6 (driver/docs/nanopc-t6-display.md,
 * section 2 route (a), section 5). Started by a crash kexec, so Linux's
 * display chain still runs: VP0 scans 1024x768 or 1920x1080 at 60 Hz from
 * Cluster0 through the VOP's IOMMU. Before main() the board glue has armed
 * WDT0 (nanopc_t6.c). This draws the section 5 pattern into a buffer of this
 * image (red, green / blue, yellow quadrants, a white 1-pixel border),
 * cleans it to the point of coherency, then yd_t6_display_adopt
 * (board::nanopc_t6_display in the drivers crate): what Linux left is read
 * and checked, every window but Esmart0 turned off, the IOMMU's paging
 * turned off, Esmart0 made VP0's only layer on the buffer. It prints what
 * it found and did, holds the picture for T6_PICTURE_HOLD_S seconds with
 * the watchdog fed, prints the section 5 read-backs (yd_t6_display_status)
 * and PASS or FAIL, and resets back into Armbian. The pattern, the hold and
 * the read-backs are common/t6_picture.c's, shared with t6_cold (step D8).
 * Nothing here touches the GPU; the GIC has every SPI disabled by Zephyr's
 * init, so the VOP's and the HDMI controller's interrupt lines Linux left
 * enabled reach no CPU.
 */
#include <zephyr/kernel.h>
#include <zephyr/sys/printk.h>
#include <zephyr/sys/util.h>

#include <errno.h>

#include <nanopc_t6.h>
#include <yakogl_drivers.h>

#include "t6_picture.h"

int main(void)
{
	struct yd_t6_display_bases b;
	struct yd_t6_display_adopt a;
	struct yd_t6_display_status s;
	uint64_t fb_pa;
	int rc;

	printk("t6_display: build %s\n", T6_DISPLAY_BUILD);
	printk("t6_display: WDT0 period %u ms, fed until %u ms of uptime\n",
	       t6_watchdog_period_ms(), t6_watchdog_deadline_ms());

	fb_pa = t6_picture_prepare("t6_display");
	if (fb_pa == 0) {
		t6_reset_to_linux("t6_display done");
	}
	/* The adopt reads CLKGATE_CON(52) and (60) and the controller's CMU and
	 * video monitor words only: a page of each. */
	t6_picture_map(&b, 0x1000, 0x1000);
	t6_watchdog_feed();

	rc = yd_t6_display_adopt(&b, fb_pa, t6_delay_us, &a);
	t6_watchdog_feed();
	if (rc == -EINVAL) {
		printk("t6_display: FAIL: yd_t6_display_adopt refused its arguments\n");
		t6_reset_to_linux("t6_display done");
	}
	t6_display_print_adopt("t6_display", rc, &a);
	if (rc != 0) {
		printk("t6_display: FAIL: adopt stop %u\n", a.stop);
		t6_reset_to_linux("t6_display done");
	}

	t6_picture_hold("t6_display");
	rc = t6_display_read_back("t6_display", &b, &s);
	t6_picture_verdict("t6_display", rc, &s, a.fb);
	t6_reset_to_linux("t6_display done");
}
```
