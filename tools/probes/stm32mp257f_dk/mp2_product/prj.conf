## CMakeLists.txt
```
# SPDX-License-Identifier: Apache-2.0
# SPDX-FileCopyrightText: 2026 Signal Slot, Inc.
# mp2_product: the STM32MP257F-DK's product image shape for a standalone
# default (README.md): INIT of OP-TEE's watchdog, a PET every 5 s while a
# heartbeat advances, a line a minute, and the product watchdog marker. Its
# own lifetime (CONFIG_MP2_PRODUCT_LIFETIME_S, 120 s) brings a counted run
# back to Linux; 0 is the product's "runs indefinitely".
#
#   west build -p always -b stm32mp257f_dk/stm32mp257fxx/a35 -d build/mp2_product \
#     yakogl/tools/probes/stm32mp257f_dk/mp2_product
cmake_minimum_required(VERSION 3.20.0)

# driver/ is a Zephyr module (the SoC, the board, the board layer).
get_filename_component(PVR_REPO "${CMAKE_CURRENT_SOURCE_DIR}/../../../../driver" ABSOLUTE)
list(APPEND ZEPHYR_EXTRA_MODULES "${PVR_REPO}")

find_package(Zephyr REQUIRED HINTS $ENV{ZEPHYR_BASE})
project(mp2_product)

# The build prints its own commit first (a result row names its build).
execute_process(COMMAND git -C "${PVR_REPO}" describe --always --dirty
                OUTPUT_VARIABLE MP2_PRODUCT_BUILD OUTPUT_STRIP_TRAILING_WHITESPACE
                ERROR_QUIET RESULT_VARIABLE describe_rc)
if(NOT describe_rc EQUAL 0 OR MP2_PRODUCT_BUILD STREQUAL "")
  set(MP2_PRODUCT_BUILD "unknown")
endif()
target_compile_definitions(app PRIVATE MP2_PRODUCT_BUILD="${MP2_PRODUCT_BUILD}")
message(STATUS "mp2_product build: ${MP2_PRODUCT_BUILD}")

target_sources(app PRIVATE src/main.c)
# The refresh's C ABI is mp2_wdt's header (pinned against the Rust side by
# smc_wdt_refresh.rs's host test); one copy, read from there.
target_include_directories(app PRIVATE ${CMAKE_CURRENT_SOURCE_DIR}/../mp2_wdt/src)

# The refresh is the yakogl-drivers crate's soc::stm32mp2::smc_wdt_refresh,
# linked by driver/zephyr/CMakeLists.txt when the board layer's
# CONFIG_YAKOGL_STM32MP2_GPU is on (prj.conf), as for mp2_wdt. Without the
# Vivante driver nothing of the GPU's runs; the archive is only linked.
if(NOT CONFIG_YAKOGL_STM32MP2_GPU)
  message(FATAL_ERROR "mp2_product: CONFIG_YAKOGL_STM32MP2_GPU is off (the crate is not linked)")
endif()

# Zero warnings in our C files with -DYAKOGL_WERROR=ON; off by default.
if(YAKOGL_WERROR)
  target_compile_options(app PRIVATE -Werror)
endif()
```

## Kconfig
```
# SPDX-License-Identifier: Apache-2.0
# SPDX-FileCopyrightText: 2026 Signal Slot, Inc.

config MP2_PRODUCT_LIFETIME_S
	int "Seconds of uptime after which the image resets through PSCI (0: never)"
	default 120
	range 0 3599
	help
	  The image's own end: a PSCI SYSTEM_RESET at this uptime, so that a
	  counted standalone default (`default <image> N`) of it comes back
	  to Linux after N boots. 0 is a real product: no reset of its own,
	  it runs while the heartbeat holds. Only `forever` with
	  BOARD_PERSON_PRESENT=1 may carry such an image (README.md). It is
	  not the board layer's CONFIG_YAKOGL_STM32MP2_LIFETIME_S, which has
	  no off switch; a non-zero value must stay below that one (a build
	  assert).

config MP2_PRODUCT_PET_S
	int "Seconds between two PETs"
	default 5
	range 1 26
	help
	  Must stay under the timeout less OP-TEE's 5 s (a build assert).

config MP2_PRODUCT_HEARTBEAT_MS
	int "Period of the heartbeat timer (ms)"
	default 1000
	range 10 5000
	help
	  A k_timer advances the heartbeat counter at this period. The main
	  loop pets only when the counter moved since the previous PET, so
	  the period must be below MP2_PRODUCT_PET_S (a build assert).

source "Kconfig.zephyr"
```

## prj.conf
```kconfig
# SPDX-License-Identifier: Apache-2.0
# SPDX-FileCopyrightText: 2026 Signal Slot, Inc.
# The board defconfig has the console; the board layer (stm32mp2.c) prints
# the banner and the hand-over record. The layer's own watchdog
# (stm32mp2_wdog.c) stays off: this image is the watchdog's only client.
# The refresh is the yakogl-drivers crate's, linked by the board layer's
# YAKOGL_STM32MP2_GPU (feature stm32mp2; no GPU driver, no GPU access).
CONFIG_PRINTK=y
CONFIG_EARLY_CONSOLE=y
CONFIG_YAKOGL_STM32MP2_WDOG=n
CONFIG_YAKOGL_STM32MP2_GPU=y
# The image's own end is CONFIG_MP2_PRODUCT_LIFETIME_S (Kconfig, 120 s).
# The layer's lifetime cannot be switched off (range 5-3600): its maximum,
# so that it is only the backstop.
CONFIG_YAKOGL_STM32MP2_LIFETIME_S=3600
```

## src/main.c
```c
/* SPDX-License-Identifier: Apache-2.0 */
/* SPDX-FileCopyrightText: 2026 Signal Slot, Inc. */
/*
 * mp2_product: the shape of a product image for the STM32MP257F-DK's
 * standalone default (README.md; docs/notes/stm32mp257f-dk-standalone.md
 * section 6). Before main() the board layer has printed the early banner
 * and the hand-over record (stm32mp2.c); this image does not have the
 * layer's own watchdog (CONFIG_YAKOGL_STM32MP2_WDOG off).
 *
 * It prints its banner, calls INIT (then SET_TIMEOUT 32, ENABLE 1, PET)
 * through driver/rust/src/soc/stm32mp2/smc_wdt_refresh.rs (mp2_wdtr.h) and
 * resets through PSCI if that is refused. Then the main loop pets every
 * CONFIG_MP2_PRODUCT_PET_S, but only while the heartbeat (a counter a
 * k_timer advances every CONFIG_MP2_PRODUCT_HEARTBEAT_MS) moved since the
 * previous PET: a stalled timer or a stuck main loop stops the petting, and
 * OP-TEE and the IWDG reset the board about 32 s after the last PET. One
 * line a minute says it is alive.
 *
 * CONFIG_MP2_PRODUCT_LIFETIME_S (120 s by default) is the image's own PSCI
 * SYSTEM_RESET, so a counted default of it comes back to Linux. 0 (a real
 * product) means none: only `forever` with BOARD_PERSON_PRESENT=1 may carry
 * that build. The layer's lifetime (CONFIG_YAKOGL_STM32MP2_LIFETIME_S,
 * 3600 s in prj.conf) has no off switch and stays the backstop.
 */
#include <zephyr/kernel.h>
#include <zephyr/devicetree.h>
#include <zephyr/sys/atomic.h>
#include <zephyr/sys/printk.h>

#include <stm32mp2.h>

#include "mp2_wdtr.h"

/* The product watchdog marker: the runner's `default <image> forever`
 * refuses an image without these bytes (tools/mp2s_image_check.py
 * --require-marker). It is printed once INIT succeeded. */
#define MP2_PRODUCT_WDT_MARKER "mp2_wdtr: product refresh armed"

#define TIMEOUT_S    32u /* the DK's timeout-sec, the one Linux uses */
#define PET_S        CONFIG_MP2_PRODUCT_PET_S
#define HEARTBEAT_MS CONFIG_MP2_PRODUCT_HEARTBEAT_MS
#define LIFETIME_S   CONFIG_MP2_PRODUCT_LIFETIME_S
#define LINE_S       60

BUILD_ASSERT(!IS_ENABLED(CONFIG_YAKOGL_STM32MP2_WDOG),
	     "one client of the watchdog: the layer's stm32mp2_wdog.c is off in this image");
BUILD_ASSERT(PET_S + MP2_WDTR_EARLY_S < TIMEOUT_S,
	     "each pet comes before OP-TEE's early interrupt");
BUILD_ASSERT(HEARTBEAT_MS < PET_S * MSEC_PER_SEC,
	     "the heartbeat advances at least once between two pets");
BUILD_ASSERT(LIFETIME_S == 0 || LIFETIME_S < CONFIG_YAKOGL_STM32MP2_LIFETIME_S,
	     "the image's own lifetime comes before the layer's");

static atomic_t s_heartbeat;
static int64_t s_start_ms;

static void heartbeat(struct k_timer *t)
{
	ARG_UNUSED(t);
	atomic_inc(&s_heartbeat);
}
static K_TIMER_DEFINE(s_heartbeat_timer, heartbeat, NULL);

static void lifetime_over(struct k_timer *t)
{
	ARG_UNUSED(t);
	mp2_reset_to_linux("mp2_product lifetime over");
}
static K_TIMER_DEFINE(s_lifetime, lifetime_over, NULL);

static long long t_s(void)
{
	return (long long)((k_uptime_get() - s_start_ms) / MSEC_PER_SEC);
}

int main(void)
{
	struct yd_mp2_wdtr r;
	atomic_val_t last;
	long long next_line = LINE_S;
	unsigned int pets = 0;
	int rc;

	printk("mp2_product: build %s\n", MP2_PRODUCT_BUILD);
	printk("mp2_product: %s, console usart2 at %u baud, image at 0x%lx, timer %u Hz\n",
	       CONFIG_BOARD, (unsigned int)DT_PROP(DT_CHOSEN(zephyr_console), current_speed),
	       (unsigned long)CONFIG_SRAM_BASE_ADDRESS,
	       (unsigned int)sys_clock_hw_cycles_per_sec());
	if (LIFETIME_S != 0) {
		/* Uptime from boot, as the layer's own lifetime. */
		k_timer_start(&s_lifetime, K_MSEC(MAX(LIFETIME_S * MSEC_PER_SEC - k_uptime_get(), 0)),
			      K_NO_WAIT);
		printk("mp2_product: PSCI version 0x%x, lifetime %u s (PSCI SYSTEM_RESET), "
		       "layer's at %u ms\n",
		       (unsigned int)mp2_psci_version(), LIFETIME_S, mp2_lifetime_ms());
	} else {
		printk("mp2_product: PSCI version 0x%x, no lifetime of its own (product build), "
		       "layer's at %u ms\n",
		       (unsigned int)mp2_psci_version(), mp2_lifetime_ms());
	}
	printk("mp2_product: fid 0x%08x, timeout %u s, PET every %u s while the heartbeat "
	       "(%u ms) advances\n",
	       MP2_WDTR_FUNC_ID_DK, TIMEOUT_S, PET_S, HEARTBEAT_MS);

	s_start_ms = k_uptime_get();
	rc = yd_mp2_wdtr_init(MP2_WDTR_FUNC_ID_DK, TIMEOUT_S, &r);
	if (rc != 0) {
		printk("mp2_product: FAIL: init rc %d, command %u answered %d, bounds %llu..%llu s\n",
		       rc, (unsigned int)r.cmd, (int)r.code, (unsigned long long)r.min_s,
		       (unsigned long long)r.max_s);
		mp2_reset_to_linux("mp2_product init refused");
	}
	printk("%s: bounds %llu..%llu s, timeout %u s\n", MP2_PRODUCT_WDT_MARKER,
	       (unsigned long long)r.min_s, (unsigned long long)r.max_s, TIMEOUT_S);

	last = atomic_get(&s_heartbeat);
	k_timer_start(&s_heartbeat_timer, K_MSEC(HEARTBEAT_MS), K_MSEC(HEARTBEAT_MS));

	for (;;) {
		atomic_val_t now;

		k_sleep(K_SECONDS(PET_S));
		now = atomic_get(&s_heartbeat);
		if (now == last) {
			/* Unhealthy: no PET; OP-TEE panics and the IWDG resets
			 * about TIMEOUT_S after the last one. */
			printk("mp2_product: heartbeat stalled at %ld t=%lld, not petting\n",
			       (long)now, t_s());
			continue;
		}
		last = now;
		rc = yd_mp2_wdtr_pet(&r);
		if (rc != 0) {
			printk("mp2_product: pet t=%lld refused: rc %d code %d\n", t_s(), rc,
			       (int)r.code);
			continue;
		}
		pets++;
		if (t_s() >= next_line) {
			rc = yd_mp2_wdtr_time_left(&r);
			if (rc == 0) {
				printk("mp2_product: alive t=%lld heartbeat=%ld pets=%u left=%llu\n",
				       t_s(), (long)now, pets, (unsigned long long)r.left_s);
			} else {
				printk("mp2_product: alive t=%lld heartbeat=%ld pets=%u left=? "
				       "(rc %d code %d)\n",
				       t_s(), (long)now, pets, rc, (int)r.code);
			}
			next_line += LINE_S;
		}
	}
}
```
