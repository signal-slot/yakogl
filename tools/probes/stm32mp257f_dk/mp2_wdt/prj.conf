## CMakeLists.txt
```
# SPDX-License-Identifier: Apache-2.0
# SPDX-FileCopyrightText: 2026 Signal Slot, Inc.
# mp2_wdt: the opt-in OP-TEE watchdog refresh on the STM32MP257F-DK's A35,
# bounded (README.md): INIT, a PET every few seconds for REFRESH_S, then no
# more, so the IWDG resets the board back into ST's Linux.
#
#   west build -p always -b stm32mp257f_dk/stm32mp257fxx/a35 -d build/mp2_wdt \
#     yakogl/tools/probes/stm32mp257f_dk/mp2_wdt
cmake_minimum_required(VERSION 3.20.0)

# driver/ is a Zephyr module (the SoC, the board, the board layer).
get_filename_component(PVR_REPO "${CMAKE_CURRENT_SOURCE_DIR}/../../../../driver" ABSOLUTE)
list(APPEND ZEPHYR_EXTRA_MODULES "${PVR_REPO}")

find_package(Zephyr REQUIRED HINTS $ENV{ZEPHYR_BASE})
project(mp2_wdt)

# The build prints its own commit first (a result row names its build).
execute_process(COMMAND git -C "${PVR_REPO}" describe --always --dirty
                OUTPUT_VARIABLE MP2_WDT_BUILD OUTPUT_STRIP_TRAILING_WHITESPACE
                ERROR_QUIET RESULT_VARIABLE describe_rc)
if(NOT describe_rc EQUAL 0 OR MP2_WDT_BUILD STREQUAL "")
  set(MP2_WDT_BUILD "unknown")
endif()
target_compile_definitions(app PRIVATE MP2_WDT_BUILD="${MP2_WDT_BUILD}")
message(STATUS "mp2_wdt build: ${MP2_WDT_BUILD}")

target_sources(app PRIVATE src/main.c)

# The refresh is the yakogl-drivers crate's soc::stm32mp2::smc_wdt_refresh
# (src/mp2_wdtr.h): the crate is built with the feature stm32mp2 and linked
# by driver/zephyr/CMakeLists.txt when the board layer's
# CONFIG_YAKOGL_STM32MP2_GPU is on (prj.conf), as for mp2_gpu. Without the
# Vivante driver nothing of the GPU's runs; the archive is only linked.
if(NOT CONFIG_YAKOGL_STM32MP2_GPU)
  message(FATAL_ERROR "mp2_wdt: CONFIG_YAKOGL_STM32MP2_GPU is off (the crate is not linked)")
endif()

# Zero warnings in our C files with -DYAKOGL_WERROR=ON; off by default.
if(YAKOGL_WERROR)
  target_compile_options(app PRIVATE -Werror)
endif()
```

## Kconfig
```
# SPDX-License-Identifier: Apache-2.0
# SPDX-FileCopyrightText: 2026 Signal Slot, Inc.

config MP2_WDT_TIMEOUT_S
	int "Watchdog timeout sent with SET_TIMEOUT (seconds)"
	default 32
	range 6 131
	help
	  32 is the DK's timeout-sec, the one Linux uses. OP-TEE's early
	  interrupt comes 5 s before it and needs 1 s more, hence 6 at the
	  least; 131 is INIT's maximum with the LSI at 32 kHz.

config MP2_WDT_PET_S
	int "Seconds between two PETs"
	default 5
	range 1 60
	help
	  Must stay under the timeout less OP-TEE's 5 s (a build assert).

config MP2_WDT_REFRESH_S
	int "Seconds of petting, then no more"
	default 60
	range 1 600
	help
	  A whole number of PET periods. After it the image stops petting
	  and the IWDG resets the board about MP2_WDT_TIMEOUT_S later. The
	  layer's lifetime (CONFIG_YAKOGL_STM32MP2_LIFETIME_S, prj.conf) must
	  exceed REFRESH_S + TIMEOUT_S + 30 (a build assert).

source "Kconfig.zephyr"
```

## prj.conf
```kconfig
# SPDX-License-Identifier: Apache-2.0
# SPDX-FileCopyrightText: 2026 Signal Slot, Inc.
# The board defconfig has the console; the board layer (stm32mp2.c) prints
# the banner and the hand-over record. The layer's own watchdog
# (stm32mp2_wdog.c) stays off: this image is the watchdog's only client.
# The refresh is the yakogl-drivers crate's, linked by the board layer's
# YAKOGL_STM32MP2_GPU (feature stm32mp2; no GPU driver, no GPU access).
CONFIG_PRINTK=y
CONFIG_EARLY_CONSOLE=y
CONFIG_YAKOGL_STM32MP2_WDOG=n
CONFIG_YAKOGL_STM32MP2_GPU=y
# The layer's PSCI reset only if the watchdog did not fire: 60 s of
# petting, 32 s to the IWDG's reset, then a margin.
CONFIG_YAKOGL_STM32MP2_LIFETIME_S=150
```

## src/main.c
```c
/* SPDX-License-Identifier: Apache-2.0 */
/* SPDX-FileCopyrightText: 2026 Signal Slot, Inc. */
/*
 * mp2_wdt: the bounded proof of the opt-in OP-TEE watchdog refresh on the
 * STM32MP257F-DK's A35 (README.md; driver/rust/src/soc/stm32mp2/
 * smc_wdt_refresh.rs through mp2_wdtr.h). Before main() the board layer has
 * printed the early banner and the hand-over record (stm32mp2.c); this image
 * does not have the layer's own watchdog (CONFIG_YAKOGL_STM32MP2_WDOG off).
 *
 * It prints its banner, calls INIT (then SET_TIMEOUT, ENABLE 1, PET), pets
 * every CONFIG_MP2_WDT_PET_S for CONFIG_MP2_WDT_REFRESH_S, printing the
 * time left after each pet, then stops petting: a loop with a fixed count,
 * so the petting ends by construction. From there it only reads the time
 * left; OP-TEE panics and the IWDG resets the board about
 * CONFIG_MP2_WDT_TIMEOUT_S after the last pet. The layer's lifetime
 * (PSCI SYSTEM_RESET) is later still and catches a watchdog that does not
 * fire: no step strands the board.
 */
#include <zephyr/kernel.h>
#include <zephyr/devicetree.h>
#include <zephyr/sys/printk.h>

#include <stm32mp2.h>

#include "mp2_wdtr.h"

#define TIMEOUT_S CONFIG_MP2_WDT_TIMEOUT_S
#define PET_S     CONFIG_MP2_WDT_PET_S
#define REFRESH_S CONFIG_MP2_WDT_REFRESH_S
#define PETS      (REFRESH_S / PET_S)

BUILD_ASSERT(!IS_ENABLED(CONFIG_YAKOGL_STM32MP2_WDOG),
	     "one client of the watchdog: the layer's stm32mp2_wdog.c is off in this image");
BUILD_ASSERT(TIMEOUT_S >= MP2_WDTR_MIN_TIMEOUT_S, "OP-TEE's early interrupt needs 6 s or more");
BUILD_ASSERT(PET_S + MP2_WDTR_EARLY_S < TIMEOUT_S,
	     "each pet comes before OP-TEE's early interrupt");
BUILD_ASSERT(PETS >= 1 && REFRESH_S % PET_S == 0, "REFRESH_S is a whole number of pets");
BUILD_ASSERT(REFRESH_S + TIMEOUT_S + 30 <= CONFIG_YAKOGL_STM32MP2_LIFETIME_S,
	     "the layer's lifetime reset comes well after the watchdog's");

static int64_t s_start_ms;

static long long t_s(void)
{
	return (long long)((k_uptime_get() - s_start_ms) / MSEC_PER_SEC);
}

/* "left=<s>", or why GET_TIMELEFT gave none. */
static void print_left(const char *what)
{
	struct yd_mp2_wdtr r;
	int rc = yd_mp2_wdtr_time_left(&r);

	if (rc == 0) {
		printk("mp2_wdt: %s t=%lld left=%llu\n", what, t_s(), (unsigned long long)r.left_s);
	} else {
		printk("mp2_wdt: %s t=%lld left=? (rc %d code %d)\n", what, t_s(), rc, (int)r.code);
	}
}

int main(void)
{
	struct yd_mp2_wdtr r;
	int rc;
	int i;

	printk("mp2_wdt: build %s\n", MP2_WDT_BUILD);
	printk("mp2_wdt: %s, console usart2 at %u baud, image at 0x%lx, timer %u Hz\n", CONFIG_BOARD,
	       (unsigned int)DT_PROP(DT_CHOSEN(zephyr_console), current_speed),
	       (unsigned long)CONFIG_SRAM_BASE_ADDRESS, (unsigned int)sys_clock_hw_cycles_per_sec());
	printk("mp2_wdt: PSCI version 0x%x, reset at %u ms of uptime at the latest\n",
	       (unsigned int)mp2_psci_version(), mp2_lifetime_ms());
	printk("mp2_wdt: fid 0x%08x, timeout %u s, PET every %u s for %u s, then stop petting\n",
	       MP2_WDTR_FUNC_ID_DK, TIMEOUT_S, PET_S, REFRESH_S);

	s_start_ms = k_uptime_get();
	rc = yd_mp2_wdtr_init(MP2_WDTR_FUNC_ID_DK, TIMEOUT_S, &r);
	if (rc != 0) {
		printk("mp2_wdt: FAIL: init rc %d, command %u answered %d, bounds %llu..%llu s\n", rc,
		       (unsigned int)r.cmd, (int)r.code, (unsigned long long)r.min_s,
		       (unsigned long long)r.max_s);
		mp2_reset_to_linux("mp2_wdt init refused");
	}
	printk("mp2_wdt: init ok: bounds %llu..%llu s, timeout %u s\n", (unsigned long long)r.min_s,
	       (unsigned long long)r.max_s, TIMEOUT_S);
	print_left("init");

	for (i = 1; i <= PETS; i++) {
		k_sleep(K_SECONDS(PET_S));
		rc = yd_mp2_wdtr_pet(&r);
		if (rc != 0) {
			printk("mp2_wdt: pet t=%lld refused: rc %d code %d\n", t_s(), rc, (int)r.code);
			break;
		}
		print_left("pet");
	}

	printk("mp2_wdt: stopped petting at t=%lld after %d pets: OP-TEE panics in about %u s, "
	       "the IWDG resets in about %u s\n",
	       t_s(), i - 1, TIMEOUT_S - MP2_WDTR_EARLY_S, TIMEOUT_S);
	for (;;) {
		k_sleep(K_SECONDS(PET_S));
		print_left("unpetted");
	}
}
```

## src/mp2_wdtr.h
```c
/* SPDX-License-Identifier: Apache-2.0 */
/* SPDX-FileCopyrightText: 2026 Signal Slot, Inc. */
/*
 * mp2_wdtr.h -- the C ABI of driver/rust/src/soc/stm32mp2/smc_wdt_refresh.rs
 * (yakogl-drivers, feature stm32mp2, aarch64): the opt-in refresh of
 * OP-TEE's arm,smc-wdt. Its host test abi_probe_header_has_the_same_numbers
 * pins the numbers below.
 *
 * yd_mp2_wdtr_init: INIT, then SET_TIMEOUT timeout_s, ENABLE 1, PET,
 * stopping at the first refusal. 0; -EIO when the firmware refused (the
 * command and its code in *out); -EINVAL for a timeout under
 * MP2_WDTR_MIN_TIMEOUT_S or func_id 0 (no call made), or a timeout outside
 * INIT's bounds (only INIT sent; the bounds in *out).
 * yd_mp2_wdtr_pet: PET; yd_mp2_wdtr_time_left: GET_TIMELEFT, the seconds in
 * out->left_s (-EIO with code -8 while the watchdog is stopped). Both are
 * -ENODEV with no call made before a successful init.
 * There is no ENABLE 0: OP-TEE's stop makes a hang never reset. out may be
 * NULL.
 */
#ifndef MP2_WDTR_H
#define MP2_WDTR_H

#include <stddef.h>
#include <stdint.h>

/* The DK's arm,smc-id (stm32mp251.dtsi:78-82). */
#define MP2_WDTR_FUNC_ID_DK 0xbc000000u
/* OP-TEE's early interrupt (5 s before the timeout) needs 1 s more. */
#define MP2_WDTR_MIN_TIMEOUT_S 6u
/* OP-TEE panics this long before the timeout when nothing pets. */
#define MP2_WDTR_EARLY_S 5u
#define YD_MP2_WDTR_NO_CMD 0xffffffffu /* cmd when no call was made */

struct yd_mp2_wdtr {
	uint64_t min_s;  /* INIT's bounds (init) */
	uint64_t max_s;
	uint64_t left_s; /* GET_TIMELEFT's seconds (time_left) */
	uint32_t cmd;    /* the last command sent (on -EIO the refusing one) */
	int32_t code;    /* its code: 0 or the firmware's refusal */
};

_Static_assert(sizeof(struct yd_mp2_wdtr) == 32, "smc_wdt_refresh.rs YdMp2Wdtr");
_Static_assert(offsetof(struct yd_mp2_wdtr, left_s) == 16, "smc_wdt_refresh.rs YdMp2Wdtr");
_Static_assert(offsetof(struct yd_mp2_wdtr, cmd) == 24, "smc_wdt_refresh.rs YdMp2Wdtr");
_Static_assert(offsetof(struct yd_mp2_wdtr, code) == 28, "smc_wdt_refresh.rs YdMp2Wdtr");

int yd_mp2_wdtr_init(uint32_t func_id, uint32_t timeout_s, struct yd_mp2_wdtr *out);
int yd_mp2_wdtr_pet(struct yd_mp2_wdtr *out);
int yd_mp2_wdtr_time_left(struct yd_mp2_wdtr *out);

#endif /* MP2_WDTR_H */
```
