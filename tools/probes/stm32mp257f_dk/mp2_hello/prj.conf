## CMakeLists.txt
```
# SPDX-License-Identifier: Apache-2.0
# SPDX-FileCopyrightText: 2026 Signal Slot, Inc.
# mp2_hello: the first image on the STM32MP257F-DK's A35 (README.md): the
# early banner, the hand-over record, a few seconds on the system timer,
# then PSCI SYSTEM_RESET back into ST's Linux.
#
#   west build -p always -b stm32mp257f_dk/stm32mp257fxx/a35 -d build/mp2_hello \
#     yakogl/tools/probes/stm32mp257f_dk/mp2_hello
cmake_minimum_required(VERSION 3.20.0)

# driver/ is a Zephyr module (the SoC, the board, the board layer).
get_filename_component(PVR_REPO "${CMAKE_CURRENT_SOURCE_DIR}/../../../../driver" ABSOLUTE)
list(APPEND ZEPHYR_EXTRA_MODULES "${PVR_REPO}")

find_package(Zephyr REQUIRED HINTS $ENV{ZEPHYR_BASE})
project(mp2_hello)

# The build prints its own commit first (a result row names its build).
execute_process(COMMAND git -C "${PVR_REPO}" describe --always --dirty
                OUTPUT_VARIABLE MP2_HELLO_BUILD OUTPUT_STRIP_TRAILING_WHITESPACE
                ERROR_QUIET RESULT_VARIABLE describe_rc)
if(NOT describe_rc EQUAL 0 OR MP2_HELLO_BUILD STREQUAL "")
  set(MP2_HELLO_BUILD "unknown")
endif()
target_compile_definitions(app PRIVATE MP2_HELLO_BUILD="${MP2_HELLO_BUILD}")
message(STATUS "mp2_hello build: ${MP2_HELLO_BUILD}")

target_sources(app PRIVATE src/main.c)

# Zero warnings in our C files with -DYAKOGL_WERROR=ON; off by default.
if(YAKOGL_WERROR)
  target_compile_options(app PRIVATE -Werror)
endif()
```

## Kconfig
```
# SPDX-License-Identifier: Apache-2.0
# SPDX-FileCopyrightText: 2026 Signal Slot, Inc.

config MP2_HELLO_HANG
	bool "Hang on purpose with interrupts locked (the watchdog trial)"
	help
	  Instead of counting five seconds and resetting through PSCI, print
	  the hang line and spin with interrupts locked. Neither the layer's
	  lifetime timer nor a PSCI reset can fire: only OP-TEE's SMC
	  watchdog (BL2 arms the IWDG, about 32 s) brings the board back.
	  Off by default; run it with tools/board-stm32mp2.sh run
	  --expect-watchdog.

source "Kconfig.zephyr"
```

## prj.conf
```kconfig
# SPDX-License-Identifier: Apache-2.0
# SPDX-FileCopyrightText: 2026 Signal Slot, Inc.
# The board defconfig has the console; the board layer (stm32mp2.c) prints
# the banner and the hand-over record and resets through PSCI at the end.
CONFIG_PRINTK=y
CONFIG_EARLY_CONSOLE=y
```

## src/main.c
```c
/* SPDX-License-Identifier: Apache-2.0 */
/* SPDX-FileCopyrightText: 2026 Signal Slot, Inc. */
/*
 * mp2_hello: the first image on the STM32MP257F-DK's A35 (README.md).
 * Before main() the board layer has printed the early banner and the
 * hand-over record (stm32mp2.c). This prints the build, counts
 * MP2_HELLO_SECONDS on the system timer (each second a k_sleep: the arch
 * timer's interrupt through the GIC-400) and resets the board back into
 * ST's Linux through PSCI. With CONFIG_MP2_HELLO_HANG it prints one line
 * and spins with interrupts locked instead (the OP-TEE watchdog must reset).
 */
#include <zephyr/kernel.h>
#include <zephyr/devicetree.h>
#include <zephyr/sys/printk.h>

#include <stm32mp2.h>

#define MP2_HELLO_SECONDS 5

BUILD_ASSERT(MP2_HELLO_SECONDS + 5 < CONFIG_YAKOGL_STM32MP2_LIFETIME_S,
	     "the run ends well inside the layer's lifetime");

int main(void)
{
	int64_t start = k_uptime_get();

	printk("mp2_hello: build %s\n", MP2_HELLO_BUILD);
	printk("mp2_hello: %s, console usart2 at %u baud, image at 0x%lx, timer %u Hz\n",
	       CONFIG_BOARD, (unsigned int)DT_PROP(DT_CHOSEN(zephyr_console), current_speed),
	       (unsigned long)CONFIG_SRAM_BASE_ADDRESS, (unsigned int)sys_clock_hw_cycles_per_sec());
	printk("mp2_hello: PSCI version 0x%x, reset at %u ms of uptime at the latest\n",
	       (unsigned int)mp2_psci_version(), mp2_lifetime_ms());
#ifdef CONFIG_MP2_HELLO_HANG
	printk("mp2_hello: hanging on purpose with interrupts locked, the OP-TEE watchdog must reset\n");
	(void)irq_lock();
	for (;;) {
		/* no timer tick, no lifetime reset, no PSCI: the watchdog alone */
		__asm__ volatile("" ::: "memory");
	}
#endif
	for (int i = 1; i <= MP2_HELLO_SECONDS; i++) {
		k_sleep(K_SECONDS(1));
		printk("mp2_hello: %d s (uptime %lld ms)\n", i, (long long)k_uptime_get());
	}
	printk("mp2_hello: PASS: counted %d s in %lld ms\n", MP2_HELLO_SECONDS,
	       (long long)(k_uptime_get() - start));
	mp2_reset_to_linux("mp2_hello done");
}
```
