/* SPDX-License-Identifier: Apache-2.0 */
/* SPDX-FileCopyrightText: 2026 Signal Slot, Inc. */
/*
 * The board's sram0 is 512 KiB at 0x200000 (dts/arm64/broadcom/bcm2711.dtsi).
 * An image carries the V3D's 48 MiB carve-out, the compiler's 2 MiB
 * scratch and the 1024x608 window (2.4 MiB) as statics, and the Slint
 * example its 48 MiB UI heap too. One size serves every example: 144 MiB
 * from 0x200000 (the Slint example's need, 93% used). DRAM starts at 0 on
 * the Pi 4 and the firmware keeps its own memory at the top of the first
 * GiB (the framebuffer is at 0x3c100000), so this is ARM memory on every
 * Pi 4.
 */
#include "../../../../samples/zephyr/common/rpi_4b_sram.dtsi"

&sram0 {
	reg = <0x200000 0x9000000>;
};
