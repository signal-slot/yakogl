/*
 * SPDX-License-Identifier: Apache-2.0
 * SPDX-FileCopyrightText: 2026 Signal Slot, Inc.
 *
 * Pins the A53 image uses on the Armadillo-X2. UART2 is the board's console
 * (ttymxc1 under Armadillo Base OS). The pads and their mux match what the
 * X2's own Linux devicetree sets (uart2grp: UART2_RXD/UART2_TXD, mode 0, pad
 * control 0x49), read from the board on 2026-09-23.
 */

#include <nxp/nxp_imx/mimx8ml8dvnlz-pinctrl.dtsi>

&pinctrl {
	uart2_default: uart2_default {
		group0 {
			pinmux = <&iomuxc_uart2_rxd_uart_rx_uart2_rx>,
				 <&iomuxc_uart2_txd_uart_tx_uart2_tx>;
			bias-pull-up;
			slew-rate = "slow";
			drive-strength = "x1";
		};
	};
};
