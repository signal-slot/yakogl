## driver/boards/atmark/armadillo_x2/Kconfig.armadillo_x2
```kconfig
# SPDX-License-Identifier: Apache-2.0
# SPDX-FileCopyrightText: 2026 Signal Slot, Inc.

config BOARD_ARMADILLO_X2
	select SOC_MIMX8ML8_A53 if BOARD_ARMADILLO_X2_MIMX8ML8_A53 || \
			     BOARD_ARMADILLO_X2_MIMX8ML8_A53_DIRECT
	select SOC_PART_NUMBER_MIMX8ML8DVNLZ
```

## driver/boards/friendlyarm/nanopc_t6/Kconfig.nanopc_t6
```kconfig
# SPDX-License-Identifier: Apache-2.0
# SPDX-FileCopyrightText: 2026 Signal Slot, Inc.

config BOARD_NANOPC_T6
	select SOC_RK3588
```

## driver/boards/st/stm32mp257f_dk/Kconfig.stm32mp257f_dk
```kconfig
# SPDX-License-Identifier: Apache-2.0
# SPDX-FileCopyrightText: 2026 Signal Slot, Inc.

config BOARD_STM32MP257F_DK
	select SOC_STM32MP257FXX_A35 if BOARD_STM32MP257F_DK_STM32MP257FXX_A35
```

## driver/boards/toradex/verdin_am62p/Kconfig.verdin_am62p
```kconfig
# SPDX-License-Identifier: Apache-2.0
# SPDX-FileCopyrightText: 2026 Signal Slot, Inc.

config BOARD_VERDIN_AM62P
	select SOC_AM62P54_A53 if BOARD_VERDIN_AM62P_AM62P54_A53 || \
			   BOARD_VERDIN_AM62P_AM62P54_A53_DIRECT
```

## driver/boards/toradex/verdin_am62p/verdin_am62p_am62p54_a53_defconfig
```kconfig
# SPDX-License-Identifier: Apache-2.0
# SPDX-FileCopyrightText: 2026 Signal Slot, Inc.
CONFIG_XIP=n
CONFIG_SERIAL=y
CONFIG_CONSOLE=y
CONFIG_UART_CONSOLE=y
CONFIG_UART_INTERRUPT_DRIVEN=y

# ARM Options
CONFIG_AARCH64_IMAGE_HEADER=y
CONFIG_ARMV8_A_NS=y
CONFIG_ARM64_VA_BITS_36=y
CONFIG_ARM64_PA_BITS_36=y

# Cache Options
CONFIG_CACHE_MANAGEMENT=y
CONFIG_DCACHE_LINE_SIZE_DETECT=y
CONFIG_ICACHE_LINE_SIZE_DETECT=y

# Multicore
CONFIG_SMP=y
CONFIG_PM_CPU_OPS=y
CONFIG_MP_MAX_NUM_CPUS=4
```

## driver/dts/bindings/cpu/arm,cortex-a35.yaml
```yaml
# SPDX-License-Identifier: Apache-2.0
# SPDX-FileCopyrightText: 2026 Signal Slot, Inc.

description: |
  ARM Cortex-A35 CPU (the STM32MP257F's application cores). Zephyr carries
  bindings for the Cortex-A53/A55/A72/... (dts/bindings/cpu/) but none for
  the A35; without one the cpu nodes get no device_type and Zephyr counts
  no CPU (include/zephyr/devicetree/cpu.h, DT_FOREACH_CPU_STATUS_OKAY_SEP).

compatible: "arm,cortex-a35"

include: cpu.yaml
```

## driver/dts/bindings/display/yakogl,adv7535.yaml
```yaml
# SPDX-License-Identifier: Apache-2.0
# SPDX-FileCopyrightText: 2026 Signal Slot, Inc.

description: |
  Analog Devices ADV7535 MIPI DSI to HDMI bridge on I2C (the STM32MP257F-DK's
  HDMI output; the node stm32mp257f-dk.dts:428-469, a child of the &i2c2 bus
  at :395, ST's compatible "adi,adv7535" at :429). The register logic is
  driver/rust/src/ip/adv7535.rs, from Linux's drivers/gpu/drm/bridge/adv7511/
  (adv7511_drv.c, adv7533.c) in its ADV7533 mode, which the ADV7535 shares.

  The main register map sits at `reg`; the secondary maps (EDID, CEC/DSI,
  packet memory) are separate I2C addresses the driver programs into the
  chip at init, named as in Linux's adi,adv7533 binding (reg-names "edid",
  "cec", "packet", adi,adv7533.yaml:35-44; the DK states all four, reg and
  reg-names at stm32mp257f-dk.dts:430-431).

compatible: "yakogl,adv7535"

include: [i2c-device.yaml]

properties:
  reg:
    required: true
    description: |
      The main map; 0x3d on the DK (stm32mp257f-dk.dts:430, reg-names "main"
      at :431). 0x39 or 0x3d by the strapping (the bindings' own examples sit
      at hdmi@39, adi,adv7533.yaml:135).

  edid-reg:
    type: int
    default: 0x3f
    description: |
      I2C address of the EDID map (Linux "edid" reg, adi,adv7533.yaml:42;
      0x3f on the DK, stm32mp257f-dk.dts:430). The chip's EDID_I2C_ADDR
      register 0x43 holds it shifted left, reset 0x7e (adv7511.h:56, the
      reset table's byte at adv7511_drv.c:51, the driver's default 0x3f at
      adv7511.h:99).

  cec-reg:
    type: int
    default: 0x3c
    description: |
      I2C address of the CEC / DSI map (Linux "cec" reg; 0x3c on the DK,
      stm32mp257f-dk.dts:430; in ADV7533 mode it holds the MIPI DSI receiver
      registers, which adv7533.c writes through regmap_cec, adv7533.c:42).
      CEC_I2C_ADDR register 0xe1, reset 0x78 (adv7511.h:92, default 0x3c at
      adv7511.h:98).

  packet-reg:
    type: int
    default: 0x38
    description: |
      I2C address of the packet memory map (Linux "packet" reg; 0x38 on the
      DK, stm32mp257f-dk.dts:430). PACKET_I2C_ADDR register 0x45, reset 0x70
      (adv7511.h:58, default 0x38 at adv7511.h:100).

  hpd-gpios:
    type: phandle-array
    description: |
      A hot-plug detect line, if wired; the DK has none (the hdmi-connector
      node, stm32mp257f-dk.dts:129-140, carries no HPD gpio). Absent: HPD is
      read from the chip's status register 0x42 (adv7511.h:55).

  pd-gpios:
    type: phandle-array
    description: |
      The chip's power-down pin (Linux "pd-gpios", adi,adv7533.yaml:56-58;
      adv7511_drv.c:1248 requests "pd" and toggles it active then inactive to
      wake the chip). Absent: not driven. The DK wires no pd line; see
      reset-gpios.

  reset-gpios:
    type: phandle-array
    description: |
      The chip's reset line, if wired. The DK wires one: ST's dts names it
      reset-gpios = <&gpiob 6 GPIO_ACTIVE_LOW> (stm32mp257f-dk.dts:438).
      Nothing in Linux consumes it — the adv7511 driver reads only "pd"
      (adv7511_drv.c:1248), and neither adi,adv7533.yaml nor adi,adv7511.yaml
      defines reset-gpios — so ST's Linux runs with the line left as the
      board's pulls and the bootloader have it. Absent: not driven.

  interrupts:
    description: |
      The chip's INT output, if wired (Linux "interrupts", maxItems 1,
      adi,adv7533.yaml:53-54). The DK has it on GPIO B4, falling edge
      (stm32mp257f-dk.dts:436-437). Absent: the driver polls.

  adi,dsi-lanes:
    type: int
    default: 4
    enum: [1, 2, 3, 4]
    description: |
      DSI data lanes used (Linux adi,adv7533 binding "adi,dsi-lanes",
      :87-90, required there and 2 to 4; four on the DK,
      stm32mp257f-dk.dts:433). Must equal the DSI host's data-lanes.

  adi,disable-timing-generator:
    type: boolean
    description: |
      Disable the chip's internal timing generator (Linux adi,adv7533
      binding, :80-85): the DSI stream's own timing is used. Absent: the
      timing generator runs, which is the DK's state (ST's node does not
      carry the property).
```

## driver/dts/bindings/display/yakogl,am62p-dss.yaml
```yaml
# SPDX-License-Identifier: Apache-2.0
# SPDX-FileCopyrightText: 2026 Signal Slot, Inc.
description: TI AM62P display subsystem (DSS7) driven from the MCU R5F for the safety layer

compatible: "yakogl,am62p-dss"

include: [display-controller.yaml, base.yaml]

properties:
  reg:
    required: true
    description: common, vidl1, vid, ovr1, ovr2, vp1, vp2, common1
  reg-names:
    required: true
  interrupts:
    description: DSS functional interrupt line of this host (VIM 92 for DSS1 on the MCU R5F)
  tisci:
    type: phandle
    description: TISCI client used to power the module and set the pixel clock
  tisci-device-id:
    type: int
    required: true
    description: TISCI device id (DSS1 = 232)
  tisci-aux-device-ids:
    type: array
    description: |
      Other TISCI devices that must be on for this DSS (Linux lists power
      domain 244 next to 232 for DSS1 on the AM62P). Cores without a TISCI
      power-on-devices list (the A53) name them here.
  tisci-fck-clk-id:
    type: int
    default: 8
  tisci-vp-clk-id:
    type: int
    default: 0
    description: clock id of the video port clock source (DSS1 VP1 = OLDI clock, id 0)
  vp-clk-div:
    type: int
    default: 7
    description: fixed divider between the TISCI clock and the pixel clock
  video-port:
    type: int
    default: 1
    description: video port driving the panel (1 or 2)
  pixel-clock-hz:
    type: int
    required: true
  hfront-porch:
    type: int
    required: true
  hback-porch:
    type: int
    required: true
  hsync-len:
    type: int
    required: true
  vfront-porch:
    type: int
    required: true
  vback-porch:
    type: int
    required: true
  vsync-len:
    type: int
    required: true
  hsync-active-low:
    type: boolean
  vsync-active-low:
    type: boolean
  de-active-low:
    type: boolean
  pixclk-negedge:
    type: boolean
```

## driver/dts/bindings/display/yakogl,imx8mp-display.yaml
```yaml
# SPDX-License-Identifier: Apache-2.0
# SPDX-FileCopyrightText: 2026 Signal Slot, Inc.

description: |
  The i.MX8MP display pipeline as one device: LCDIFv3 -> MIPI DSIM + D-PHY
  -> TI SN65DSI8x DSI-to-LVDS bridge -> LVDS panel. The media power domains
  are yakogl,imx8mp-media-pd devices (power-domains), driven through
  include/yakogl_drv/imx8mp_media.h; the backlight is a PWM device of its own
  (pwms), driven through Zephyr's PWM API, and the bridge a
  yakogl,sn65dsi8x device (bridge), driven through include/yakogl_drv/sn65dsi8x.h.

  It is one node rather than a chain of drivers because the bring-up order
  is fixed and every step needs the numbers of the one before it (the CCM
  pixel clock decides the DSIM PLL, which decides the bridge's clock range).

compatible: "yakogl,imx8mp-display"

include: [base.yaml]

properties:
  reg:
    required: true
  reg-names:
    required: true
    description: |
      "lcdif" and "dsim", in that order.

  power-domains:
    required: true
    description: |
      The yakogl,imx8mp-media-pd domains of the LCDIF and of the DSIM, in
      that order ("lcdif1", "mipi-dsi1"). The display drives them itself on
      its cold path (on, clock plan, reset pulse) and reads the pixel clock
      back through them on the adopt path.

  bridge:
    type: phandle
    required: true
    description: |
      The SN65DSI8x on its I2C bus, a yakogl,sn65dsi8x device without a
      dsi-host: this display drives it (claims its EN pin at init, starts it
      on the cold path, never touches it on the adopt path). Its EN pin and
      the LVDS-side format, termination and polarities are its own
      properties.

  lcdif:
    type: phandle
    description: |
      The yakogl,imx8mp-lcdif of this chain. With
      CONFIG_YAKOGL_DRV_DISPLAY_IMX8MP_LCDIF_RUST the display configures, enables
      and stops the LCDIF through that device (driver/rust ip::lcdifv3)
      instead of src/display/imx8mp_lcdif.c; reads (running, scan-out, flip
      of a running layer) stay on this node's own "lcdif" mapping.

  dsi:
    type: phandle
    description: |
      The yakogl,samsung-dsim of this chain. With CONFIG_YAKOGL_DRV_DSIM_RUST the
      display attaches it (mipi_dsi_attach), releases its data lanes after
      the bridge and the LCDIF are up (yakogl_samsung_dsim_video_start) and
      detaches it, instead of src/display/imx8mp_dsim.c. Its
      pll-ref-frequency must equal this node's.

  backlight-enable-gpios:
    type: phandle-array
    description: |
      Optional backlight enable pin. The Verdin DSI backlight has none; the
      mezzanine and Dahlia ones do.

  dsi-lanes:
    type: int
    default: 4
    description: |
      DSI data lanes wired to the bridge (the DSIM side; the bridge node's
      data-lanes must say the same, which the driver checks at build time).

  esc-clock-frequency:
    type: int
    default: 20000000
    description: |
      Target DSIM escape clock; the driver picks the prescaler that stays at
      or below it. 20 MHz is the value the i.MX8MP EVK device trees use for
      samsung,esc-clock-frequency.

  burst-clock-frequency:
    type: int
    default: 0
    description: |
      The DSI HS clock to run, as mainline's samsung,burst-clock-frequency.
      0 derives it as pixel clock * 24 / lanes, which leaves burst mode no
      margin for packet overhead; a panel that works under Linux should state
      the rate Linux runs (the DSIM's PLLCTRL decoded).

  video-pll1-frequency:
    type: int
    default: 0
    description: |
      Program VIDEO_PLL1 to this rate and offer it as a parent of the LCDIF
      pixel clock, so the pixel clock can be the one Linux uses. 0 leaves the
      PLL alone; the pixel clock then comes from whichever of VIDEO_PLL1 (if
      it runs), SYS_PLL2, SYS_PLL1 and the oscillator gets nearest.

  pll-ref-frequency:
    type: int
    default: 24000000
    description: |
      MEDIA_MIPI_PHY1_REF, the DSIM PLL input. Mainline imx8mp.dtsi assigns
      24 MHz from the crystal and states the same in
      samsung,pll-clock-frequency.

  pwms:
    type: phandle-array
    required: true
    description: |
      The backlight PWM: <&pwm channel period-ns flags>. 6667179 ns (150 Hz)
      is what the board's Linux device tree gives backlight-verdin-dsi.

  backlight-brightness-percent:
    type: int
    default: 100
    description: Duty cycle of the backlight PWM.

  clock-frequency:
    type: int
    required: true
    description: Panel pixel clock in Hz.

  hactive:
    type: int
    required: true
  vactive:
    type: int
    required: true
  hfront-porch:
    type: int
    required: true
  hback-porch:
    type: int
    required: true
  hsync-len:
    type: int
    required: true
  vfront-porch:
    type: int
    required: true
  vback-porch:
    type: int
    required: true
  vsync-len:
    type: int
    required: true

  hsync-active:
    type: int
    default: 0
    description: 1 = HSYNC active high at the panel, 0 = active low.
  vsync-active:
    type: int
    default: 0
  de-active:
    type: int
    default: 1
```
