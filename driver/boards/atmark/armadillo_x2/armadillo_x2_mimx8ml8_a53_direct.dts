/*
 * SPDX-License-Identifier: Apache-2.0
 * SPDX-FileCopyrightText: 2026 Signal Slot, Inc.
 *
 * Atmark Techno Armadillo-X2, Cortex-A53 cluster, started at power-on:
 * Boot ROM -> U-Boot SPL -> TF-A BL31 (-> OP-TEE, which returns) -> this image
 * as BL33, with no U-Boot proper and no Linux (tools/cts/log/x2-direct-boot.md).
 *
 * The kexec variant's devicetree with three differences:
 *
 * 1. RAM. TF-A enters BL33 at PLAT_NS_IMAGE_OFFSET = 0x40200000 (Atmark's
 *    imx-atf, plat/imx/imx8m/imx8mp/include/platform_def.h), so the image is
 *    linked there. DRAM is 2 GiB at 0x40000000; what the earlier stages own:
 *      0x40000000    2 MiB  below the entry point: the DDR timing SPL saves
 *                           for TF-A's DRAM frequency service
 *                           (SAVED_DRAM_TIMING_BASE), never touched here
 *      0x40200000  256 MiB  this image's RAM (zephyr,sram)
 *      0x43200000           BL32_FDT_OVERLAY_ADDR: TF-A clears a word there
 *                           and OP-TEE may write a devicetree overlay, both
 *                           BEFORE this image runs. zephyr.bin (the loaded
 *                           part) must end below it, i.e. stay under 48 MiB;
 *                           .bss over it is fine, it is cleared later
 *      0x56000000   32 MiB  OP-TEE (BL32_BASE/BL32_SIZE), secure: never mapped
 *      0x80000000   64 MiB  GPU carveout, as in the kexec variant
 *    The crash-window address (0x60000000) of the kexec variant is not used.
 *
 * 2. No display node. Nothing has powered MEDIAMIX or clocked LCDIF3 at this
 *    point, so the adopt driver would read a dead block (and the cold
 *    LCDIF3 -> HDMI bring-up does not exist yet). The console is UART2.
 *
 * 3. The GIC, the system counter and CNTFRQ are as TF-A and SPL leave them;
 *    the defconfig re-initialises the distributor like the kexec variant.
 */

#include "armadillo_x2_mimx8ml8_a53.dts"

/ {
	model = "Atmark Techno Armadillo-X2 A53 (direct boot)";

	chosen {
		zephyr,sram = &a53_direct_ram;
	};
};

&ddr0 {
	reg = <0x40000000 DT_SIZE_M(2048)>;

	/delete-node/ memory@60000000;

	a53_direct_ram: memory@40200000 {
		reg = <0x40200000 DT_SIZE_M(256)>;
	};
};

/delete-node/ &display0;
