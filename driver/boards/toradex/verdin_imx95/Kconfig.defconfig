## driver/boards/toradex/verdin_imx95/verdin_imx95_mimx9596_a55_defconfig
```kconfig
# SPDX-License-Identifier: Apache-2.0
# SPDX-FileCopyrightText: 2024 NXP
# SPDX-FileCopyrightText: 2026 Signal Slot, Inc.
# From Zephyr's boards/nxp/imx95_evk/imx95_evk_mimx9596_a55_defconfig at
# af17c0c8aa2a: one core (no SMP), the console on LPUART1, SCMI over MU2
# for the clocks and pins.

# ARM Options
CONFIG_AARCH64_IMAGE_HEADER=y
CONFIG_ARMV8_A_NS=y

# MMU Options
CONFIG_MAX_XLAT_TABLES=64

# Cache Options
CONFIG_CACHE_MANAGEMENT=y
CONFIG_DCACHE_LINE_SIZE_DETECT=y
CONFIG_ICACHE_LINE_SIZE_DETECT=y

# Zephyr Kernel Configuration
CONFIG_XIP=n

# Serial Drivers
CONFIG_SERIAL=y
CONFIG_UART_INTERRUPT_DRIVEN=y

# Enable Console
CONFIG_CONSOLE=y
CONFIG_UART_CONSOLE=y

CONFIG_CLOCK_CONTROL=y

CONFIG_MBOX=y
CONFIG_ARM_SCMI=y
```

## driver/dts/bindings/display/yakogl,imx95-dsi-display.yaml
```yaml
# SPDX-License-Identifier: Apache-2.0
# SPDX-FileCopyrightText: 2026 Signal Slot, Inc.

description: |
  The i.MX 95's display stream 0 routed to its MIPI DSI output, as one
  picture: the DPU, the display block's CSR and pixel interleaver, the DW
  MIPI DSI host with the camera mix's CSRs and the combo D-PHY (reached
  through CSI-1's test interface), a TPM for the backlight, and a TI
  SN65DSI83 bridge on I2C with its EN on a GPIO. The register logic is
  driver/rust/src/board/verdin_imx95_display.rs (the order of
  driver/docs/imx95-display.md section 4(b)); the board layer drives it
  (driver/zephyr/lib/board/verdin_imx95/verdin_imx95_display.c), no Zephyr
  driver binds this node. The blocks' clocks and power domains are the
  System Manager's, asked over SCMI by the Rust side.

  Every value here is a fact of the SoC (the addresses), the module (the
  expander line, the bridge's bus) or the display on the carrier (the
  bridge's address, the backlight pin).

compatible: "yakogl,imx95-dsi-display"

include: [base.yaml, pinctrl-device.yaml]

properties:
  reg:
    required: true

  reg-names:
    required: true
    description: |
      "dpu", "csr" (display CSR), "interleaver", "dsi" (DW host), "stream"
      and "master" (the DSI stream and master CSRs), "phy_csr" (combo PHY
      CSR), "csi1" (the CSI-2 host whose test interface reaches the combo
      PHY), "tpm" (the backlight's TPM), in this order.

  bridge:
    type: phandle
    required: true
    description: The SN65DSI83's node on its I2C bus (its reg is the address).

  enable-gpios:
    type: phandle-array
    required: true
    description: The bridge's EN pin (active high at the pin).

  pinctrl-0:
    required: true
    description: The backlight's TPM channel on its pad.
```

## driver/dts/bindings/display/yakogl,imx95-lvds-display.yaml
```yaml
# SPDX-License-Identifier: Apache-2.0
# SPDX-FileCopyrightText: 2026 Signal Slot, Inc.

description: |
  The i.MX 95's display stream 0 routed to its native LVDS output, as one
  picture: the LVDS CSR (LDB, LVDS PHY 0), the DPU, the display block's CSR
  and pixel interleaver, a TPM for the backlight's PWM and an RGPIO port for
  its enable. The register logic is driver/rust/src/board/verdin_imx95_lvds.rs
  (the order of driver/docs/imx95-display.md section 4(b')); the board layer
  drives it (driver/zephyr/lib/board/verdin_imx95/verdin_imx95_lvds.c), no
  Zephyr driver binds this node. The blocks' clocks and power domain are the
  System Manager's, asked over SCMI by the Rust side.

  Every value here is a fact of the SoC (the addresses) or of the display
  on the carrier (the backlight's pads).

compatible: "yakogl,imx95-lvds-display"

include: [base.yaml, pinctrl-device.yaml]

properties:
  reg:
    required: true

  reg-names:
    required: true
    description: |
      "ldb" (the LVDS CSR), "dpu", "csr" (display CSR), "interleaver",
      "tpm" (the backlight's TPM), "gpio" (the RGPIO port of its enable), in
      this order.

  pinctrl-0:
    required: true
    description: The backlight's TPM channel and its enable pin on their pads.
```

## driver/dts/bindings/gpu/arm,mali-valhall-csf.yaml
```yaml
# SPDX-License-Identifier: Apache-2.0
# SPDX-FileCopyrightText: 2026 Signal Slot, Inc.

description: |
  Arm Mali Valhall GPU with a command stream frontend (CSF): the Mali-G310 of
  the NXP i.MX 95. The node is Linux's (arch/arm64/boot/dts/freescale/
  imx95.dtsi, gpu@4d900000). No Zephyr driver binds it: the YakoGL Mali OSAL
  (src/osal/zephyr_mali.c, its board half in driver/zephyr/lib/board/) reads
  the register block from it. The clocks and the power domain are the SoC's
  firmware's (the i.MX 95 System Manager, through SCMI); who asks for them
  is the board's.

compatible: "arm,mali-valhall-csf"

include: base.yaml

properties:
  reg:
    required: true
    description: The GPU's register block, doorbell pages included.

  interrupts:
    required: true
    description: Three, named "job", "mmu" and "gpu".

  interrupt-names:
    required: true

  clocks:
    required: true
    description: |
      "core" and "coregroup" (on the i.MX 95 the SCMI clocks
      IMX95_CLK_GPU_CGC and IMX95_CLK_GPUAPB).

  clock-names:
    required: true

  power-domains:
    required: true
    description: The GPU's power domain (on the i.MX 95 SCMI domain 14, IMX95_PD_GPU).
```

## driver/dts/bindings/mmc/yakogl,imx95-usdhc-boot.yaml
```yaml
# SPDX-License-Identifier: Apache-2.0
# SPDX-FileCopyrightText: 2026 Signal Slot, Inc.
description: |
  The i.MX 95's uSDHC as the second-stage loader's polled eMMC path
  (driver/samples/zephyr/boot_stage2, BOOT_STAGE2_COUNT; loader/src/usdhc.rs):
  no Zephyr driver binds it. Zephyr's nxp,imx-usdhc driver does not build
  for the i.MX 95 A55 at the workspace pin (its MCUX fsl_usdhc needs
  USDHC_Type, which the MIMX9596 A55 device header names WAKEUP_USDHC_Type).
  The loader maps reg, reads the clock's rate through the SCMI clock
  protocol, and relies on the boot stage before it (U-Boot SPL, which booted
  from this card) for the clock root being on and for the pads' mux.
compatible: "yakogl,imx95-usdhc-boot"
include: base.yaml
properties:
  reg:
    required: true
  clocks:
    required: true
    description: the uSDHC's root clock (the "per" clock), as <&scmi_clk id>
```

## driver/zephyr/lib/board/nanopc_t6/Kconfig
```kconfig
# SPDX-License-Identifier: Apache-2.0
# SPDX-FileCopyrightText: 2026 Signal Slot, Inc.
# The NanoPC-T6 board glue (nanopc_t6.c over driver/rust's ip::dw_wdt,
# soc::rk3588 and aarch64): every image built for the board has it, so no
# image can run without its bounded watchdog.

config YAKOGL_NANOPC_T6
	def_bool BOARD_NANOPC_T6
	select YAKOGL_DRV_DISPLAY_RUST
	help
	  The early banner (raw T6:A/A1/A2/A3 lines on uart2 before the
	  console, T6:X for an exception taken to EL2) and HCR_EL2 at entry;
	  WDT0 (the DesignWare APB watchdog at 0xfeaf0000) armed at the end
	  of Zephyr's EL1 init, before every init hook, and fed from a timer
	  for a bounded time; at EARLY, every interrupt left Active at the
	  GICv3 distributor and at the boot CPU's redistributor deactivated,
	  and the GICv3 CPU interface put back into its reset EOI mode, with
	  no active priority and ICC_BPR1_EL1 0; and
	  t6_reset_to_linux() (nanopc_t6.h), the end of a run: PSCI
	  SYSTEM_RESET, with WDT0 behind it. YAKOGL_DRV_DISPLAY_RUST is the switch
	  that builds the yakogl-drivers crate (driver/zephyr/CMakeLists.txt,
	  feature rk3588).

config YAKOGL_BOARD_NANOPC_T6
	def_bool YAKOGL_BOARD && YAKOGL_NANOPC_T6
	depends on YAKOGL_GPU_MALI
	select YAKOGL_BOARD_DISPLAY_BUSY
	help
	  The board layer on the NanoPC-T6 (board_nanopc_t6.c). Window: the
	  last pages of the Mali OSAL's carve-out, so board_window() comes
	  before eglInitialize(); screen: VP0 of the VOP on HDMI0, at the
	  first board_show() adopted when a picture was left running and
	  started from cold when none was
	  (driver/docs/nanopc-t6-display.md, steps D3 and D8); record: the
	  UART line; watchdog: WDT0 below, fed for YAKOGL_BOARD_LIFETIME_S
	  while board_watchdog_feed() or the OSAL's waits come within
	  YAKOGL_BOARD_ALIVE_S; reset: t6_reset_to_linux().

config YAKOGL_BOARD_NANOPC_T6_COLD_1920X1080
	bool "The display's start from cold is 1920x1080@60 (n: 1024x768@60)"
	depends on YAKOGL_BOARD_NANOPC_T6
	help
	  The mode the first board_show() programs when no picture was left
	  running (a normal kexec, or U-Boot): 1024x768 at 60 Hz (65 MHz),
	  or with this 1920x1080 at 60 Hz (148.5 MHz) for a sink that shows
	  no other mode, such as the HDMI capture unit on the board's
	  output. The window stays at the screen's origin and the rest is
	  black. A picture left running (the crash route) is adopted in its
	  own mode and this is not used.

if YAKOGL_NANOPC_T6

config YAKOGL_NANOPC_T6_VHE_EXIT
	bool "Write HCR_EL2 := RW at entry (leave Linux's VHE state)"
	default y
	help
	  Armbian's Linux runs at EL2 with VHE, and its kexec enters the
	  image with HCR_EL2.E2H (and FMO) still set. Zephyr's
	  z_arm64_el2_init keeps both, writes CNTHCTL_EL2 in the E2H=0
	  layout, and EL1's first physical-timer write in z_arm64_el1_init
	  then traps to EL2, where nothing of the image's is: the first jump
	  on 2026-10-19 printed nothing (driver/rust/src/aarch64.rs). With
	  this, the image's first code writes HCR_EL2 = RW only, as Linux's
	  own entry writes a whole HCR_EL2. n keeps Linux's value: the A/B
	  arm that shows the failure (T6:A with E2H set, then T6:X).

config YAKOGL_NANOPC_T6_WDT_TOP
	int "WDT0 period: TOP (period = 2^(16 + TOP) / 24 MHz)"
	default 13
	range 11 15
	help
	  11: 5.6 s, 12: 11.2 s, 13: 22.4 s, 14: 44.7 s, 15: 89.5 s. The
	  board resets at most one period after the feeding stops. Below 11
	  a missed tick of the 1 s feeder would already reset the board.

config YAKOGL_NANOPC_T6_LIFETIME_S
	int "Seconds of uptime the watchdog is fed at most"
	default YAKOGL_BOARD_LIFETIME_S if YAKOGL_BOARD
	default 60
	range 10 3600
	help
	  After this nothing feeds WDT0 and the board resets within one
	  period, also when the image hangs or faults. The run must end
	  before it (t6_reset_to_linux()). An image with the board layer
	  sets YAKOGL_BOARD_LIFETIME_S, not this.

config YAKOGL_NANOPC_T6_ALIVE_S
	int "Seconds between two t6_watchdog_feed() calls at most"
	default YAKOGL_BOARD_ALIVE_S if YAKOGL_BOARD
	default 5
	range 1 600
	help
	  Once the sample has called t6_watchdog_feed(), a longer gap stops
	  the feeding, so a stuck sample is reset long before the lifetime.
	  An image with the board layer sets YAKOGL_BOARD_ALIVE_S, not this:
	  there t6_watchdog_feed() is board_watchdog_feed().

config YAKOGL_NANOPC_T6_WDT_PROOF
	bool "Proof: arm WDT0 and never feed it"
	help
	  The measurement of the reset path itself: WDT0 is armed and not
	  fed, and t6_reset_to_linux() waits for it instead of calling PSCI.
	  A software backstop (PSCI SYSTEM_RESET) fires 10 s after one period
	  and prints "t6: proof FAILED" first.

endif # YAKOGL_NANOPC_T6
```

## driver/zephyr/lib/board/verdin_imx95/Kconfig
```kconfig
# SPDX-License-Identifier: Apache-2.0
# SPDX-FileCopyrightText: 2026 Signal Slot, Inc.
# The Verdin iMX95 (i.MX 95, Cortex-A55) board glue: every image built for
# the board (driver/boards/toradex/verdin_imx95), outside the board layer
# YAKOGL_BOARD, as YAKOGL_NANOPC_T6 and YAKOGL_STM32MP2 are. Built, not run
# on a board yet (docs/standalone-boot.md, "Toradex Verdin iMX95").

config YAKOGL_VERDIN_IMX95
	def_bool BOARD_VERDIN_IMX95
	help
	  verdin_imx95.c: the end of a run, verdin_imx95_reset()
	  (verdin_imx95.h: PSCI SYSTEM_RESET to TF-A), and a lifetime timer
	  that takes it after YAKOGL_VERDIN_IMX95_LIFETIME_S.
	  verdin_imx95_wdog.c: WDOG3, armed at PRE_KERNEL_1 for 60 s
	  (ip::wdog32 in the yakogl-drivers crate, feature imx95) and fed by
	  a 1 s timer up to the lifetime and while the board layer's alive
	  window holds; its timeout resets the whole board through the
	  System Manager (docs/notes/pre-study-imx95.md, "The watchdog").
	  With YAKOGL_GPU_MALI, verdin_imx95_mali.c is the Mali OSAL's
	  board half: the CSF firmware, the GPU's power-on over SCMI to the
	  System Manager and its bring-up (yd_imx95_osal_up), over the
	  board's one raw SCMI channel (verdin_imx95_scmi.c), which the
	  display shares.

if YAKOGL_VERDIN_IMX95

config YAKOGL_VERDIN_IMX95_LIFETIME_S
	int "Seconds of uptime after which the glue resets the board through PSCI"
	default YAKOGL_BOARD_LIFETIME_S if YAKOGL_BOARD
	default 60
	range 5 3600
	help
	  The board layer's lifetime when the image has the layer
	  (YAKOGL_BOARD_LIFETIME_S), else 60 s. A timer of the system clock;
	  WDOG3's feeding stops at the same uptime, so a PSCI reset that
	  returns, or a hang with interrupts locked, ends in WDOG3's reset
	  at most 60 s later.

endif # YAKOGL_VERDIN_IMX95

config YAKOGL_BOARD_VERDIN_IMX95
	def_bool YAKOGL_BOARD && YAKOGL_VERDIN_IMX95
	help
	  The board layer (yakogl_board.h) on the Verdin iMX95's A55
	  (board_verdin_imx95.c): the windows in the Mali carve-out's window
	  memory (YAKOGL_MALI_WINDOW_BYTES), the screen with
	  YAKOGL_VERDIN_IMX95_DISPLAY; record: the yk-record line on the
	  console UART; reset: verdin_imx95_reset(); watchdog: WDOG3
	  (YAKOGL_VERDIN_IMX95).

config YAKOGL_VERDIN_IMX95_DISPLAY
	bool "The Toradex 10.1\" DSI display on X4 is the board layer's screen"
	default y
	depends on YAKOGL_BOARD_VERDIN_IMX95 && YAKOGL_GPU_MALI
	depends on DT_HAS_YAKOGL_IMX95_DSI_DISPLAY_ENABLED
	select YAKOGL_DRV_DISPLAY_RUST
	select I2C
	select GPIO
	select PINCTRL
	help
	  verdin_imx95_display.c: board_show() puts the window on the
	  Toradex Capacitive Touch Display 10.1" DSI (1280x800) on the
	  Mallow's X4, cold, in the order of driver/docs/imx95-display.md
	  section 4(b) (yd_imx95_display_up / _flip / _down of the drivers
	  crate, feature imx95). The blocks and the bridge are the
	  x4_display node (the board layer's app.overlay); the bridge's
	  I2C is Zephyr's nxp,lpi2c driver on LPI2C3, its EN Zephyr's
	  nxp,pcal6416 driver on the module's expander (LPI2C2, line 3),
	  both buses and the expander initialised at the first show after
	  their SCMI clocks are on. The SCMI channel is the GPU's.
```

## tools/cts/testdata/pr-c7-check/defaulty/driver/zephyr/Kconfig
```kconfig
config OTHER
	default y

config YAKOGL_DRV_GPU_PVR_PARTIAL_RENDER
	bool "x"
	default y

config NEXT
	default y
```

## tools/cts/testdata/pr-c7-check/nocite/driver/zephyr/Kconfig
```kconfig
config OTHER
	default y

config YAKOGL_DRV_GPU_PVR_PARTIAL_RENDER
	bool "x"


config NEXT
	default y
```

## tools/cts/testdata/pr-c7-check/pass/driver/zephyr/Kconfig
```kconfig
config OTHER
	default y

config YAKOGL_DRV_GPU_PVR_PARTIAL_RENDER
	bool "x"
	default n

config NEXT
	default y
```
