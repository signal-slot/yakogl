/* SPDX-License-Identifier: Apache-2.0 — Verdin AM62P on Dahlia: pins used by the PoC */
/* SPDX-FileCopyrightText: 2026 Signal Slot, Inc. */

&pinctrl {
	/* Verdin UART_3 (debug console) = AM62P main_uart0 */
	main_uart0_rx_default: main_uart0_rx_default {
		pinmux = <K3_PINMUX(0x1c8, PIN_INPUT, MUX_MODE_0)>;
	};

	main_uart0_tx_default: main_uart0_tx_default {
		pinmux = <K3_PINMUX(0x1cc, PIN_OUTPUT, MUX_MODE_0)>;
	};
};
