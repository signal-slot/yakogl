## driver/zephyr/lib/board/imx8mp/Kconfig
```kconfig
# SPDX-License-Identifier: Apache-2.0
# SPDX-FileCopyrightText: 2026 Signal Slot, Inc.
# yakogl_gc_board: what every Zephyr image kexec'd onto the Verdin iMX8M Plus
# needs, whatever it runs -- the inherited watchdog and the bounded way back to
# Linux, the fatal handler, the interrupt guard, the SNVS result record and the
# panel console. It started as the i.MX8MP samples' gc_common and moved here so
# that an application outside this repository (Qt) links the same code.

menuconfig YAKOGL_GC_BOARD
	bool "Board support for a kexec'd image on the Verdin iMX8M Plus"
	depends on ARM64
	help
	  The i.MX8MP samples turn this on in their boards/*.conf
	  (CONFIG_YAKOGL_GC_BOARD=y). An application outside this repository sets
	  CONFIG_YAKOGL_GC_BOARD=y and calls gc_sample_finish() (gc_sample.h)
	  on every path that ends the run.

if YAKOGL_GC_BOARD

config GC_BOARD_GIC_EOI_RESET
	bool "Undo the GICv3 split EOI mode a kexec from Linux leaves behind"
	default y
	depends on GIC_V3
	help
	  Clears ICC_CTLR_EL1.EOImode on the boot CPU at the EARLY init
	  level (gc_board_gic.c). Without it the system timer ticks once and
	  the kernel hangs in its first timed wait. It used to be the SafeUI
	  Verdin extension's board_a53.c.

config GC_SAMPLE_HOLD_SECONDS
	int "Seconds to stay up (servicing the inherited watchdog) before resetting the SoC"
	default 60
	help
	  The sample keeps the i.MX WDOG1 Linux left running serviced for this
	  long, then resets the SoC through PSCI so the boot loader brings
	  Linux back. A bounded lifetime is the lab rule: nothing else can
	  reset the board remotely.

	  Sixty seconds is long enough to read the panel console and take a
	  photograph of it, which on this carrier is how a run is reported.

config GC_SAMPLE_HOLD_SECONDS_FATAL
	int "Seconds to hold after a fatal error before the SoC reset"
	default 15
	help
	  Long enough to photograph the exception dump on the panel; short
	  enough that the return time (about 20 s) is unlike PASS (60 s) and
	  FAIL (40 s).

config GC_SAMPLE_FATAL_HANDLER
	bool "gc_common's fatal error handler (hold, then reset)"
	default y
	help
	  Off for a sample that brings its own k_sys_fatal_error_handler.

config GC_SAMPLE_HOLD_CODE_STEP
	int "Seconds of hold per unit of the result code"
	default 6
	help
	  A coded hold is 70 s + this many seconds per unit of the code, and
	  the code is read back by timing the board's return. The return time
	  jitters by two or three seconds, so at a 3 s step a code cannot be
	  told from its neighbour -- a run that reads 46 s could be code 0 or
	  code 1. Six seconds is the smallest step that survives the jitter.

	  Runs recorded before 2026-09-21 were read with a 3 s step; a hold
	  quoted in an older README means half the code it would mean now.

	  This applies to a sample's own result code (gc_sample_hold_code),
	  not to the fatal-error encodings below. Those stay at 3 s because
	  the display and Cortex-M7 work is reading them right now, and
	  changing what a hold means under someone mid-investigation is worse
	  than two formulas.

config GC_SAMPLE_FATAL_ENCODE_ELR
	bool "Encode the faulting PC in the hold after a fatal error"
	depends on GC_SAMPLE_FATAL_HANDLER
	help
	  The hold becomes 70 s + 3 s per 4 KiB window of the faulting PC
	  from the image base, so that the one or two seconds of jitter in
	  the return time cannot move the reading to the next window.

config GC_SAMPLE_FATAL_ENCODE_ELR_FINE
	bool "Encode bits 11:6 of the faulting PC in the hold after a fatal error"
	depends on GC_SAMPLE_FATAL_HANDLER
	help
	  The second half of ENCODE_ELR: 70 s + 3 s per 64-byte step inside
	  the 4 KiB window, which names the function.

config GC_SAMPLE_FATAL_ENCODE_EC
	bool "Encode the exception class in the hold after a fatal error"
	depends on GC_SAMPLE_FATAL_HANDLER
	help
	  The hold becomes 70 s + 3 s * ESR_EL1.EC: 133 for an SVC (k_panic
	  or k_oops), 169 for an instruction abort, 181 for a data abort,
	  211 for an SError; 250 + reason when there is no frame at all.

config GC_SAMPLE_FATAL_ENCODE_FAR
	depends on GC_SAMPLE_FATAL_HANDLER
	bool "Encode the faulting address in the hold after a fatal error"
	help
	  For a board whose panel cannot be seen: the hold becomes 70 s plus
	  3 s per unit of bits 23:18 of FAR_EL1, so the time until Linux is
	  back names the peripheral that was being accessed.

config GC_SAMPLE_FATAL_ENCODE_DFSC
	depends on GC_SAMPLE_FATAL_HANDLER
	bool "Encode the abort's fault status code in the hold after a fatal error"
	help
	  The hold becomes 70 s + 3 s * ESR_EL1.ISS[5:0]: 82..91 for a
	  translation fault (level 0..3), 109..118 for a permission fault,
	  118 for a synchronous external abort (a clock-gated or powered-down
	  peripheral), 133 for an alignment fault. 70 rather than 60 so that
	  a code of 0 is not mistaken for the 60 s PASS hold.

config GC_SAMPLE_HOLD_REPORTS_WDOG
	bool "Diagnostic: the hold encodes WDOG1's state at boot instead of the sample's code"
	help
	  70 s + 3 s * (32 + WT / 8) when the watchdog was enabled (WDE),
	  70 s when it was not. Timeout in seconds is (WT + 1) / 2.

config GC_SAMPLE_FAULT_RECORD
	bool "Write the fault syndrome to DDR that survives the SoC reset"
	help
	  A fault whose handler faults again leaves the CPU in the exception
	  with interrupts masked: no ISR, no watchdog feed, no supervisor, and
	  from outside it is indistinguishable from a system tick that stopped.
	  FATAL_HANDLER cannot report it, because the reporting is what faults.

	  This stores reason, ESR, FAR, ELR, a caller-set note and the uptime
	  at the very first instruction of the fatal handler, before any
	  printing or unwinding, into carveout DDR that Linux leaves no-map
	  and the SoC reset does not clear. The magic word is written LAST, so
	  a half-written record cannot be mistaken for a whole one.

config GC_SAMPLE_FAULT_RECORD_ADDR
	hex "Physical address of the fault record (one page)"
	default 0x81006000
	depends on GC_SAMPLE_FAULT_RECORD
	help
	  Must be memory nothing else writes and the reset does not clear. The
	  default sits in the M7's reserved carveout above the frame ring
	  (status 0x81000000, log 0x81001000, ring 0x81005000), inside the
	  32 KiB uncached window and referenced by nothing else.

config GC_SAMPLE_WDOG_TIMER_FEED
	bool "Feed the watchdog from a timer, not from the working thread"
	depends on GC_SAMPLE_WDOG_BASE != 0
	help
	  Every feed is otherwise made by the code doing the work, so when the
	  work stops the watchdog resets the board at a fixed interval with no
	  report -- the route-3 image returned exactly 131 s for every
	  configuration because it wedged and nothing fed from there on.

	  A timer feeds instead, keeping the board alive while a thread is
	  stuck for long enough that the supervisor's STUCK code can get out.

	  It cannot help if the system timer itself has stopped, since the
	  callback runs from that interrupt -- but that is worth learning: a
	  run that still returns 131 s with this on says the tick is dead,
	  which is a different fault from a blocked thread.

config GC_SAMPLE_WDOG_TIMER_CAP_S
	int "Seconds the timer may feed before it stops and lets the board reset"
	default 240
	depends on GC_SAMPLE_WDOG_TIMER_FEED
	help
	  Bounded on purpose. Feeding a watchdog for ever is how this lab lost
	  a board for a day; past this the timer stops and the watchdog takes
	  the board, so a wedge returns at the cap plus the watchdog rather
	  than never.

config GC_SAMPLE_HOLD_SECONDS_FAIL
	int "Seconds to hold after a FAIL verdict"
	default 40
	help
	  Different from the PASS hold on purpose: when the console cannot be
	  seen, the time until Linux is back still says which verdict the
	  sample reached (60 s PASS, 40 s FAIL, the watchdog's 128 s neither).

config GC_SAMPLE_WDOG_BASE
	hex "Physical address of the watchdog to service (0 to skip)"
	default 0x30280000
	help
	  i.MX8MP WDOG1. Its service sequence (0x5555 then 0xaaaa to WSR) is
	  harmless when the watchdog is not armed.

config GC_BOARD_WDOG_SELF_ARM
	bool "Arm WDOG1 for 60 s ourselves, then feed it for a bounded time"
	depends on GC_SAMPLE_WDOG_BASE = 0x30280000
	depends on MMU
	select YAKOGL_DRV_DISPLAY_RUST
	help
	  For an image U-Boot starts with "go" (docs/standalone-boot.md, "What
	  the image does on a go entry"). Nothing then guarantees that WDOG1
	  runs: a U-Boot built without the driver model watchdog's autostart
	  leaves it stopped, and the inherited-watchdog feeding the samples do
	  (gc_sample.c) then bounds nothing. At PRE_KERNEL_1 this turns the CCM
	  WDOG root and the WDOG1 gate on, arms WDOG1 for 60 s from whatever
	  state it is in (stopped, U-Boot's 60 s, Linux's 30 s: the register
	  logic is driver/rust ip::imx_wdog), reads it back and logs
	  "gc_wdog_arm: armed" (the literal tools/board.sh requires). From then
	  on gc_sample_service_wdog() and a 1 s timer feed it until
	  GC_BOARD_WDOG_SECONDS of uptime and never after, so a hung image comes
	  back by itself at most that plus 60 s after boot. A refusal
	  (gc_result.h kind WDOG tag 2) resets the SoC at once: an image that
	  could not arm its watchdog does not run.

	  The same image works on a kexec entry: the running watchdog is
	  re-timed to 60 s and fed under the same bound.

config GC_BOARD_WDOG_SECONDS
	int "Seconds of uptime during which WDOG1 is fed"
	depends on GC_BOARD_WDOG_SELF_ARM
	default YAKOGL_BOARD_LIFETIME_S if YAKOGL_BOARD
	default 300
	range 10 3600
	help
	  The image's one bound. It must cover the sample's run and its hold
	  (GC_SAMPLE_HOLD_SECONDS, 60 by default, or a hold code's up to
	  448 s); a hold longer than this is cut short by the watchdog 60 s
	  after the bound, which changes the return time the hold encodes.

config GC_BOARD_WDOG_PROOF
	bool "Proof image: arm WDOG1, never feed it, software reset as a backstop"
	depends on GC_BOARD_WDOG_SELF_ARM
	help
	  For the netboot plan's watchdog proof only: shows on the board that
	  the WDOG1 this image arms really resets the SoC. Nothing feeds it
	  after the arming; gc_sample_finish() holds instead of resetting.
	  The record (kind WDOG tag 3) is rewritten when the sample has
	  finished, so the reader finds it; WDOG1 should reset the SoC 60 s
	  after the uptime it carries. If the image is still alive
	  GC_BOARD_WDOG_PROOF_BACKSTOP_SECONDS after the arming, it writes
	  tag 4 and resets through PSCI.

config GC_BOARD_WDOG_PROOF_BACKSTOP_SECONDS
	int "Seconds after the arming before the proof image resets by software"
	depends on GC_BOARD_WDOG_PROOF
	default 90
	range 65 600


config GC_COMMON_PANEL_CONSOLE
	bool "Render the console onto the DSI panel Linux left scanning out"
	default y
	depends on CONSOLE && PRINTK && MMU
	select CONSOLE_HAS_DRIVER
	select YAKOGL_DRV_DISPLAY_RUST
	help
	  The Verdin iMX8M Plus on a Mallow carrier has no reachable UART: the
	  debug header X11 is not assembled. Every RAM-based channel we tried
	  is gone by the time a kexec'd Zephyr runs. The panel is not: Linux
	  leaves the LCDIFv3 scanning a framebuffer out to the DSI panel and it
	  keeps scanning after the jump.

	  This takes that framebuffer over and draws printk() into it with a
	  bitmap font, so a photograph of the panel is the console log.

	  A sample that turns this on must also set CONFIG_UART_CONSOLE=n (the
	  board's defconfig turns it on, and a defconfig beats a Kconfig
	  default) and CONFIG_LOG_MODE_MINIMAL=y, so that LOG_* goes through
	  printk instead of the logging back ends.

if GC_COMMON_PANEL_CONSOLE

config GC_COMMON_PANEL_CONSOLE_LCDIF_BASE
	hex "Physical address of the LCDIFv3 that drives the DSI panel"
	default 0x32e80000
	help
	  The i.MX8MP has two LCDIFv3 instances; this is the one Linux's device
	  tree calls lcd-controller@32e80000 and wires to the DSI bridge.

config GC_COMMON_PANEL_CONSOLE_MEDIA_BLK_BASE
	hex "Physical address of MEDIA_BLK_CTRL"
	default 0x32ec0000
	help
	  With the GPC and CCM below, what the take-over reads (Rust
	  soc::imx8mp::media::lcdif_unreachable) before it touches the LCDIF:
	  the LCDIF sits inside MEDIAMIX, and on an entry where MEDIAMIX is
	  powered down or unclocked (U-Boot's "go") a register read of it
	  never completes. Addresses as Linux's device tree on this board
	  (samples/zephyr/common/verdin_imx8mp_display.dtsi).

config GC_COMMON_PANEL_CONSOLE_GPC_BASE
	hex "Physical address of the GPC"
	default 0x303a0000

config GC_COMMON_PANEL_CONSOLE_CCM_BASE
	hex "Physical address of the CCM"
	default 0x30380000

config GC_COMMON_PANEL_CONSOLE_OWN_FB
	bool "Scan out of a framebuffer of our own"
	default y
	help
	  Allocate a framebuffer with the geometry read out of the LCDIF and
	  point the controller at it with the shadow-load handshake, instead of
	  drawing over the picture Linux left. If the handshake does not
	  complete the code puts the old address back and draws into Linux's
	  buffer anyway, so saying n here only skips the attempt.

config GC_COMMON_PANEL_CONSOLE_FB_KB
	int "Size of that framebuffer, in KiB"
	default 4000
	depends on GC_COMMON_PANEL_CONSOLE_OWN_FB
	help
	  4000 KiB is 1280x800 at 4 bytes per pixel, this board's panel. The
	  buffer is __noinit, so it costs nothing in the image, only in RAM.
	  If the geometry read out of the LCDIF does not fit, the console
	  draws into the buffer Linux left instead.

config GC_COMMON_PANEL_CONSOLE_SCALE
	int "Glyph zoom (1 = one font pixel per screen pixel)"
	default 1
	range 1 4
	help
	  1 gives 160x50 characters on a 1280x800 panel, 2 gives 80x25 in
	  characters twice the size, which photographs better but holds a
	  quarter of the text.

config GC_COMMON_PANEL_CONSOLE_COLD_BRINGUP
	bool "Turn the panel on ourselves when Linux left it off"
	default y
	depends on GC_COMMON_PANEL_CONSOLE_OWN_FB
	help
	  The PRE_KERNEL_1 stage can only take over a picture that is already
	  there, which is the kexec crash route. On the normal route Linux
	  runs device_shutdown() and the panel is dark. This adds a second
	  stage at POST_KERNEL that calls imx8mp_display_on() (the
	  CONFIG_YAKOGL_DRV_DISPLAY_IMX8MP driver) to bring the LCDIF, the DSIM,
	  the SN65DSI8x bridge and the backlight up on its own framebuffer,
	  then installs the printk hook.

	  It cannot run earlier: the bridge is on I2C behind a GPIO enable
	  line and its sequence needs millisecond sleeps. Whatever the image
	  printed before POST_KERNEL is lost on that route.

	  Without CONFIG_YAKOGL_DRV_DISPLAY_IMX8MP (no display node in the device
	  tree) this compiles out and only the adopt path remains.

config GC_COMMON_PANEL_CONSOLE_COLD_PRIORITY
	int "Init priority of that second stage"
	default 85
	depends on GC_COMMON_PANEL_CONSOLE_COLD_BRINGUP
	help
	  Must be greater than CONFIG_YAKOGL_DRV_DISPLAY_IMX8MP_INIT_PRIORITY (80),
	  so the display device has mapped its registers first.

endif # GC_COMMON_PANEL_CONSOLE

config GC_SAMPLE_HOLD_BUSY_WAIT
	bool "Hold with k_busy_wait instead of k_sleep (no timer interrupt)"
	help
	  Diagnostic. The hold loop spins on the counter instead of sleeping,
	  so it completes even when no timer interrupt ever arrives, which is
	  what a GIC left in the wrong state by the previous kernel looks like.

config GC_COMMON_IRQ_GUARD
	bool "Catch interrupts no driver registered instead of dying on them"
	default y
	select DYNAMIC_INTERRUPTS
	help
	  After all drivers initialised, every interrupt line still on the
	  spurious handler gets a handler that disables the line, counts it
	  and prints it. On the i.MX8MP a kexec'd image otherwise dies on one
	  such interrupt within its first minute (see gc_irq_guard.c).

config GC_COMMON_RESULT_SNVS
	bool "Leave a 128-bit result record in the SNVS LPGPR for Linux to read"
	default y
	depends on MMU
	help
	  The SNVS low-power general purpose registers, 0x30370090..0x9C,
	  keep their value across the SoC reset that takes the board back to
	  Linux; DDR and OCRAM do not. Neither U-Boot 2024.07 nor NXP TF-A
	  lf-6.6.52-2.2.1 uses them, and Linux reads them back through
	  /sys/bus/nvmem/devices/30370000.snvs:snvs-lpgpr0/nvmem. The record
	  layout (gc_result.h) is the one every board uses. The fatal handler
	  stores a FAULT record when this is on.

config GC_COMMON_RESULT_SNVS_KEEP_LPGPR0
	bool "Leave LPGPR0 alone: the record is LPGPR1..3, without its last word"
	depends on GC_COMMON_RESULT_SNVS
	help
	  For a board whose boot loader keeps state in LPGPR0 (the
	  Armadillo-X2's U-Boot 2020.04-at30: its boot count). The record moves
	  one register up -- w0 in LPGPR1, w1 in LPGPR2, w2 in LPGPR3 -- and
	  w3 is not stored; a reader writes the selector there too (w0 = 0,
	  w1 = 0x5345 << 16 | index) and puts LPGPR0 back as it found it.

	  That is the Verdin's boot firmware. Other boot loaders do use the
	  LPGPRs -- the Armadillo-X2's U-Boot keeps its boot count in LPGPR0
	  -- and such a board turns this off in its Kconfig.defconfig.

config GC_COMMON_RESULT_STAGES
	bool "Leave a breadcrumb in the result record at every boot and sample stage"
	depends on GC_COMMON_RESULT_SNVS
	help
	  For a board with no UART that dies before its result record
	  (docs/notes/imx8mp-netboot.md, "Board run
	  2026-10-03": the first gc_gl_triangle run from U-Boot left only the
	  WDOG1 arming breadcrumb). Writes a kind STAGE record (gc_result.h,
	  which lists the stages) at the PRE_KERNEL_1, PRE_KERNEL_2 and
	  POST_KERNEL driver boundaries, around the panel console's two stages,
	  at each sub-step of the GPU device init and at the sample's own stages
	  (gc_gl_triangle). Each is a breadcrumb: dropped once a result record
	  is stored and never counted in the record's sequence number, so an
	  image that reaches its verdict leaves the same record as without this.
	  Each costs five register writes to the SNVS.

endif # YAKOGL_GC_BOARD
```
