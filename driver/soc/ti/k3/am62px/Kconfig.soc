## driver/zephyr/lib/board/nanopc_t6/Kconfig
```kconfig
# SPDX-License-Identifier: Apache-2.0
# SPDX-FileCopyrightText: 2026 Signal Slot, Inc.
# The NanoPC-T6 board glue (nanopc_t6.c over driver/rust's ip::dw_wdt,
# soc::rk3588 and aarch64): every image built for the board has it, so no
# image can run without its bounded watchdog.

config YAKOGL_NANOPC_T6
	def_bool BOARD_NANOPC_T6
	select YAKOGL_DRV_DISPLAY_RUST
	help
	  The early banner (raw T6:A/A1/A2/A3 lines on uart2 before the
	  console, T6:X for an exception taken to EL2) and HCR_EL2 at entry;
	  WDT0 (the DesignWare APB watchdog at 0xfeaf0000) armed at
	  PRE_KERNEL_1 and fed from a timer for a bounded time; the GICv3 CPU
	  interface put back into its reset EOI mode at EARLY; and
	  t6_reset_to_linux() (nanopc_t6.h), the end of a run: PSCI
	  SYSTEM_RESET, with WDT0 behind it. YAKOGL_DRV_DISPLAY_RUST is the switch
	  that builds the yakogl-drivers crate (driver/zephyr/CMakeLists.txt,
	  feature rk3588).

if YAKOGL_NANOPC_T6

config YAKOGL_NANOPC_T6_VHE_EXIT
	bool "Write HCR_EL2 := RW at entry (leave Linux's VHE state)"
	default y
	help
	  Armbian's Linux runs at EL2 with VHE, and its kexec enters the
	  image with HCR_EL2.E2H (and FMO) still set. Zephyr's
	  z_arm64_el2_init keeps both, writes CNTHCTL_EL2 in the E2H=0
	  layout, and EL1's first physical-timer write in z_arm64_el1_init
	  then traps to EL2, where nothing of the image's is: the first jump
	  on 2026-10-19 printed nothing (driver/rust/src/aarch64.rs). With
	  this, the image's first code writes HCR_EL2 = RW only, as Linux's
	  own entry writes a whole HCR_EL2. n keeps Linux's value: the A/B
	  arm that shows the failure (T6:A with E2H set, then T6:X).

config YAKOGL_NANOPC_T6_WDT_TOP
	int "WDT0 period: TOP (period = 2^(16 + TOP) / 24 MHz)"
	default 13
	range 11 15
	help
	  11: 5.6 s, 12: 11.2 s, 13: 22.4 s, 14: 44.7 s, 15: 89.5 s. The
	  board resets at most one period after the feeding stops. Below 11
	  a missed tick of the 1 s feeder would already reset the board.

config YAKOGL_NANOPC_T6_LIFETIME_S
	int "Seconds of uptime the watchdog is fed at most"
	default 60
	range 10 3600
	help
	  After this nothing feeds WDT0 and the board resets within one
	  period, also when the image hangs or faults. The run must end
	  before it (t6_reset_to_linux()).

config YAKOGL_NANOPC_T6_ALIVE_S
	int "Seconds between two t6_watchdog_feed() calls at most"
	default 5
	range 1 600
	help
	  Once the sample has called t6_watchdog_feed(), a longer gap stops
	  the feeding, so a stuck sample is reset long before the lifetime.

config YAKOGL_NANOPC_T6_WDT_PROOF
	bool "Proof: arm WDT0 and never feed it"
	help
	  The measurement of the reset path itself: WDT0 is armed and not
	  fed, and t6_reset_to_linux() waits for it instead of calling PSCI.
	  A software backstop (PSCI SYSTEM_RESET) fires 10 s after one period
	  and prints "t6: proof FAILED" first.

endif # YAKOGL_NANOPC_T6
```

## driver/zephyr/lib/board/stm32mp2/Kconfig
```kconfig
# SPDX-License-Identifier: Apache-2.0
# SPDX-FileCopyrightText: 2026 Signal Slot, Inc.
# The STM32MP257F-DK's Cortex-A35 board layer, its core (stm32mp2.c): outside
# the board layer YAKOGL_BOARD, as YAKOGL_NANOPC_T6 is.

config YAKOGL_STM32MP2
	bool "STM32MP257F-DK A35: early banner, hand-over record, PSCI reset at the end"
	default y
	depends on SOC_SERIES_STM32MP2X_A35
	help
	  The early banner (raw MP2:A/A1 lines on USART2 before the
	  console), the hand-over record line (what the previous stage left:
	  EL, SCTLR M/C/I, x0-x3 with the DTB pointer, the entry address,
	  CNTFRQ_EL0, MPIDR_EL1, PSCI_VERSION), and
	  mp2_reset_to_linux() (stm32mp2.h), the end of a run: PSCI
	  SYSTEM_RESET. A fatal error and the end of the lifetime take the
	  same way out.

config YAKOGL_STM32MP2_LIFETIME_S
	int "Seconds of uptime after which the layer resets the board through PSCI"
	default 20
	range 5 3600
	depends on YAKOGL_STM32MP2
	help
	  The run must end before it (mp2_reset_to_linux()). A timer of the
	  system clock: it does not cover a hang with interrupts locked, or
	  one before the kernel runs; the OP-TEE watchdog does, once the layer
	  arms it.

config YAKOGL_STM32MP2_WDOG
	bool "STM32MP257F-DK A35: arm OP-TEE's watchdog (arm,smc-wdt) at boot and feed it"
	default n
	depends on YAKOGL_STM32MP2
	help
	  stm32mp2_wdog.c: SET_TIMEOUT 32, ENABLE 1, PET at PRE_KERNEL_1 0
	  over SMC (function id 0xbc000000, ST's arm,smc-id), the line
	  "gc_wdog_arm: armed" (the literal tools/board.sh requires) at 99,
	  or on a refusal what refused and PSCI SYSTEM_RESET at once, and a
	  1 s PET until the lifetime. Off by default; an image asks for it
	  (tools/probes/stm32mp257f_dk/mp2_identify).

config YAKOGL_STM32MP2_GPU
	bool "STM32MP257F-DK A35: the GPU power C ABI (stm32mp2_gpu.h) in libyakogl_drivers.a"
	default y if YAKOGL_DRV_GPU_VIVANTE
	depends on YAKOGL_STM32MP2
	select YAKOGL_DRV_DISPLAY_RUST
	help
	  The yakogl-drivers crate is built with the features stm32mp2 and
	  vivante (driver/zephyr/CMakeLists.txt) and linked: one archive for
	  the image, whether the Vivante driver is in it (gc_fence, gc_clear:
	  on by default with it) or not (the mp2_gpu probe asks for it). With
	  the driver, gc_power_mp2.c powers the GPU for it (gc_board_power_on:
	  SCMI over OP-TEE, every message on the console, the RCC gate and
	  reset), and refuses a part that is not model 0x8000 revision 0x6205
	  (#1281) with a PSCI reset.

config YAKOGL_BOARD_STM32MP2
	def_bool YAKOGL_BOARD && YAKOGL_STM32MP2
	help
	  The board layer (yakogl_board.h) on the DK's A35
	  (board_stm32mp2.c): no window or screen yet; record: the
	  yk-record line on USART2; reset: mp2_reset_to_linux() (PSCI
	  SYSTEM_RESET), the watchdog OP-TEE's (YAKOGL_STM32MP2_WDOG).
```
