## driver/zephyr/lib/board/am62p/Kconfig
```kconfig
# SPDX-License-Identifier: Apache-2.0
# SPDX-FileCopyrightText: 2026 Signal Slot, Inc.
# Board glue shared by the Zephyr samples: what to do after the drawing.
# (The RTI watchdog a kexec entry inherits is fed by the SafeUI SoC layer:
# CONFIG_SOC_AM62PX_A53_FEED_INHERITED_WDT.)

menu "PowerVR sample board glue"

config YAKOGL_SAMPLE_HOLD_SECONDS
	int "Seconds to keep the picture on screen before finishing"
	default 0

config YAKOGL_SAMPLE_REBOOT
	bool "Reset the SoC when done (back to the boot loader and its default OS)"
	depends on REBOOT
	default y if YAKOGL_BOARD_AM62P
	help
	  Also resets on a fatal error instead of halting, so a board without a
	  reset button at hand always comes back.

config YAKOGL_SAMPLE_BOOT_TRACE
	bool "Print a line per POST_KERNEL init priority band (locates a hang in a driver init)"

config YAKOGL_AM62P_WDT_SECONDS
	int "AM62P: seconds the image keeps the RTI watchdog fed, whichever feeder runs"
	depends on SOC_SERIES_AM62PX_A53
	default YAKOGL_BOARD_LIFETIME_S if YAKOGL_BOARD
	default 0
	range 0 3600
	help
	  The image's bound: after it the RTI is left alone and resets the SoC
	  within 60 s, so a hung image comes back by itself. Set it in the
	  sample's board .conf (150 gl_test, 200 gl_slint, 600 deqp). It feeds
	  the SafeUI feeder's bound (SOC_AM62PX_A53_FEED_INHERITED_WDT_SECONDS,
	  through the configdefault below) and YAKOGL_AM62P_RTI_SELF_ARM's, so
	  a netboot image that turns the SafeUI feeder off assigns nothing that
	  feeder owns. 0 leaves the SafeUI default (feed for ever).

configdefault SOC_AM62PX_A53_FEED_INHERITED_WDT_SECONDS
	default YAKOGL_AM62P_WDT_SECONDS if YAKOGL_AM62P_WDT_SECONDS != 0

config YAKOGL_AM62P_RTI_SELF_ARM
	bool "AM62P: arm the MAIN RTI0 watchdog when no earlier stage did, feed it for a bounded time"
	depends on SOC_SERIES_AM62PX_A53 && TISCI && REBOOT
	depends on !SOC_AM62PX_A53_FEED_INHERITED_WDT
	depends on YAKOGL_AM62P_WDT_SECONDS != 0
	help
	  For an image entered from U-Boot with "go" (docs/standalone-boot.md,
	  "What the image does on a go entry"): that U-Boot starts no watchdog,
	  so without this a hang holds the board until the power is cut. On a
	  kexec entry the RTI is already running and this only feeds it.
	  Replaces the SafeUI feeder (SOC_AM62PX_A53_FEED_INHERITED_WDT, which
	  must be off): that one reads the RTI before any TISCI power-on. Feeds
	  for YAKOGL_AM62P_WDT_SECONDS. Refuses (resets the SoC at once) when it
	  cannot arm the RTI for 60 s. Logs "rti_arm: armed", the literal
	  tools/board.sh requires before it boots an image.

config YAKOGL_AM62P_RTI_PROOF
	bool "AM62P: RTI proof image: arm, never feed, software reset as a backstop"
	depends on YAKOGL_AM62P_RTI_SELF_ARM
	help
	  For the netboot plan's step B only: proves on the board that the
	  RTI this image arms really resets the SoC. The RTI should reset it
	  about 60 s after "rti_arm: armed". If the image is still alive after
	  YAKOGL_AM62P_RTI_PROOF_BACKSTOP_SECONDS, it logs "rti_arm: proof
	  FAILED" and resets by software. Build it with YAKOGL_SAMPLE_REBOOT=n, or
	  the sample's own reset at its end can come first and prove nothing.

config YAKOGL_AM62P_RTI_PROOF_BACKSTOP_SECONDS
	int "Seconds after arming before the proof image resets by software"
	depends on YAKOGL_AM62P_RTI_PROOF
	default 90
	range 65 600

config YAKOGL_AM62P_RTI_SELF_ARM_INIT_PRIORITY
	int "POST_KERNEL priority of the arming (after TISCI)"
	depends on YAKOGL_AM62P_RTI_SELF_ARM
	default 47

config YAKOGL_SAMPLE_SHOW_ON_DSS
	bool "Show a buffer through the SafeUI AM62P DSS driver (application plane)"
	default y
	depends on YAKOGL_DRV_DSS_AM62P

config YAKOGL_BOARD_DISPLAY_BUSY
	def_bool YAKOGL_BOARD_AM62P && YAKOGL_SAMPLE_SHOW_ON_DSS
	help
	  The board layer answers the OSAL's display_busy (gles_osal.h):
	  board_display_busy() says which window buffers the DSS application
	  plane may still scan, so EGL keeps four buffers and never draws into
	  one the panel scans (docs/notes/am62p-flip-latch.md). Set by the
	  board; nothing to choose.

config YAKOGL_SAMPLE_DISPLAY_DUMP
	bool "Print the display path's registers with the DSS counters (diagnosis)"
	depends on YAKOGL_SAMPLE_SHOW_ON_DSS
	help
	  Before and after the hold, print the DSS1, DSI, wrapper and D-PHY
	  registers of driver/docs/am62p-display-cold.md's read list in the
	  format of driver/docs/am62p-display-dump-linux.txt, plus the
	  SN65DSI8x's IRQ_STAT, so a board run can be diffed against the dump
	  taken while Linux drove the panel. Reads only.

config YAKOGL_SAMPLE_DISPLAY_FILL
	hex "Fill the DSS safety layer with this opaque ARGB8888 colour before the hold (diagnosis)"
	depends on YAKOGL_SAMPLE_SHOW_ON_DSS
	default 0x0
	help
	  0 does nothing. Otherwise, before the hold, the whole safety layer
	  (the DSS driver's own VIDL1 plane, above the application plane) is
	  filled with this colour by the CPU, flipped in, and the video port is
	  enabled; the colour must then cover the panel whatever the GPU and
	  the application plane did. A known-colour fill is the first step of
	  a black-panel diagnosis: it separates "nothing reaches the panel"
	  (the DSS/DSI/bridge path) from "the application plane is not shown"
	  (buffer, format, plane enable). 0xffff0000 is opaque red.

endmenu
```
