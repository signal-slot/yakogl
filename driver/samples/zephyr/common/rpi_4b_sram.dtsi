/* SPDX-License-Identifier: Apache-2.0 */
/* SPDX-FileCopyrightText: 2026 Signal Slot, Inc. */
/*
 * Zephyr's rpi_4b takes zephyr,sram from dram0 (boards/raspberrypi/rpi_4b/
 * rpi_4b.dts: 8 MiB at 0x200000), where it used to take it from the SoC's
 * sram0 (dts/arm64/broadcom/bcm2711.dtsi: 512 KiB at 0x200000, the same
 * address). Each Pi 4 sample's boards/rpi_4b.overlay sizes sram0 for what the
 * image carries (the V3D's 48 MiB carve-out, the compiler's scratch, ...), so
 * the image's RAM has to be sram0 again: include this file from the overlay,
 * before the `&sram0 { reg = ...; };` that sizes it. Without it the link stops
 * with "region `RAM' overflowed" at the 8 MiB of dram0.
 */
/ {
	chosen {
		zephyr,sram = &sram0;
	};
};

/*
 * One mailbox client, not two: the rpi_4b board of the Zephyr this repository
 * pins (west.yml, af17c0c8) enables &mbox0 and /firmware (rpi_fw), whose ISR
 * drains every reply from MAIL0 while our rpi_mbox.c polls MAIL0 for it, so
 * every call of ours timed out (-116: no framebuffer, no V3D clock raise).
 * The lasting form is rpi_mbox.c on Zephyr's rpi_fw API (tools/cts/RESULTS.md,
 * Work list); until then Zephyr's side stays off.
 */
&mbox0 {
	status = "disabled";
};

/ {
	firmware {
		status = "disabled";
	};
};
