## CMakeLists.txt
```
# SPDX-License-Identifier: Apache-2.0
# SPDX-FileCopyrightText: 2026 Signal Slot, Inc.
# slint: the one Slint sample for the Raspberry Pi 4, the Verdin AM62P and
# the Verdin iMX8M Plus (driver/docs/one-method.md, section 5, step 1). The
# board is chosen by the Zephyr board (-b) only; there is no per-board option
# here. What differs per board is the board layer's
# (driver/zephyr/lib/board, CONFIG_YAKOGL_BOARD) and the board files under
# boards/.
#
# What is shared, by path:
#   - the UI, ui/cluster.slint (moved here from gl_slint in Step 1),
#     with the SafeUI layout for 1024x600 (../safeui_dir.cmake) on every board;
#   - the no_std Slint workspace (SLINT_NOSTD_DIR) and the femtovg/glow forks
#     (NOSTD_PATCH_DIR), recreated from nostd/'s patches (nostd/README.md);
#   - the check, ./check (crate yakogl-slint-check, host-tested by
#     tools/check.sh), and through it driver/rust/src/board/record.rs.
cmake_minimum_required(VERSION 3.20.0)

get_filename_component(PVR_REPO "${CMAKE_CURRENT_SOURCE_DIR}/../../.." ABSOLUTE)
include("${CMAKE_CURRENT_SOURCE_DIR}/../common/yakogl_dir.cmake")

find_package(Zephyr REQUIRED HINTS $ENV{ZEPHYR_BASE})
project(slint)

target_sources(app PRIVATE src/main.c)

# ---------------------------------------------------------------------------
# The no_std Slint workspace and the femtovg/glow forks.
# ---------------------------------------------------------------------------
foreach(var SLINT_NOSTD_DIR NOSTD_PATCH_DIR)
  if(NOT ${var} AND DEFINED ENV{${var}})
    set(${var} "$ENV{${var}}")
  endif()
endforeach()
if(NOT SLINT_NOSTD_DIR OR NOT EXISTS "${SLINT_NOSTD_DIR}/internal/renderers/femtovg/Cargo.toml")
  message(FATAL_ERROR
    "slint: SLINT_NOSTD_DIR='${SLINT_NOSTD_DIR}' is not the no_std Slint workspace. "
    "Recreate it as nostd/README.md says and pass -DSLINT_NOSTD_DIR=<path>.")
endif()
if(NOT NOSTD_PATCH_DIR)
  get_filename_component(NOSTD_PATCH_DIR "${SLINT_NOSTD_DIR}/../nostd" ABSOLUTE)
endif()
if(NOT EXISTS "${NOSTD_PATCH_DIR}/femtovg/Cargo.toml" OR NOT EXISTS "${NOSTD_PATCH_DIR}/glow/Cargo.toml")
  message(FATAL_ERROR
    "slint: NOSTD_PATCH_DIR='${NOSTD_PATCH_DIR}' must hold the no_std femtovg/ and "
    "glow/ forks (nostd/README.md). Pass -DNOSTD_PATCH_DIR=<path>.")
endif()

# The AM62P's 1024x600 layout on every board: the window is 1024x600 on all
# three panels, and the reference points are the AM62P's.
include("${CMAKE_CURRENT_SOURCE_DIR}/../safeui_dir.cmake")
safeui_layout_dir(SAFEUI_LAYOUT_DIR SAFEUI_ROOT_DIR 1024x600)

# ---------------------------------------------------------------------------
# The Rust staticlib (rust/): built for aarch64-unknown-none (release) with
# -Z build-std=core,alloc, and linked whole.
# ---------------------------------------------------------------------------
find_program(CARGO cargo REQUIRED)
set(UI_DIR "${CMAKE_CURRENT_SOURCE_DIR}/ui")
set(SLINT_UI_FILE "${UI_DIR}/cluster.slint")
set(CARGO_SRC "${CMAKE_CURRENT_SOURCE_DIR}/rust")
set(SLINT_CHECK_DIR "${CMAKE_CURRENT_SOURCE_DIR}/check")
set(cargo_build_dir "${CMAKE_CURRENT_BINARY_DIR}/rust")
set(cargo_target_dir "${cargo_build_dir}/target")
set(RUST_TARGET aarch64-unknown-none)
set(slint_staticlib "${cargo_target_dir}/${RUST_TARGET}/release/libslint_sample.a")
file(MAKE_DIRECTORY "${cargo_build_dir}")
configure_file("${CARGO_SRC}/Cargo.toml.in" "${cargo_build_dir}/Cargo.toml" @ONLY)

file(GLOB_RECURSE slint_rust_srcs CONFIGURE_DEPENDS
     "${CARGO_SRC}/src/*.rs"
     "${CARGO_SRC}/build.rs"
     "${SLINT_CHECK_DIR}/src/*.rs"
     "${PVR_REPO}/rust/src/board/record.rs"
     "${UI_DIR}/*.slint"
     "${SAFEUI_LAYOUT_DIR}/*.slint"
     "${UI_DIR}/assets/*"
     "${SLINT_NOSTD_DIR}/internal/renderers/femtovg/*.rs"
     "${SLINT_NOSTD_DIR}/internal/core/*.rs"
     "${NOSTD_PATCH_DIR}/femtovg/src/*.rs"
     "${NOSTD_PATCH_DIR}/femtovg/src/*.glsl"
     "${NOSTD_PATCH_DIR}/glow/src/*.rs")

add_custom_command(
  OUTPUT "${slint_staticlib}"
  COMMAND ${CMAKE_COMMAND} -E env
          "CARGO_TARGET_DIR=${cargo_target_dir}"
          "SLINT_UI_FILE=${SLINT_UI_FILE}"
          "SAFEUI_LAYOUT_DIR=${SAFEUI_LAYOUT_DIR}"
          ${CARGO} build --release
          -Z build-std=core,alloc
          --target ${RUST_TARGET}
          --manifest-path "${cargo_build_dir}/Cargo.toml"
  DEPENDS ${slint_rust_srcs} "${cargo_build_dir}/Cargo.toml"
  WORKING_DIRECTORY "${cargo_build_dir}"
  COMMENT "cargo build slint_sample (${RUST_TARGET}, release)"
  VERBATIM)
add_custom_target(slint_sample_build DEPENDS "${slint_staticlib}")
add_dependencies(app slint_sample_build)
target_link_libraries(app PRIVATE "${slint_staticlib}")
```

## prj.conf
```kconfig
# SPDX-License-Identifier: Apache-2.0
# SPDX-FileCopyrightText: 2026 Signal Slot, Inc.
# The one Slint sample: the same configuration on every board. What a board
# needs beyond it (its GPU driver, display path, memory) is in boards/,
# selected by the Zephyr board; the window, the screen, the watchdog, the
# records and the end of the run are the board layer's (yakogl_board.h).
CONFIG_YAKOGL=y
CONFIG_YAKOGL_BOARD=y
# The in-process shader compiler on every board (the offline table is being
# retired; the V3D has no other back end).
CONFIG_YAKOGL_SHADERC_ONLINE=y

CONFIG_PRINTK=y
CONFIG_LOG=y
CONFIG_LOG_MODE_MINIMAL=y
CONFIG_CACHE_MANAGEMENT=y

# Slint's gauge geometry and FemtoVG's tessellation are float work; the Rust
# archive is hard-float.
CONFIG_FPU=y

# Slint layout and FemtoVG path flattening have deep call chains and the item
# tree renders recursively; the online compiler needs 256 KiB too.
CONFIG_MAIN_STACK_SIZE=262144
CONFIG_STACK_SENTINEL=y

# Slint and FemtoVG allocate from the UI heap in src/main.c (a sys_heap); the
# C heap holds glShaderSource's copies only.
CONFIG_COMMON_LIBC_MALLOC=y
CONFIG_COMMON_LIBC_MALLOC_ARENA_SIZE=1048576
```

## boards/rpi_4b.conf
```kconfig
# SPDX-License-Identifier: Apache-2.0
# SPDX-FileCopyrightText: 2026 Signal Slot, Inc.
# Raspberry Pi 4: what the board needs for this sample beyond prj.conf, from
# v3d_gl_slint/prj.conf. Moves into the board layer once it carries the Pi
# 4's defaults (one-method.md section 2).
CONFIG_YAKOGL_GPU_V3D=y
# 48 MiB of GPU memory (a static of the image; see rpi_4b.overlay).
CONFIG_YAKOGL_V3D_CARVEOUT_BYTES=50331648
CONFIG_FPU_SHARING=y
# Address space: the image (144 MiB, the overlay), the carve-out's
# non-cacheable alias (48 MiB), the framebuffer and the device blocks.
CONFIG_MAX_XLAT_TABLES=64
CONFIG_KERNEL_VM_SIZE=0x10000000
```

## boards/verdin_am62p_am62p54_a53.conf
```kconfig
# SPDX-License-Identifier: Apache-2.0
# SPDX-FileCopyrightText: 2026 Signal Slot, Inc.
# Verdin AM62P: what the board needs for this sample beyond prj.conf, from
# gl_slint/boards/verdin_am62p_am62p54_a53.conf without its sample and
# watchdog options (those are the board layer's now). Moves into the board
# layer once it carries the AM62P's defaults (one-method.md section 2).
CONFIG_SAFEUI_GPU_PVR=y
CONFIG_FPU_SHARING=y

# Init order: mailbox 40 -> TISCI 45 -> TISCI power-on 46 -> GPIO 47 ->
# I2C 50 -> DSI 70 -> DSS 80 -> GPU 90 -> panel bridge 95.
CONFIG_MBOX=y
CONFIG_MBOX_TI_SECURE_PROXY=y
CONFIG_TISCI=y
CONFIG_TISCI_INIT_PRIORITY=45
CONFIG_GPIO_INIT_PRIORITY=47
CONFIG_SAFEUI_SN65DSI8X_SELF_START_INIT_PRIORITY=95
```

## boards/verdin_am62p_am62p54_a53_direct.conf
```kconfig
# Verdin AM62P started by the A53 SPL at power-on, in place of U-Boot proper
# (board verdin_am62p/am62p54/a53/direct, docs/direct-boot.md): the route
# gl_slint's boards/verdin_am62p_am62p54_a53_direct.conf carried until Step 1
# deleted gl_slint (driver/docs/one-method.md section 5). The board's
# devicetree has the display path on, so there is no overlay: bring the DSI
# panel up from cold, draw and check the cluster, animate it, hold the last
# frame, then reset, which boots this image again (each reset is another
# boot-time sample). The lines of verdin_am62p_am62p54_a53.conf are repeated
# here: Zephyr reads only the file of the exact board name.
CONFIG_SAFEUI_GPU_PVR=y
CONFIG_FPU_SHARING=y

# the run: 60 s of animation, 20 s on screen, then the reset (the board
# layer's board_finish; PVR_SAMPLE_REBOOT defaults on the AM62P)
CONFIG_YAKOGL_BOARD_ANIMATE_S=60
CONFIG_YAKOGL_BOARD_HOLD_S=20
CONFIG_REBOOT=y
# The time since the R5 SPL started the GTC, at main() and at the first frame.
CONFIG_PVR_SAMPLE_BOOT_TIME=y

# Nothing started the RTI watchdog on this route: arm it here and feed it past
# the run (200 s), so a hung image is reset by it.
CONFIG_YAKOGL_BOARD_LIFETIME_S=200
CONFIG_YAKOGL_AM62P_RTI_SELF_ARM=y

# Init order: mailbox 40 -> TISCI 45 -> TISCI power-on 46 -> GPIO 47 ->
# RTI arm 47 -> I2C 50 -> DSI 70 -> DSS 80 -> GPU 90 -> panel bridge 95.
CONFIG_MBOX=y
CONFIG_MBOX_TI_SECURE_PROXY=y
CONFIG_TISCI=y
CONFIG_TISCI_INIT_PRIORITY=45
CONFIG_GPIO_INIT_PRIORITY=47
CONFIG_SAFEUI_SN65DSI8X_SELF_START_INIT_PRIORITY=95
```

## boards/verdin_imx8mp_mimx8ml8_a53.conf
```kconfig
# SPDX-License-Identifier: Apache-2.0
# SPDX-FileCopyrightText: 2026 Signal Slot, Inc.
# Verdin iMX8M Plus (Mallow): what the board needs for this sample beyond
# prj.conf, from gc_slint/prj.conf without its sample options. Moves into
# the board layer once it carries the i.MX8MP's defaults (one-method.md
# section 2).
CONFIG_SAFEUI_GPU_VIVANTE=y
CONFIG_YAKOGL_GPU_VIVANTE=y
# FPU sharing off on purpose: with it on, printk from an interrupt handler
# spills argument registers through the FPU, which is disabled in exception
# context on arm64 (gc_slint/prj.conf).
CONFIG_FPU_SHARING=n
# No UART on the Mallow: the console is the board layer's panel console.
CONFIG_UART_CONSOLE=n
# The display chain (the LCDIF scans the window, imx8mp_display_on).
CONFIG_GPIO=y
CONFIG_I2C=y
CONFIG_PINCTRL=y
CONFIG_SAFEUI_DISPLAY_IMX8MP=y
# The reset at the end of a run goes through PSCI.
CONFIG_PM_CPU_OPS=y
CONFIG_PM_CPU_OPS_PSCI=y
```

## boards/rpi_4b.overlay
```dts
/* SPDX-License-Identifier: Apache-2.0 */
/* SPDX-FileCopyrightText: 2026 Signal Slot, Inc. */
/*
 * The board's sram0 is 512 KiB at 0x200000 (dts/arm64/broadcom/bcm2711.dtsi).
 * This image carries the V3D's 48 MiB carve-out, the compiler's 2 MiB
 * scratch and the 48 MiB UI heap as statics, so it gets 144 MiB from
 * 0x200000 (v3d_gl_triangle's 96 MiB plus the heap). DRAM starts at 0 on the
 * Pi 4 and the firmware keeps its own memory at the top of the first GiB (the
 * framebuffer is at 0x3c100000), so this is ARM memory on every Pi 4.
 */
#include "../../common/rpi_4b_sram.dtsi"

&sram0 {
	reg = <0x200000 0x9000000>;
};
```

## boards/verdin_am62p_am62p54_a53.overlay
```dts
/* SPDX-License-Identifier: Apache-2.0 */
/* SPDX-FileCopyrightText: 2026 Signal Slot, Inc. */
/* The display path of the Verdin AM62P, driven by this image. */
#include "../../common/verdin_am62p_display.dtsi"
```

## src/main.c
```c
/* SPDX-License-Identifier: Apache-2.0 */
/* SPDX-FileCopyrightText: 2026 Signal Slot, Inc. */
/*
 * slint: the one Slint sample, the same source on the Raspberry Pi 4 (V3D),
 * the Verdin AM62P (PowerVR) and the Verdin iMX8M Plus (GC7000)
 * (driver/docs/one-method.md, section 5, step 1). The board is chosen by
 * the Zephyr board only; everything that differs per board is behind
 * yakogl_board.h.
 *
 * This file is the thin part: the window from the board layer, EGL/GL
 * through YakoGL, the swaps, the screen and the records. The frames, the
 * vehicle and the check are Rust (rust/src/lib.rs, check/src/lib.rs):
 *
 *   board_window(1024, 600 + guard rows)  sentinel window, guard rows
 *   EGL up (RGBA8888 + stencil, ES 2)     the window's 1024x600 only
 *   slint_sample_first_frame()            demo_vehicle at t = 0, 2 frames
 *   eglSwapBuffers, board_show()
 *   slint_sample_check()                  the one check (5 points at
 *                                         tolerance 1, sentinel, alpha,
 *                                         guard rows, glReadPixels)
 *   CONFIG_YAKOGL_BOARD_ANIMATE_S of demo_vehicle frames, each shown
 *   board_result(FINGERPRINT), board_result_tag(PROBES)
 *   board_finish()
 *
 * The records are stored after the animation, not after the check: a run
 * that dies in the animation must not leave a PASS as its last record, and
 * board_progress() is dropped once a result was stored. PROBES is stored
 * last because the last record of a run is its verdict; FINGERPRINT is a
 * fingerprint, not a verdict. PROBES' status is the whole run's (the check
 * and the animation).
 */
#include <zephyr/kernel.h>
#include <zephyr/sys/printk.h>
#include <zephyr/sys/sys_heap.h>
#include <errno.h>
#include <stdint.h>
#include <string.h>

#include <EGL/egl.h>
#include <GLES2/gl2.h>

#include <yakogl_board.h>
#include <yakogl_record.h>

#define WIN_W 1024 /* the AM62P's panel; fits all three panels */
#define WIN_H 600
/* check/src/lib.rs: GUARD_ROWS, SENTINEL */
#define GUARD_ROWS 8u
#define SENTINEL   0x00000001u
/* The guard rows as they were before the first frame: read, never painted
 * (in a view they are on the screen, CONFIG_YAKOGL_BOARD_SCANOUT_VIEW). */
static uint32_t s_guard_before[GUARD_ROWS * WIN_W];

/* Where a run that died stopped (kind PROGRESS, YK_RECORD_WHERE_STAGE | n). */
enum stage {
	STAGE_WINDOW = 1,
	STAGE_EGL,
	STAGE_FIRST_FRAME,
	STAGE_SWAPPED,
	STAGE_CHECKED,
	STAGE_ANIMATING,
	STAGE_ANIMATED,
};

/* ---- what the Rust archive needs from C ---------------------------------- */

/* The UI heap (Slint, femtovg, the glyph textures): gl_slint's 48 MiB, a
 * sys_heap over a static arena. */
#define UI_HEAP_BYTES (48u * 1024u * 1024u)
static uint8_t s_ui_heap_mem[UI_HEAP_BYTES] __noinit __aligned(64);
static struct sys_heap s_ui_heap;

void *slint_heap_alloc(size_t alignment, size_t size)
{
	return sys_heap_aligned_alloc(&s_ui_heap, alignment, size);
}

void slint_heap_free(void *ptr)
{
	sys_heap_free(&s_ui_heap, ptr);
}

/* rust/src/lib.rs */
typedef const void *(*slint_get_proc_fn)(const char *name);
struct slint_sample_result {
	uint32_t status; /* YK_RECORD_STATUS_PASS / _FAIL */
	uint32_t probes[3];
	uint32_t fingerprint[3];
};
BUILD_ASSERT(sizeof(struct slint_sample_result) == 28, "rust/src/lib.rs SampleResult");
int slint_sample_first_frame(slint_get_proc_fn get_proc, uint32_t w, uint32_t h);
int slint_sample_animate_frame(slint_get_proc_fn get_proc, uint32_t w, uint32_t h, uint32_t t_ms,
			       uint32_t frame);
int slint_sample_check(const uint32_t *cpu, uint32_t w, uint32_t h, uint32_t stride, uint32_t guard_rows,
		       const uint32_t *guard_before, uint32_t format, struct slint_sample_result *out);

static const void *get_proc(const char *name)
{
	return (const void *)eglGetProcAddress(name);
}

/* ---- the run ------------------------------------------------------------- */

static struct board_window s_win; /* the window as EGL and the screen see it */
static EGLDisplay s_dpy;
static EGLSurface s_surf;
static struct slint_sample_result s_result;
static bool s_checked;

/* Each EGL call is checked on its own: eglGetError reports the LAST call. */
static int egl_fail(const char *call)
{
	printk("slint: %s failed: EGL error 0x%x\n", call, eglGetError());
	return -EIO;
}

static int egl_up(void)
{
	/* femtovg fills concave paths and strokes through the stencil */
	static const EGLint cfg_attribs[] = {
		EGL_RED_SIZE, 8, EGL_GREEN_SIZE, 8, EGL_BLUE_SIZE, 8, EGL_ALPHA_SIZE, 8,
		EGL_STENCIL_SIZE, 8, EGL_SURFACE_TYPE, EGL_WINDOW_BIT,
		EGL_RENDERABLE_TYPE, EGL_OPENGL_ES2_BIT, EGL_NONE,
	};
	static const EGLint ctx_attribs[] = { EGL_CONTEXT_CLIENT_VERSION, 2, EGL_NONE };
	static struct gles_native_window nw;
	EGLConfig cfg;
	EGLint n = 0;

	nw = (struct gles_native_window){
		.phys = s_win.phys, .width = s_win.w, .height = s_win.h,
		.stride_bytes = s_win.stride, .format = s_win.format,
	};
	/* every board: the Pi 4 board layer gives the V3D OSAL its clock
	 * switch through the OSAL's default-platform hook (db659a88) */
	s_dpy = eglGetDisplay(EGL_DEFAULT_DISPLAY);
	if (!eglInitialize(s_dpy, NULL, NULL))
		return egl_fail("eglInitialize");
	if (!eglChooseConfig(s_dpy, cfg_attribs, &cfg, 1, &n))
		return egl_fail("eglChooseConfig");
	if (n != 1) {
		printk("slint: eglChooseConfig: %d configs for RGBA8888 + stencil 8\n", n);
		return -ENOENT;
	}
	s_surf = eglCreateWindowSurface(s_dpy, cfg, &nw, NULL);
	if (s_surf == EGL_NO_SURFACE)
		return egl_fail("eglCreateWindowSurface");
	EGLContext ctx = eglCreateContext(s_dpy, cfg, EGL_NO_CONTEXT, ctx_attribs);
	if (ctx == EGL_NO_CONTEXT)
		return egl_fail("eglCreateContext");
	if (!eglMakeCurrent(s_dpy, s_surf, s_surf, ctx))
		return egl_fail("eglMakeCurrent");
	printk("slint: GL_RENDERER %s, GL_VERSION %s\n", (const char *)glGetString(GL_RENDERER),
	       (const char *)glGetString(GL_VERSION));
	return 0;
}

/* eglSwapBuffers submits the frame and waits for it; a GL error during the
 * frame is a failure (a refused draw logs its reason). */
static int swap(void)
{
	if (!eglSwapBuffers(s_dpy, s_surf))
		return egl_fail("eglSwapBuffers");
	GLenum err = glGetError();
	if (err != GL_NO_ERROR) {
		printk("slint: GL error 0x%x during the frame\n", err);
		return -EIO;
	}
	return 0;
}

static int window(void)
{
	struct board_window full;
	int ret = board_window(WIN_W, WIN_H + GUARD_ROWS, &full);

	if (ret) {
		printk("slint: board_window(%u, %u) = %d\n", WIN_W, WIN_H + GUARD_ROWS, ret);
		return ret;
	}
	/* w * 4, or the scan-out buffer's pitch when the window is a view into
	 * it (CONFIG_YAKOGL_BOARD_SCANOUT_VIEW): handed to EGL as is */
	if (full.stride < WIN_W * 4u || full.stride % 4u != 0u) {
		printk("slint: board_window gave stride %u, not whole pixels of at least %u\n", full.stride,
		       WIN_W * 4u);
		return -EINVAL;
	}
	/* The window's rows start with the sentinel (near black, alpha 0:
	 * nothing a user sees in a view), WIN_W pixels a row at the stride; the
	 * guard rows after them are read into s_guard_before and never
	 * written, and a view's padding is the screen's and never touched.
	 * The snapshot is taken here: after board_window() returned, which is
	 * after every write the board layer makes to that memory (the i.MX8MP
	 * view's zeroing and the Pi 4 view's console move happen inside it; the
	 * AM62P and the copy paths write nothing there), and before egl_up()
	 * and the first GL frame. A console printk after this point goes beside
	 * the window on the Pi 4 view, never into these rows.
	 * Through the CPU's view (Normal non-cacheable on every board,
	 * yakogl_board.h: no cache maintenance). */
	for (uint32_t y = 0; y < WIN_H + GUARD_ROWS; y++) {
		uint32_t *row = (uint32_t *)((uint8_t *)full.cpu + (size_t)y * full.stride);

		if (y < WIN_H) {
			for (uint32_t x = 0; x < WIN_W; x++)
				row[x] = SENTINEL;
		} else {
			memcpy(&s_guard_before[(y - WIN_H) * WIN_W], row, WIN_W * 4u);
		}
	}
	s_win = full;
	s_win.h = WIN_H; /* EGL and the screen get the window, not the guard rows */
	printk("slint: window %ux%u at phys 0x%lx, stride %u, format 0x%x, %u guard rows\n", s_win.w,
	       s_win.h, (unsigned long)s_win.phys, s_win.stride, s_win.format, GUARD_ROWS);
	return 0;
}

static void show(void)
{
	static bool reported;
	int ret = board_show(&s_win);

	/* the check reads the window, not the screen: go on, say it once */
	if (ret && !reported) {
		printk("slint: board_show = %d (the window is not on the screen)\n", ret);
		reported = true;
	}
}

static int first_frame_and_check(void)
{
	int ret;

	board_progress(YK_RECORD_WHERE_STAGE | STAGE_FIRST_FRAME);
	ret = slint_sample_first_frame(get_proc, WIN_W, WIN_H);
	if (ret)
		return ret;
	ret = swap();
	if (ret)
		return ret;
	board_progress(YK_RECORD_WHERE_STAGE | STAGE_SWAPPED);
	show();
	ret = slint_sample_check(s_win.cpu, WIN_W, WIN_H, s_win.stride / 4u, GUARD_ROWS, s_guard_before,
				 s_win.format, &s_result);
	s_checked = ret >= 0;
	board_progress(YK_RECORD_WHERE_STAGE | STAGE_CHECKED);
	return ret;
}

static int animate(void)
{
	const int64_t bound_ms = (int64_t)CONFIG_YAKOGL_BOARD_ANIMATE_S * 1000;
	int64_t t0 = k_uptime_get(), now;
	uint32_t frame = 1;
	int ret = 0;

	board_progress(YK_RECORD_WHERE_STAGE | STAGE_ANIMATING);
	while ((now = k_uptime_get() - t0) < bound_ms) {
		ret = slint_sample_animate_frame(get_proc, WIN_W, WIN_H, (uint32_t)now, frame);
		if (ret == 0)
			ret = swap();
		if (ret)
			break;
		show();
		board_watchdog_feed();
		frame++;
	}
	now = k_uptime_get() - t0;
	printk("slint: animation: %u frames in %lld ms%s\n", frame - 1, (long long)now,
	       ret ? " (stopped by a failure)" : "");
	board_progress(YK_RECORD_WHERE_STAGE | STAGE_ANIMATED);
	return ret;
}

int main(void)
{
	int rc;

	sys_heap_init(&s_ui_heap, s_ui_heap_mem, sizeof(s_ui_heap_mem));
	printk("slint: the cluster at %ux%u, then %d s of animation\n", WIN_W, WIN_H,
	       CONFIG_YAKOGL_BOARD_ANIMATE_S);
	board_progress(YK_RECORD_WHERE_STAGE | STAGE_WINDOW);
	rc = window();
	if (rc == 0) {
		board_progress(YK_RECORD_WHERE_STAGE | STAGE_EGL);
		rc = egl_up();
	}
	if (rc == 0)
		rc = first_frame_and_check();
	if (rc == 0)
		rc = animate();
	if (s_checked) {
		board_result(YK_RECORD_KIND_FINGERPRINT, s_result.fingerprint[0],
			     s_result.fingerprint[1], s_result.fingerprint[2]);
		board_result_tag(YK_RECORD_KIND_PROBES,
				 rc == 0 ? YK_RECORD_STATUS_PASS : YK_RECORD_STATUS_FAIL,
				 s_result.probes[0], s_result.probes[1], s_result.probes[2]);
	}
	board_finish("slint", rc);
}
```
