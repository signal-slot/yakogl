## CMakeLists.txt
```
# SPDX-License-Identifier: Apache-2.0
# SPDX-FileCopyrightText: 2026 Signal Slot, Inc.
cmake_minimum_required(VERSION 3.20.0)

# The driver (repository root) is a Zephyr module; point ZEPHYR_EXTRA_MODULES
# at it unless a west manifest lists it.
get_filename_component(PVR_REPO "${CMAKE_CURRENT_SOURCE_DIR}/../../.." ABSOLUTE)
list(APPEND ZEPHYR_EXTRA_MODULES "${PVR_REPO}")

# The shared sample shape (bounded watchdog service, PASS/FAIL, PSCI reset).
set(ENV{GC_SAMPLE_COMMON_KCONFIG} "${CMAKE_CURRENT_SOURCE_DIR}/../gc_common/Kconfig")

find_package(Zephyr REQUIRED HINTS $ENV{ZEPHYR_BASE})
project(gc_identify)

include("${CMAKE_CURRENT_SOURCE_DIR}/../gc_common/gc_sample.cmake")
target_sources(app PRIVATE src/main.c)
```

## Kconfig
```
# SPDX-License-Identifier: Apache-2.0
# SPDX-FileCopyrightText: 2026 Signal Slot, Inc.
mainmenu "gc_identify"

source "$(GC_SAMPLE_COMMON_KCONFIG)"
source "Kconfig.zephyr"
```

## prj.conf
```kconfig
# SPDX-License-Identifier: Apache-2.0
# SPDX-FileCopyrightText: 2026 Signal Slot, Inc.
CONFIG_SAFEUI_GPU_VIVANTE=y
CONFIG_SAFEUI_GPU_VIVANTE_LOG_LEVEL_DBG=y

CONFIG_LOG=y
CONFIG_CACHE_MANAGEMENT=y

# The console is the DSI panel: this carrier has no reachable UART, so printk
# is rendered into the framebuffer Linux left scanning out (gc_common).
# LOG_MODE_MINIMAL sends LOG_* through printk; the board defconfig turns the
# UART console on, and only prj.conf can turn it back off.
CONFIG_GC_COMMON_PANEL_CONSOLE=y
# ... and when Linux left the panel off (the normal kexec route), turn it on
# ourselves. The bridge is on I2C behind a GPIO, so the display driver needs
# both subsystems; without them CONFIG_SAFEUI_DISPLAY_IMX8MP compiles out and
# only the adopt path is left.
CONFIG_I2C=y
CONFIG_GPIO=y
CONFIG_PINCTRL=y
CONFIG_SAFEUI_DISPLAY_IMX8MP=y
CONFIG_LOG_MODE_MINIMAL=y
CONFIG_UART_CONSOLE=n

# The way back to Linux: reset the SoC through PSCI when done.
CONFIG_REBOOT=y
CONFIG_PM_CPU_OPS=y
CONFIG_PM_CPU_OPS_PSCI=y

# Glyphs three times the font size: readable in a photograph of the panel.
CONFIG_GC_COMMON_PANEL_CONSOLE_SCALE=3
```

## src/main.c
```c
/* SPDX-License-Identifier: Apache-2.0 */
/* SPDX-FileCopyrightText: 2026 Signal Slot, Inc. */
/*
 * gc_identify - the first thing to run on an i.MX8MP: the Vivante driver's
 * milestone 1 (power, clocks, identity, reset), the result on the console,
 * then a bounded wait and a SoC reset back to the boot loader.
 *
 * Boot it from Torizon with tools/kexec-zephyr (the Verdin iMX8MP A53 board
 * in the SafeUI repository puts the image at 0x42000000):
 *   kexec_zephyr zephyr.bin 0x42000000
 */
#include <zephyr/kernel.h>
#include <zephyr/device.h>
#include <zephyr/devicetree.h>
#include <zephyr/logging/log.h>
#include <gc.h>

#include "gc_sample.h"
#include "gc_panel_console.h"

LOG_MODULE_REGISTER(gc_identify, LOG_LEVEL_INF);

int main(void)
{
	const struct device *gpu = DEVICE_DT_GET_ONE(vivante_gc);

	gc_sample_service_wdog();
	gc_panel_console_stage(4, 0x0000ff);   /* blue: main() runs */

	if (!device_is_ready(gpu)) {
		gc_sample_verdict("gc_identify", false,
				  "the GPU device did not initialise (see the gpu_gc log)");
	} else {
		const struct gc_identity *id = gc_identity(gpu);
		bool expected = (id->model == 0x7000 && id->revision == 0x6204);

		gc_panel_console_stage(5, 0xffffff);   /* white: identity read */

		LOG_INF("GC%x rev 0x%x: %s", id->model, id->revision,
			gc_alive(gpu) ? "alive and idle" : "not alive");
		if (!expected) {
			gc_sample_verdict("gc_identify", false, "unexpected core");
		} else if (!gc_alive(gpu)) {
			gc_sample_verdict("gc_identify", false, "the GPU did not reset to idle");
		} else {
			gc_sample_verdict("gc_identify", true, NULL);
		}
	}

	gc_sample_finish();
	return 0;
}
```
