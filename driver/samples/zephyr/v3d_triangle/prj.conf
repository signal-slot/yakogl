## CMakeLists.txt
```
# SPDX-License-Identifier: Apache-2.0
# SPDX-FileCopyrightText: 2026 Signal Slot, Inc.
# v3d_triangle: V3D 4.2 milestone M5 on the Raspberry Pi 4 (see src/main.c).
# Standalone like v3d_clear, whose mailbox and console files it reuses.
cmake_minimum_required(VERSION 3.20.0)

find_package(Zephyr REQUIRED HINTS $ENV{ZEPHYR_BASE})
project(v3d_triangle)

get_filename_component(DRIVER "${CMAKE_CURRENT_SOURCE_DIR}/../../.." ABSOLUTE)
get_filename_component(REPO "${DRIVER}/.." ABSOLUTE)

execute_process(COMMAND git -C "${DRIVER}" describe --always --dirty
                OUTPUT_VARIABLE V3D_BUILD OUTPUT_STRIP_TRAILING_WHITESPACE
                RESULT_VARIABLE describe_rc)
if(NOT describe_rc EQUAL 0 OR V3D_BUILD STREQUAL "")
  set(V3D_BUILD "unknown")
endif()
target_compile_definitions(app PRIVATE V3D_BUILD="${V3D_BUILD}")

# The program: tools/shaders/passthrough.vert + interp_color.frag, compiled by
# tools/v3d/v3d_shc into shaders/passthrough_interp_color.json:
#   glslangValidator -G passthrough.vert -o vs.spv
#   glslangValidator -G interp_color.frag -o fs.spv
#   v3d_shc vs.spv fs.spv > passthrough_interp_color.json
# The header is generated from that JSON at build time. Every prog_data field
# the frame builder reads must be in the JSON; the generator refuses an absent
# one rather than defaulting it, and takes no --assume here.
# Which compiler's code the image carries: the Mesa-compiled JSON above by
# default, or YakoGL's own (src/shaderc/online/v3d), written by
# `V3D_WRITE_OURS_JSON=1 cargo test ... the_triangle_samples_json` into
# shaders/ours_passthrough_interp_color.json:
#   cmake ... -DTRI_JSON=<sample>/shaders/ours_passthrough_interp_color.json
# The image prints the JSON's gpu.compiler and sha256 before anything else.
# The uniform variant (-DTRI_UNIFORMS=ON): tools/shaders/es100/utri.vert +
# utri.frag, whose program reads uniform storage (QUNIFORM_UNIFORM); main.c
# fills it and expects the uniforms' effect. Its JSONs: shaders/utri.json
# (Mesa, the default; made as tools/v3d/glsl2v3d.py makes SPIR-V, then
# v3d_shc vs.spv fs.spv --vpm-size 65536) and shaders/ours_utri.json
# (V3D_WRITE_OURS_JSON=1 cargo test ... samples_json). The image refuses to
# build when the JSON and the option disagree about uniform storage.
option(TRI_UNIFORMS "Build the uniform variant (es100/utri)" OFF)
# The if variant (-DTRI_IF=ON): tools/shaders/es100/tri_if.vert + tri_if.frag,
# an FS if whose threshold crosses the triangle. Its JSONs: shaders/tri_if.json
# (Mesa, the default, made as utri.json is) and shaders/ours_tri_if.json.
option(TRI_IF "Build the if variant (es100/tri_if)" OFF)
# The int variant (-DTRI_INT=ON): tools/shaders/es100/tri_int.vert +
# tri_int.frag, the int and bool operations in a picture. Its JSONs:
# shaders/tri_int.json (Mesa, the default, made as utri.json is) and
# shaders/ours_tri_int.json.
option(TRI_INT "Build the int variant (es100/tri_int)" OFF)
# The discard variant (-DTRI_DISCARD=ON): tools/shaders/es100/tri_discard.*,
# a nested-condition discard whose discarded part keeps the clear colour.
# Its JSONs: shaders/tri_discard.json (Mesa, the default) and
# shaders/ours_tri_discard.json.
option(TRI_DISCARD "Build the discard variant (es100/tri_discard)" OFF)
# The gl_FragCoord variant (-DTRI_FRAGCOORD=ON): tools/shaders/es100/
# tri_fragcoord.*, red = window x / 1280 and green = window y / 512, so the
# window flip (the FB_WPOS_Y_SCALE / _OFFSET words the frame writes from
# f.wpos) is visible. Our compiler's JSON only (shaders/ours_tri_fragcoord.json):
# Mesa's program takes the flip from a gallium state uniform this frame
# builder does not fill.
option(TRI_FRAGCOORD "Build the gl_FragCoord variant (es100/tri_fragcoord)" OFF)
set(TRI_N_VARIANTS 0)
foreach(v TRI_IF TRI_UNIFORMS TRI_INT TRI_DISCARD TRI_FRAGCOORD)
  if(${v})
    math(EXPR TRI_N_VARIANTS "${TRI_N_VARIANTS} + 1")
  endif()
endforeach()
if(TRI_N_VARIANTS GREATER 1)
  message(FATAL_ERROR "TRI_IF, TRI_UNIFORMS, TRI_INT, TRI_DISCARD and TRI_FRAGCOORD are separate variants")
endif()
if(TRI_FRAGCOORD)
  set(TRI_JSON_DEFAULT "${CMAKE_CURRENT_SOURCE_DIR}/shaders/ours_tri_fragcoord.json")
  target_compile_definitions(app PRIVATE TRI_FRAGCOORD=1)
elseif(TRI_DISCARD)
  set(TRI_JSON_DEFAULT "${CMAKE_CURRENT_SOURCE_DIR}/shaders/tri_discard.json")
  target_compile_definitions(app PRIVATE TRI_DISCARD=1)
elseif(TRI_INT)
  set(TRI_JSON_DEFAULT "${CMAKE_CURRENT_SOURCE_DIR}/shaders/tri_int.json")
  target_compile_definitions(app PRIVATE TRI_INT=1)
elseif(TRI_IF)
  set(TRI_JSON_DEFAULT "${CMAKE_CURRENT_SOURCE_DIR}/shaders/tri_if.json")
  target_compile_definitions(app PRIVATE TRI_IF=1)
elseif(TRI_UNIFORMS)
  set(TRI_JSON_DEFAULT "${CMAKE_CURRENT_SOURCE_DIR}/shaders/utri.json")
  target_compile_definitions(app PRIVATE TRI_UNIFORMS=1)
else()
  set(TRI_JSON_DEFAULT "${CMAKE_CURRENT_SOURCE_DIR}/shaders/passthrough_interp_color.json")
endif()
set(TRI_JSON "${TRI_JSON_DEFAULT}"
    CACHE FILEPATH "The v3d_shc-schema JSON whose QPU code the image embeds")
if(NOT EXISTS "${TRI_JSON}")
  message(FATAL_ERROR "TRI_JSON ${TRI_JSON} does not exist")
endif()
message(STATUS "v3d_triangle: shaders from ${TRI_JSON}, uniform variant ${TRI_UNIFORMS}, if variant ${TRI_IF}, int variant ${TRI_INT}, discard variant ${TRI_DISCARD}, gl_FragCoord variant ${TRI_FRAGCOORD}")
set(TRI_GEN "${CMAKE_CURRENT_BINARY_DIR}/gen")
if(DEFINED Python3_EXECUTABLE)
  set(TRI_PY "${Python3_EXECUTABLE}")
else()
  set(TRI_PY "${PYTHON_EXECUTABLE}")
endif()
add_custom_command(
  OUTPUT "${TRI_GEN}/tri_prog.h"
  COMMAND ${CMAKE_COMMAND} -E make_directory "${TRI_GEN}"
  COMMAND "${TRI_PY}" "${REPO}/tools/v3d/v3d_prog_header.py" "${TRI_JSON}"
          "${TRI_GEN}/tri_prog.h" --name tri
  DEPENDS "${TRI_JSON}" "${REPO}/tools/v3d/v3d_prog_header.py"
  COMMENT "v3d_prog_header: ${TRI_JSON}")
add_custom_target(tri_prog_h DEPENDS "${TRI_GEN}/tri_prog.h")
add_dependencies(app tri_prog_h)

target_include_directories(app PRIVATE
  "${TRI_GEN}"
  "${CMAKE_CURRENT_SOURCE_DIR}/../../../zephyr/lib/board/rpi4"
  "${DRIVER}/src/v3d"
  "${DRIVER}/../third_party/mesa-26.2.1/src/broadcom"   # Mesa's packers (v3d_cl.h)
  "${DRIVER}/../third_party/mesa-26.2.1/src"
  "${DRIVER}/../third_party/mesa-26.2.1/include"
  "${DRIVER}/zephyr/lib/board/common")   # gc_font8x16.h only
target_sources(app PRIVATE
  src/main.c
  ../../../zephyr/lib/board/rpi4/rpi_mbox.c
  ../../../zephyr/lib/board/rpi4/rpi_wdog.c
  ../../../zephyr/lib/board/rpi4/fbcon.c
  "${DRIVER}/src/v3d/v3d_hw.c"
  "${DRIVER}/src/v3d/v3d_frame.c")
```

## prj.conf
```kconfig
# SPDX-License-Identifier: Apache-2.0
# SPDX-FileCopyrightText: 2026 Signal Slot, Inc.
# The console is the HDMI framebuffer (driver/zephyr/lib/board/rpi4/fbcon.c): printk and
# LOG_* are drawn there. The mini UART stays on as well.
CONFIG_PRINTK=y
CONFIG_LOG=y
CONFIG_LOG_MODE_MINIMAL=y
CONFIG_CACHE_MANAGEMENT=y
CONFIG_MAIN_STACK_SIZE=8192
# The frame builder computes the viewport and the uniforms in float
# (v3d_frame.c); on arm64 Zephyr builds with -mgeneral-regs-only without it.
CONFIG_FPU=y

# Address space, as for v3d_clear (see its prj.conf): the board default of 8
# translation tables and 8 MiB of kernel virtual space was sized for a 512 KiB
# image. This one maps the same 3.6 MiB framebuffer and the V3D, PM, ASB and
# mailbox blocks with device_map(), and running out of tables is an assert
# before the console exists.
CONFIG_MAX_XLAT_TABLES=32
CONFIG_KERNEL_VM_SIZE=0x8000000
```

## boards/rpi_4b.overlay
```dts
/* SPDX-License-Identifier: Apache-2.0 */
/* SPDX-FileCopyrightText: 2026 Signal Slot, Inc. */
/*
 * The board's sram0 is 512 KiB at 0x200000 (dts/arm64/broadcom/bcm2711.dtsi);
 * the GPU buffers of this sample need more. DRAM starts at 0 on the Pi 4, and
 * the firmware keeps its own memory at the top of the first GiB, so 32 MiB from
 * 0x200000 is ARM memory on every Pi 4.
 */
#include "../../common/rpi_4b_sram.dtsi"

&sram0 {
	reg = <0x200000 0x2000000>;
};
```

## src/main.c
```c
/* SPDX-License-Identifier: Apache-2.0 */
/* SPDX-FileCopyrightText: 2026 Signal Slot, Inc. */
/*
 * v3d_triangle: milestone M5 of the V3D bring-up
 * (docs/notes/pi4-v3d-bringup.md) for the Raspberry Pi 4. The same bring-up as v3d_clear (M1 power and identity, M2
 * MMU, M3 one bin + render job), and the render is a clear followed by one
 * triangle with a colour per vertex, drawn by the three QPU programs v3d_shc
 * compiled from tools/shaders/passthrough.vert + interp_color.frag.
 *
 * The firmware framebuffer is the console (top half) and the render target
 * (bottom half). Every pixel of the target is read back and put in one of
 * three classes by its distance from the triangle's edges, measured at the
 * pixel centre in window coordinates:
 *
 *   inside  (at least EDGE_PX inside every edge): the interpolated colour,
 *           within COLOR_TOL of 255 per channel, alpha 255
 *   outside (at least EDGE_PX outside some edge): exactly the clear colour
 *   edge    (the band between): either the clear colour or within COLOR_TOL
 *           of the interpolated colour; counted separately
 *
 * and the row above the target (a guard the console never draws: it wraps at
 * 11 lines of 32 px, rows 0..351) must keep the value the CPU wrote.
 * COLOR_TOL is a stated guess, not a measurement: the value the V3D really
 * produces goes through a float16 pack (vfpack) and the TLB's conversion to
 * unorm8, and the first board run prints the largest difference it saw.
 *
 * Every step prints its raw result; the verdict line names what failed.
 *
 * The uniform variant (-DTRI_UNIFORMS=ON, shaders es100/utri) draws the same
 * triangle through a program that reads uniform storage (QUNIFORM_UNIFORM):
 * u_offset moves it (VS and CS), u_scale and u_bias change its colour (FS,
 * or wherever the compiler moved them). The storage is filled by name from
 * tri_uniform_values through the places the generated header lists, every
 * other word is a NaN, and the check expects the values' effect.
 *
 * The if variant (-DTRI_IF=ON, shaders es100/tri_if) draws it through an FS
 * `if (v_color.r > 0.5) c.g = 1.0; else c.b = 0.25;`: the threshold crosses
 * the triangle, so both arms are drawn, and each arm leaves the other's lane
 * at its value from before the if. The check expects each pixel's side and
 * requires pixels on both.
 *
 * The int variant (-DTRI_INT=ON, shaders es100/tri_int) draws it through an
 * FS of int and bool operations (F2i, Ineg, Imul, Iadd, I2f, Ieq, Ine, B2f,
 * sign, and a ternary read by the next add), each of which changes the
 * picture; the check expects each pixel's value and requires every band of
 * i and both sides of each comparison.
 *
 * The discard variant (-DTRI_DISCARD=ON, shaders es100/tri_discard) discards
 * where g > 0.25 and b < 0.25 (a combined condition: `&&`); those pixels keep the
 * clear colour. The check requires discarded and drawn pixels inside.
 *
 * The gl_FragCoord variant (-DTRI_FRAGCOORD=ON, shaders es100/tri_fragcoord,
 * our compiler's JSON) writes (x / 1280, y / 512, b, 1) in GL window
 * coordinates: green grows toward the top of the picture when the window
 * flip (f.wpos: FB_WPOS_Y_SCALE -1, _OFFSET the height) is right, toward the
 * bottom when it is wrong. The check counts inside pixels of both kinds and
 * requires the right one.
 */
#include <zephyr/kernel.h>
#include <zephyr/cache.h>
#include <zephyr/kernel/internal/mm.h>
#include <zephyr/sys/device_mmio.h>
#include <zephyr/sys/printk.h>
#include <errno.h>
#include <string.h>

#include "v3d.h"
#include "v3d_regs.h"
#include "v3d_frame.h"
#include "rpi_mbox.h"
#include "fbcon.h"
#include "rpi_wdog.h"
#include "tri_prog.h"
#include "tri_check.h"

/* A program that reads uniform storage needs the variant that fills it, and
 * the variant needs a program that reads it, or it proves nothing. */
#if TRI_USES_STORAGE && !defined(TRI_UNIFORMS)
#error "the program reads uniform storage: build with -DTRI_UNIFORMS=ON"
#endif
#if !TRI_USES_STORAGE && defined(TRI_UNIFORMS)
#error "TRI_UNIFORMS is set but the program reads no uniform storage"
#endif

#if (defined(TRI_IF) + defined(TRI_UNIFORMS) + defined(TRI_INT) + defined(TRI_DISCARD) + \
     defined(TRI_FRAGCOORD)) > 1
#error "TRI_IF, TRI_UNIFORMS, TRI_INT, TRI_DISCARD and TRI_FRAGCOORD are separate variants"
#endif

#ifndef V3D_BUILD
#define V3D_BUILD "unknown"
#endif

#define FB_W 1280
#define FB_H 720

#define CLEAR_RGBA8 0xff202020u /* dark grey, alpha 255 (R in the low byte) */
#define SENTINEL    0xffff00ffu /* magenta, written by the CPU beforehand */
#define GUARD       0xff0000ffu /* red, the row above the target */

/* GPU memory: the page table covers 8 MiB of GPU virtual address space. */
#define PT_ENTRIES 2048
static uint32_t pt[PT_ENTRIES] __aligned(4096);
static uint8_t scratch[4096] __aligned(4096);
static uint8_t cls[3][4096] __aligned(4096); /* BCL, RCL, indirect */
static uint8_t code[3][4096] __aligned(4096); /* FS, VS, CS */
static uint8_t vertices[4096] __aligned(4096);
static uint8_t tile_alloc[64 * 1024] __aligned(4096);
static uint8_t tile_state[64 * 1024] __aligned(4096);

static uint32_t va_next = 0x00100000; /* VA 0 is never mapped */

#ifdef TRI_UNIFORMS
/* Words no uniform covers: a NaN, so a read of one shows in the picture. */
#define STORAGE_POISON 0x7fc0deadu
static uint32_t vs_words[TRI_VS_STORAGE_WORDS ? TRI_VS_STORAGE_WORDS : 1];
static uint32_t fs_words[TRI_FS_STORAGE_WORDS ? TRI_FS_STORAGE_WORDS : 1];

static const float *uniform_value(const char *name)
{
	if (strcmp(name, "u_offset") == 0)
		return tri_uniform_values.offset;
	if (strcmp(name, "u_scale") == 0)
		return tri_uniform_values.scale;
	if (strcmp(name, "u_bias") == 0)
		return tri_uniform_values.bias;
	return NULL;
}

/* Fill both storages from the header's places; false names the uniform the
 * sample has no value for. */
static bool fill_storage(void)
{
	for (uint32_t i = 0; i < ARRAY_SIZE(vs_words); i++)
		vs_words[i] = STORAGE_POISON;
	for (uint32_t i = 0; i < ARRAY_SIZE(fs_words); i++)
		fs_words[i] = STORAGE_POISON;
	for (int i = 0; i < TRI_NUM_UNIFORM_PLACES; i++) {
		const struct tri_uniform_place *pl = &tri_uniform_places[i];
		const float *v = uniform_value(pl->name);
		uint32_t *words = pl->fs ? fs_words : vs_words;
		uint32_t n = pl->fs ? TRI_FS_STORAGE_WORDS : TRI_VS_STORAGE_WORDS;
		if (!v || pl->words > 4 || pl->word + pl->words > n) {
			printk("uniform %s (%s word %u+%u): %s\n", pl->name, pl->fs ? "fs" : "vs",
			       pl->word, pl->words, v ? "does not fit" : "the sample has no value");
			return false;
		}
		for (uint32_t c = 0; c < pl->words; c++) {
			union { float f; uint32_t u; } b = { .f = v[c] };
			words[pl->word + c] = b.u;
		}
	}
	printk("uniform storage: vs %d words, fs %d words\n", TRI_VS_STORAGE_WORDS,
	       TRI_FS_STORAGE_WORDS);
	for (int s = 0; s < 2; s++) {
		const uint32_t *w = s ? fs_words : vs_words;
		int n = s ? TRI_FS_STORAGE_WORDS : TRI_VS_STORAGE_WORDS;
		for (int i = 0; i < n; i += 4) {
			printk("  %s[%2d] %08x %08x %08x %08x\n", s ? "fs" : "vs", i, w[i],
			       i + 1 < n ? w[i + 1] : 0, i + 2 < n ? w[i + 2] : 0,
			       i + 3 < n ? w[i + 3] : 0);
		}
	}
	return true;
}
#endif

static uint32_t gpu_map(uint64_t pa, uint32_t bytes, bool *ok)
{
	uint32_t va = va_next;
	uint32_t len = ROUND_UP(bytes, 4096);
	if (v3d_pte_map(pt, PT_ENTRIES, va, pa, len, true) != 0) {
		printk("gpu_map: refused pa 0x%llx len 0x%x at va 0x%x\n",
		       (unsigned long long)pa, len, va);
		*ok = false;
		return 0;
	}
	va_next += len;
	return va;
}

/* See v3d_clear: which clock the power-on toggle needs is a board question;
 * the firmware's answer is printed and is not fatal. */
static int clk_set(void *ctx, bool on)
{
	ARG_UNUSED(ctx);
	int ret = rpi_clock_state(RPI_FW_CLK_V3D, on);
	printk("  fw clock 5 %s: %d%s\n", on ? "on" : "off", ret, ret ? " (not fatal)" : "");
	return 0;
}

static void verdict(bool pass, const char *what)
{
	/* The verdict names the shaders' compiler, so one photo of the screen
	 * says whose code passed or failed. */
#ifdef TRI_UNIFORMS
#define TRI_VARIANT ", uniform variant"
#elif defined(TRI_IF)
#define TRI_VARIANT ", if variant"
#elif defined(TRI_INT)
#define TRI_VARIANT ", int variant"
#elif defined(TRI_DISCARD)
#define TRI_VARIANT ", discard variant"
#elif defined(TRI_FRAGCOORD)
#define TRI_VARIANT ", gl_FragCoord variant"
#else
#define TRI_VARIANT ""
#endif
	printk("v3d_triangle: %s (%s) [shaders: %s%s]\n", pass ? "PASS" : "FAIL", what, TRI_COMPILER,
	       TRI_VARIANT);
	/* The console scrolls: the build line printed at boot is gone by now, so
	 * the verdict carries it again (one photo = one result row). */
	printk("v3d_triangle: build %s, json %.16s\n", V3D_BUILD, TRI_JSON_SHA256);
}

static void print_stall(const char *what, int ret, const struct v3d_stall *s)
{
	printk("%s: %d core_sts 0x%x hub_sts 0x%x ct0 ca 0x%x ra 0x%x ct1 ca 0x%x ra 0x%x\n",
	       what, ret, s->core_int_sts, s->hub_int_sts, s->ct0ca, s->ct0ra, s->ct1ca, s->ct1ra);
	printk("  err_stat 0x%x mmu_ctl 0x%x vio_addr 0x%x\n", s->err_stat, s->mmu_ctl,
	       s->mmu_vio_addr);
}

static void run(void)
{
	struct rpi_fb fb;
	int ret = rpi_mbox_init();
	if (ret == 0)
		ret = rpi_fb_alloc(FB_W, FB_H, &fb);
	if (ret)
		return; /* no screen: nothing can be reported */
	uint32_t half = fb.height / 2;
	/* scale 1: 22 text rows, so the first lines (M1, the clock replies) are
	 * not overwritten before the verdict */
	fbcon_attach(fb.cpu, fb.width, fb.pitch, half, 1);
	printk("v3d_triangle: build %s\n", V3D_BUILD);
	rpi_wdog_announce();
	printk("shaders compiled by: %s\n", TRI_COMPILER);
	printk("program json sha256 %.16s, VPM size %d (%s)\n", TRI_JSON_SHA256, TRI_VPM_SIZE,
	       TRI_VPM_SIZE_SOURCE);
	printk("assumed (absent from the JSON): %s\n", TRI_ASSUMED[0] ? TRI_ASSUMED : "none");
	printk("fb %ux%u pitch %u phys 0x%08x size 0x%x\n", fb.width, fb.height, fb.pitch,
	       fb.phys, fb.size);

	uint32_t hz = 0, max_hz = 0;
	int r1 = rpi_clock_rate(RPI_FW_CLK_V3D, &hz);
	int r2 = rpi_clock_max_rate(RPI_FW_CLK_V3D, &max_hz);
	printk("V3D clock: %u Hz (%d), max %u Hz (%d)\n", hz, r1, max_hz, r2);

	struct v3d_regs regs;
	device_map(&regs.hub, BCM2711_V3D_HUB_BASE, 0x4000, K_MEM_CACHE_NONE);
	device_map(&regs.core, BCM2711_V3D_CORE0_BASE, 0x4000, K_MEM_CACHE_NONE);
	device_map(&regs.pm, BCM2711_PM_BASE, 0x1000, K_MEM_CACHE_NONE);
	device_map(&regs.asb, BCM2711_V3D_ASB_BASE, 0x1000, K_MEM_CACHE_NONE);

	/* M1 */
	struct v3d_clock_ops clk = { .set = clk_set };
	ret = v3d_power_on(&regs, &clk);
	printk("M1 power_on: %d, PM_GRAFX 0x%08x\n", ret, sys_read32(regs.pm + BCM2711_PM_GRAPHICS_CTL));
	if (ret) {
		verdict(false, "M1 power-on");
		return;
	}
	if (max_hz && hz != max_hz) {
		ret = rpi_clock_set_rate(RPI_FW_CLK_V3D, max_hz);
		r1 = rpi_clock_rate(RPI_FW_CLK_V3D, &hz);
		printk("V3D clock set to max: %d, now %u Hz (%d)\n", ret, hz, r1);
	}
	struct v3d_identity id;
	ret = v3d_identify(&regs, &id);
	if (ret) {
		verdict(false, "M1 identity");
		return;
	}
	/* The shaders were compiled for TRI_VPM_SIZE; the board's value is
	 * printed next to it. A difference is reported in the verdict, not
	 * hidden, and does not stop the run. */
	bool vpm_match = id.vpm_size == TRI_VPM_SIZE;
	printk("VPM: board %u bytes, compiled for %d: %s\n", id.vpm_size, TRI_VPM_SIZE,
	       vpm_match ? "same" : "DIFFERENT");

	/* M2: the lists, the code, the vertices, the tile buffers, the framebuffer */
	bool ok = true;
	memset(pt, 0, sizeof(pt));
	uint32_t va_cls[3], va_code[3];
	for (int i = 0; i < 3; i++)
		va_cls[i] = gpu_map(k_mem_phys_addr(cls[i]), sizeof(cls[i]), &ok);
	for (int i = 0; i < 3; i++)
		va_code[i] = gpu_map(k_mem_phys_addr(code[i]), sizeof(code[i]), &ok);
	uint32_t va_vtx = gpu_map(k_mem_phys_addr(vertices), sizeof(vertices), &ok);
	uint32_t va_ta = gpu_map(k_mem_phys_addr(tile_alloc), sizeof(tile_alloc), &ok);
	uint32_t va_ts = gpu_map(k_mem_phys_addr(tile_state), sizeof(tile_state), &ok);
	uint32_t va_fb = gpu_map(fb.phys, fb.size, &ok);
	if (!ok) {
		verdict(false, "M2 page table");
		return;
	}
	sys_cache_data_flush_range(pt, sizeof(pt));
	v3d_irq_quiesce(&regs);
	v3d_caches_init(&regs);
	ret = v3d_mmu_init(&regs, k_mem_phys_addr(pt), k_mem_phys_addr(scratch));
	printk("M2 mmu_init: %d (VA up to 0x%x)\n", ret, va_next);
	if (ret) {
		verdict(false, "M2 MMU");
		return;
	}

	/* the program: code into its pages, prog_data from the header */
	BUILD_ASSERT(sizeof(tri_fs_code) <= sizeof(code[0]) &&
		     sizeof(tri_vs_code) <= sizeof(code[1]) &&
		     sizeof(tri_cs_code) <= sizeof(code[2]));
	memset(code, 0, sizeof(code));
	memcpy(code[0], tri_fs_code, sizeof(tri_fs_code));
	memcpy(code[1], tri_vs_code, sizeof(tri_vs_code));
	memcpy(code[2], tri_cs_code, sizeof(tri_cs_code));
	struct v3d_fs_prog fs;
	struct v3d_vs_prog vs, cs;
	tri_fs_prog(&fs, va_code[0]);
	tri_vs_prog(&vs, va_code[1]);
	tri_cs_prog(&cs, va_code[2]);

	/* interleaved vec4 position + vec4 colour, 32 bytes a vertex */
	BUILD_ASSERT(TRI_NUM_ATTRS == 2);
	memset(vertices, 0, sizeof(vertices));
	memcpy(vertices, tri_vertices, sizeof(tri_vertices));
	struct v3d_vertex_attr attrs[TRI_NUM_ATTRS];
	attrs[TRI_ATTR_A_POS_RECORD] = (struct v3d_vertex_attr){ va_vtx, 32, 4 };
	attrs[TRI_ATTR_A_COLOR_RECORD] = (struct v3d_vertex_attr){ va_vtx + 16, 32, 4 };

	struct v3d_triangle_frame f = {
		.clear = {
			.width = fb.width,
			.height = fb.height - half,
			.clear_rgba8 = CLEAR_RGBA8,
			.target = va_fb + half * fb.pitch,
			.stride = fb.pitch,
			.tile_alloc = va_ta,
		},
		.front_ccw = true,
		.fs = &fs,
		.vs = &vs,
		.cs = &cs,
		.attrs = attrs,
		.num_attrs = TRI_NUM_ATTRS,
		.first_vertex = 0,
		.vertex_count = 3,
	};
#ifdef TRI_UNIFORMS
	if (!fill_storage()) {
		verdict(false, "uniform storage");
		return;
	}
	if (TRI_VS_STORAGE_WORDS)
		f.vs_storage = (struct v3d_uniform_storage){ vs_words, TRI_VS_STORAGE_WORDS };
	if (TRI_FS_STORAGE_WORDS)
		f.fs_storage = (struct v3d_uniform_storage){ fs_words, TRI_FS_STORAGE_WORDS };
	const struct tri_xform *xf = &tri_uniform_values;
#else
	const struct tri_xform *xf = &tri_identity;
#endif
	printk("expected: offset %d/1000 %d/1000, colour x (%d %d %d %d)/1000 + (%d %d %d %d)/1000\n",
	       (int)(xf->offset[0] * 1000), (int)(xf->offset[1] * 1000),
	       (int)(xf->scale[0] * 1000), (int)(xf->scale[1] * 1000),
	       (int)(xf->scale[2] * 1000), (int)(xf->scale[3] * 1000),
	       (int)(xf->bias[0] * 1000), (int)(xf->bias[1] * 1000), (int)(xf->bias[2] * 1000),
	       (int)(xf->bias[3] * 1000));
	/* glViewport over the whole target, a window-system buffer (first row
	 * at the top), glDepthRange(0, 1) */
	v3d_viewport_gl(0, 0, (float)f.clear.width, (float)f.clear.height, 0.0f, 1.0f, true,
			f.clear.height, &f.vp);
	/* gl_FragCoord's window flip for the same target (first row at the top):
	 * written only for a program that asks for it (FB_WPOS_Y_*). */
	v3d_wpos_gl(true, f.clear.height, &f.wpos);

	struct v3d_tiling t;
	uint32_t ta_size, ts_size;
	v3d_frame_tiling(f.clear.width, f.clear.height, &t);
	v3d_frame_alloc_sizes(&t, 1, 4096, &ta_size, &ts_size);
	if (ta_size > sizeof(tile_alloc) || ts_size > sizeof(tile_state)) {
		printk("tile alloc %u / state %u do not fit\n", ta_size, ts_size);
		verdict(false, "frame sizes");
		return;
	}
	struct v3d_cl bcl, rcl, ind;
	v3d_cl_init(&bcl, cls[0], va_cls[0], sizeof(cls[0]));
	v3d_cl_init(&rcl, cls[1], va_cls[1], sizeof(cls[1]));
	v3d_cl_init(&ind, cls[2], va_cls[2], sizeof(cls[2]));
	struct v3d_triangle_layout lo;
	if (!v3d_frame_build_triangle(&f, &bcl, &rcl, &ind, &lo)) {
		verdict(false, "frame build");
		return;
	}
	printk("frame %ux%u: %ux%u tiles, BCL %u RCL %u indirect %u bytes, TA %u TS %u\n",
	       f.clear.width, f.clear.height, t.tiles_x, t.tiles_y, bcl.used, rcl.used, ind.used,
	       ta_size, ts_size);
	printk("record 0x%x, uniforms fs 0x%x vs 0x%x cs 0x%x, code fs 0x%x vs 0x%x cs 0x%x\n",
	       lo.record, lo.fs_uniforms, lo.vs_uniforms, lo.cs_uniforms, va_code[0], va_code[1],
	       va_code[2]);

	/* the target starts magenta and the row above it red */
	for (uint32_t y = half; y < fb.height; y++) {
		uint32_t *p = (uint32_t *)(fb.cpu + (size_t)y * fb.pitch);
		for (uint32_t x = 0; x < fb.width; x++)
			p[x] = SENTINEL;
	}
	uint32_t *guard = (uint32_t *)(fb.cpu + (size_t)(half - 1) * fb.pitch);
	for (uint32_t x = 0; x < fb.width; x++)
		guard[x] = GUARD;
	memset(tile_state, 0, sizeof(tile_state));
	sys_cache_data_flush_range(cls, sizeof(cls));
	sys_cache_data_flush_range(code, sizeof(code));
	sys_cache_data_flush_range(vertices, sizeof(vertices));
	sys_cache_data_flush_range(tile_state, sizeof(tile_state));

	/* M3 */
	struct v3d_stall st;
	v3d_submit_bin(&regs, bcl.gpu, bcl.gpu + bcl.used, va_ta, ta_size, va_ts);
	ret = v3d_wait(&regs, V3D_CTL_0_INT_STS_INT_FLDONE_SET, 1000000, &st);
	if (ret) {
		print_stall("bin", ret, &st);
		verdict(false, ret == -ENOMEM ? "bin: out of memory" :
			       ret == -EFAULT ? "bin: MMU fault" : "bin: timeout");
		return;
	}
	printk("bin: done\n");
	v3d_submit_render(&regs, rcl.gpu, rcl.gpu + rcl.used);
	ret = v3d_wait(&regs, V3D_CTL_0_INT_STS_INT_FRDONE_SET, 1000000, &st);
	if (ret) {
		print_stall("render", ret, &st);
		verdict(false, ret == -EFAULT ? "render: MMU fault" : "render: timeout");
		return;
	}
	ret = v3d_caches_clean(&regs);
	printk("render: done, clean %d\n", ret);

	/* M5: every pixel of the target, in three classes, and the guard row */
	struct raster r;
	raster_setup(&f.vp, xf, &r);
#ifdef TRI_IF
	r.if_variant = true;
#endif
#ifdef TRI_INT
	r.int_variant = true;
#endif
#ifdef TRI_DISCARD
	r.discard_variant = true;
	r.clear = CLEAR_RGBA8;
#endif
#ifdef TRI_FRAGCOORD
	r.fragcoord_variant = true;
	r.fb_h = (float)f.clear.height;
#endif
	struct tri_result res;
	tri_check(&r, fb.cpu + (size_t)half * fb.pitch, fb.pitch, f.clear.width, f.clear.height,
		  CLEAR_RGBA8, &res);
	uint32_t guard_bad = 0;
	for (uint32_t x = 0; x < fb.width; x++)
		guard_bad += guard[x] != GUARD;

	/* a few named points: the centroid and a point near each vertex */
	static const float probe[4][3] = {
		{ 1.0f / 3, 1.0f / 3, 1.0f / 3 },
		{ 0.8f, 0.1f, 0.1f },
		{ 0.1f, 0.8f, 0.1f },
		{ 0.1f, 0.1f, 0.8f },
	};
	for (int i = 0; i < 4; i++) {
		float px = 0, py = 0;
		for (int k = 0; k < 3; k++) {
			px += probe[i][k] * r.x[k];
			py += probe[i][k] * r.y[k];
		}
		uint32_t x = (uint32_t)px, y = (uint32_t)py;
		float lambda[3];
		raster_at(&r, x + 0.5f, y + 0.5f, lambda);
		uint32_t cand[TRI_MAX_CANDIDATES];
		bool near;
		int nc = candidates(&r, lambda, x + 0.5f, y + 0.5f, cand, &near);
		uint32_t want = cand[0];
		uint32_t got = ((const uint32_t *)(fb.cpu + (size_t)(half + y) * fb.pitch))[x];
		uint32_t diff = max_diff(got, want);
		for (int k = 1; k < nc; k++)
			if (max_diff(got, cand[k]) < diff)
				diff = max_diff(got, cand[k]);
		printk("  probe %d at %u,%u: 0x%08x, expected 0x%08x%s (diff %u)\n", i, x, y, got,
		       want, near ? " or a band neighbour" : "", diff);
	}

	printk("M5: %u pixels = %u inside + %u outside + %u edge\n", res.total, res.n_in,
	       res.n_out, res.n_edge);
	printk("  inside wrong %u (largest channel diff %u, tolerance %u)\n", res.bad_in,
	       res.worst_in, COLOR_TOL);
	printk("  outside wrong %u, edge wrong %u (edge drawn %u, clear %u)\n", res.bad_out,
	       res.bad_edge, res.edge_drawn, res.n_edge - res.edge_drawn - res.bad_edge);
	if (res.have_first)
		printk("  first wrong at %u,%u: 0x%08x, expected 0x%08x\n", res.first_x,
		       res.first_y, res.first_got, res.first_want);
	printk("  guard row %u of %u changed\n", guard_bad, fb.width);
#ifdef TRI_IF
	printk("  if: inside %u then side, %u else side, %u in the band (either accepted)\n",
	       res.n_then, res.n_else, res.n_band);
#endif
#ifdef TRI_DISCARD
	printk("  discard: inside %u discarded, %u drawn, %u in the band (either accepted)\n",
	       res.n_discarded, res.n_drawn, res.n_band);
#endif
#ifdef TRI_FRAGCOORD
	printk("  gl_FragCoord: inside %u match the right flip, %u the wrong flip, %u in the band\n",
	       res.n_flip_right, res.n_flip_wrong, res.n_band);
#endif
#ifdef TRI_INT
	printk("  int: inside i=0..3 %u %u %u %u, g<0.5 %u g>0.5 %u, b>=0.5 %u b<0.5 %u, band %u\n",
	       res.n_int_i[0], res.n_int_i[1], res.n_int_i[2], res.n_int_i[3], res.n_int_g[0],
	       res.n_int_g[1], res.n_int_b[0], res.n_int_b[1], res.n_band);
#endif

	verdict(res.counted && tri_result_ok(&res) && !guard_bad,
		!res.counted ? "pixel classes do not add up" :
		res.bad_in   ? "M5 inside colour" :
		res.bad_out  ? "M5 outside not the clear colour" :
		res.bad_edge ? "M5 edge pixels" :
		guard_bad    ? "M5 guard row" :
		vpm_match    ? "M1-M5, every pixel read back" :
			       "M1-M5, every pixel read back; VPM size differs from the compile");
}

int main(void)
{
	run();
	for (;;)
		k_sleep(K_FOREVER);
	return 0;
}
```

## src/tri_check.h
```c
/* SPDX-License-Identifier: Apache-2.0 */
/* SPDX-FileCopyrightText: 2026 Signal Slot, Inc. */
/*
 * The read-back check of v3d_triangle (see main.c), in plain C so that
 * host/tri_check_test.c can show on the host that it passes a correct picture
 * and fails each kind of wrong one. It models what the picture must be; it
 * draws nothing on the board.
 */
#ifndef TRI_CHECK_H
#define TRI_CHECK_H

#include <stdbool.h>
#include <stddef.h>
#include <stdint.h>

#include "v3d_frame.h"

#define EDGE_PX   1.0f /* the band around each edge that is not classified */
#define COLOR_TOL 3    /* of 255, per channel: a stated guess until the board measures it */

/* The triangle in normalized device coordinates, and its vertex colours,
 * laid out as the vertex buffer: vec4 position, vec4 colour. */
static const float tri_vertices[3][8] = {
	/* x, y, z, w, r, g, b, a */
	{ -0.5f, -0.5f, 0.0f, 1.0f, 1.0f, 0.0f, 0.0f, 1.0f },
	{ 0.5f, -0.5f, 0.0f, 1.0f, 0.0f, 1.0f, 0.0f, 1.0f },
	{ 0.0f, 0.5f, 0.0f, 1.0f, 0.0f, 0.0f, 1.0f, 1.0f },
};

/*
 * What the program does to the vertex buffer's values: the position plus
 * `offset` (x and y; z and w must stay 0, so w is still 1 and the divide a
 * no-op) and the colour times `scale` plus `bias`, per channel. The plain
 * sample's shaders are the identity; the uniform variant's (es100/utri) take
 * the three from uniform storage.
 */
struct tri_xform {
	float offset[4], scale[4], bias[4];
};

static const struct tri_xform tri_identity = {
	{ 0.0f, 0.0f, 0.0f, 0.0f }, { 1.0f, 1.0f, 1.0f, 1.0f }, { 0.0f, 0.0f, 0.0f, 0.0f }
};

/*
 * The uniform variant's values: main.c writes them into uniform storage
 * (u_offset, u_scale, u_bias) and the check expects their effect. Every
 * channel differs from the identity and from every other channel, and each
 * value is exact in float16, so a word read from the wrong place, or not
 * read at all (0), changes the picture.
 */
static const struct tri_xform tri_uniform_values = {
	{ 0.25f, -0.125f, 0.0f, 0.0f },   /* u_offset */
	{ 0.5f, 0.75f, 0.25f, 1.0f },     /* u_scale */
	{ 0.25f, 0.0625f, 0.5f, 0.0f },   /* u_bias */
};

/*
 * The if variant (es100/tri_if.frag): `if (v_color.r > 0.5) c.g = 1.0; else
 * c.b = 0.25;` on the interpolated colour, with no uniforms. A pixel whose
 * interpolated red is within TRI_IF_BAND of 0.5 may land on either side (the
 * GPU's interpolation and ours differ in the last bits), so it is checked
 * against both; every other pixel against its own side only.
 */
#define TRI_IF_BAND 0.01f

/*
 * The int variant (es100/tri_int.frag), with no uniforms:
 *   i = int(r * 4.0); j = -i * 3 + 7;
 *   colour = (float(j + 5) / 12.0,
 *             float(i == 1) * 0.5 + float(i != 2) * 0.25 + 0.125,
 *             (b < 0.5 ? 0.25 : 0.75) + sign(g - 0.5) * 0.125, 1.0)
 * on the interpolated r, g, b. A pixel within TRI_INT_BAND of a threshold
 * (r * 4 at an integer, g or b at 0.5) may land on either side of it, so
 * every side it is near is accepted there; every other pixel is checked
 * against its own side only.
 */
#define TRI_INT_BAND 0.01f

/*
 * The discard variant (es100/tri_discard.frag): `if (g > 0.25 && b < 0.25)
 * discard;` then the interpolated colour. A discarded pixel keeps what the
 * target held: the clear colour. Within TRI_DISCARD_BAND of either threshold
 * both outcomes are accepted.
 */
#define TRI_DISCARD_BAND 0.01f

/*
 * The gl_FragCoord variant (es100/tri_fragcoord.frag): (x / 1280, y / 512,
 * the interpolated b, 1) in GL window coordinates, whose y grows upward:
 * memory row y of a target of height h has window y = h - (y + 0.5). The
 * wrong flip would give y + 0.5. A pixel whose two answers are within
 * COLOR_TOL of each other (the rows around h / 2) cannot tell them apart and
 * is counted in the band; every other inside pixel must match the right one,
 * and the check requires such pixels, and counts any that match the wrong one.
 */
#define TRI_FRAGCOORD_W 1280.0f
#define TRI_FRAGCOORD_H 512.0f
#define TRI_MAX_CANDIDATES 12

/* Window-space vertices and the edge lengths of the triangle. */
struct raster {
	struct tri_xform xf;
	bool if_variant;
	bool int_variant;
	bool discard_variant;
	bool fragcoord_variant;
	float fb_h;     /* the fragcoord variant: the target's height */
	uint32_t clear; /* the discard variant: what a discarded pixel shows */
	float x[3], y[3];
	float area;   /* twice the signed area */
	float len[3]; /* the length of the edge opposite vertex i */
};

static inline float tri_sqrt(float v)
{
	/* Newton's method; v > 0 here (an edge length squared) */
	float r = v > 1.0f ? v : 1.0f;
	for (int i = 0; i < 40; i++)
		r = 0.5f * (r + v / r);
	return r;
}

/* The viewport transform gallium hands the V3D (window = ndc * scale +
 * translate); w is 1 at every vertex, so the perspective divide is a no-op. */
static inline void raster_setup(const struct v3d_viewport *vp, const struct tri_xform *xf,
				struct raster *r)
{
	/* Every field starts zeroed, the variant flags included, so a field
	 * added later cannot be left to whatever the stack held (fragcoord_variant
	 * and fb_h were, once, and the host test's own picture failed). */
	*r = (struct raster){ .xf = *xf };
	for (int i = 0; i < 3; i++) {
		r->x[i] = (tri_vertices[i][0] + xf->offset[0]) * vp->scale[0] + vp->translate[0];
		r->y[i] = (tri_vertices[i][1] + xf->offset[1]) * vp->scale[1] + vp->translate[1];
	}
	r->area = (r->x[1] - r->x[0]) * (r->y[2] - r->y[0]) -
		  (r->x[2] - r->x[0]) * (r->y[1] - r->y[0]);
	for (int i = 0; i < 3; i++) {
		int a = (i + 1) % 3, b = (i + 2) % 3;
		float dx = r->x[b] - r->x[a], dy = r->y[b] - r->y[a];
		r->len[i] = tri_sqrt(dx * dx + dy * dy);
	}
}

/* Barycentric weights of (px, py), and its signed distance in pixels from
 * the nearest edge (positive inside). With w = 1 at every vertex the
 * perspective-correct interpolation is the linear one. */
static inline float raster_at(const struct raster *r, float px, float py, float lambda[3])
{
	float dmin = 1e30f;
	float abs_area = r->area < 0 ? -r->area : r->area;
	for (int i = 0; i < 3; i++) {
		int a = (i + 1) % 3, b = (i + 2) % 3;
		float e = (r->x[b] - r->x[a]) * (py - r->y[a]) - (r->y[b] - r->y[a]) * (px - r->x[a]);
		lambda[i] = e / r->area;
		float d = lambda[i] * abs_area / r->len[i];
		if (d < dmin)
			dmin = d;
	}
	return dmin;
}

static inline uint32_t unorm8(float c)
{
	if (c <= 0.0f)
		return 0;
	if (c >= 1.0f)
		return 255;
	return (uint32_t)(c * 255.0f + 0.5f);
}

/* The interpolated red, the value the if variant tests. */
static inline float interp_red(const float lambda[3])
{
	float c = 0;
	for (int i = 0; i < 3; i++)
		c += lambda[i] * tri_vertices[i][4];
	return c;
}

/* The expected colour as R8G8B8A8 (R in the low byte): the interpolated
 * colour, scaled and biased; for the if variant, the arm `then_side` (1: the
 * then arm, 0: the else arm) applied. */
static inline uint32_t expected_side(const struct raster *r, const float lambda[3], int then_side)
{
	float c[4];
	for (int ch = 0; ch < 4; ch++) {
		c[ch] = 0;
		for (int i = 0; i < 3; i++)
			c[ch] += lambda[i] * tri_vertices[i][4 + ch];
		c[ch] = c[ch] * r->xf.scale[ch] + r->xf.bias[ch];
	}
	if (r->if_variant) {
		if (then_side)
			c[1] = 1.0f;
		else
			c[2] = 0.25f;
	}
	uint32_t v = 0;
	for (int ch = 0; ch < 4; ch++)
		v |= unorm8(c[ch]) << (8 * ch);
	return v;
}

/* The expected colour on the pixel's own side of the if. */
static inline uint32_t expected_rgba8(const struct raster *r, const float lambda[3])
{
	return expected_side(r, lambda, interp_red(lambda) > 0.5f);
}

/* For the if variant near its threshold: the other side's colour, which is
 * also accepted there; otherwise the same as expected_rgba8. */
static inline uint32_t expected_alt(const struct raster *r, const float lambda[3])
{
	float red = interp_red(lambda);
	if (r->if_variant && red > 0.5f - TRI_IF_BAND && red < 0.5f + TRI_IF_BAND)
		return expected_side(r, lambda, !(red > 0.5f));
	return expected_rgba8(r, lambda);
}

/* The interpolated colour channel `ch` (0 r, 1 g, 2 b, 3 a). */
static inline float interp_ch(const float lambda[3], int ch)
{
	float c = 0;
	for (int k = 0; k < 3; k++)
		c += lambda[k] * tri_vertices[k][4 + ch];
	return c;
}

/* The int variant's colour for one choice of sides: `i` = int(r * 4.0),
 * `gs` = sign(g - 0.5) (-1, 0 or 1), `b_low` = (b < 0.5). */
static inline uint32_t int_colour(int i, int gs, int b_low)
{
	int j = -i * 3 + 7;
	float c[4] = {
		(float)(j + 5) / 12.0f,
		(i == 1 ? 1.0f : 0.0f) * 0.5f + (i != 2 ? 1.0f : 0.0f) * 0.25f + 0.125f,
		(b_low ? 0.25f : 0.75f) + (float)gs * 0.125f,
		1.0f,
	};
	uint32_t v = 0;
	for (int ch = 0; ch < 4; ch++)
		v |= unorm8(c[ch]) << (8 * ch);
	return v;
}

/* The int variant's pixel's own sides: i, sign(g - 0.5), b < 0.5. */
static inline void int_sides(const float lambda[3], int *i, int *gs, int *b_low)
{
	float x = interp_ch(lambda, 0) * 4.0f, dg = interp_ch(lambda, 1) - 0.5f;
	*i = (int)x; /* x >= 0: int() truncates toward zero, as GLSL's */
	*gs = dg > 0 ? 1 : dg < 0 ? -1 : 0;
	*b_low = interp_ch(lambda, 2) < 0.5f;
}

/* Every colour a pixel may correctly have: its own sides first, and near a
 * threshold every side it is near. Returns the count; *near says whether
 * the pixel is in some band. Plain and uniform pixels have one candidate,
 * the if variant's one or two. */
/* The fragcoord variant's colour at pixel centre (px, py) of memory, with
 * the window flip right (`right`) or wrong. */
static inline uint32_t fragcoord_colour(const struct raster *r, const float lambda[3], float px,
					float py, bool right)
{
	float wy = right ? r->fb_h - py : py;
	uint32_t base = expected_rgba8(r, lambda);
	return (base & 0xffff0000u) | unorm8(px / TRI_FRAGCOORD_W) | (unorm8(wy / TRI_FRAGCOORD_H) << 8);
}

/* (px, py): the pixel centre in memory coordinates (row 0 at the top). */
static inline int candidates(const struct raster *r, const float lambda[3], float px, float py,
			     uint32_t out[TRI_MAX_CANDIDATES], bool *near)
{
	*near = false;
	if (r->fragcoord_variant) {
		out[0] = fragcoord_colour(r, lambda, px, py, true);
		return 1;
	}
	if (r->discard_variant) {
		float dg = interp_ch(lambda, 1) - 0.25f, db = interp_ch(lambda, 2) - 0.25f;
		bool gone = dg > 0 && db < 0;
		uint32_t drawn = expected_rgba8(r, lambda);
		out[0] = gone ? r->clear : drawn;
		if ((dg > -TRI_DISCARD_BAND && dg < TRI_DISCARD_BAND) ||
		    (db > -TRI_DISCARD_BAND && db < TRI_DISCARD_BAND)) {
			*near = true;
			out[1] = gone ? drawn : r->clear;
			return 2;
		}
		return 1;
	}
	if (!r->int_variant) {
		out[0] = expected_rgba8(r, lambda);
		uint32_t alt = expected_alt(r, lambda);
		if (alt == out[0])
			return 1;
		*near = true;
		out[1] = alt;
		return 2;
	}
	int i, gs, b_low;
	int_sides(lambda, &i, &gs, &b_low);
	float x = interp_ch(lambda, 0) * 4.0f, dg = interp_ch(lambda, 1) - 0.5f;
	float db = interp_ch(lambda, 2) - 0.5f;
	int is[2] = { i, i }, ni = 1;
	float fr = x - (float)i;
	if (fr < 4.0f * TRI_INT_BAND && i > 0)
		is[ni++] = i - 1;
	else if (fr > 1.0f - 4.0f * TRI_INT_BAND)
		is[ni++] = i + 1;
	int gss[3] = { gs, gs, gs }, ng = 1;
	if (dg > -TRI_INT_BAND && dg < TRI_INT_BAND) {
		gss[0] = gs;
		gss[1] = gs == 1 ? -1 : 1;
		gss[2] = gs == 0 ? -1 : 0;
		ng = 3;
	}
	int bs[2] = { b_low, !b_low }, nb = (db > -TRI_INT_BAND && db < TRI_INT_BAND) ? 2 : 1;
	*near = ni > 1 || ng > 1 || nb > 1;
	int n = 0;
	for (int a = 0; a < ni; a++)
		for (int b = 0; b < ng; b++)
			for (int c = 0; c < nb; c++)
				out[n++] = int_colour(is[a], gss[b], bs[c]);
	return n;
}

/* The largest per-channel difference of two RGBA8 values. */
static inline uint32_t max_diff(uint32_t a, uint32_t b)
{
	uint32_t m = 0;
	for (int ch = 0; ch < 4; ch++) {
		int d = (int)((a >> (8 * ch)) & 0xff) - (int)((b >> (8 * ch)) & 0xff);
		uint32_t ad = (uint32_t)(d < 0 ? -d : d);
		if (ad > m)
			m = ad;
	}
	return m;
}

struct tri_result {
	uint32_t total, n_in, n_out, n_edge;
	uint32_t bad_in, bad_out, bad_edge, edge_drawn, worst_in;
	/* the if variant: inside pixels on each side, and in the band */
	uint32_t n_then, n_else, n_band;
	/* the int variant: inside pixels (out of every band) per i = 0..3, on
	 * each side of g = 0.5 and of b = 0.5 */
	uint32_t n_int_i[4], n_int_g[2], n_int_b[2];
	/* the discard variant: inside pixels (out of the band) discarded, drawn */
	uint32_t n_discarded, n_drawn;
	/* the fragcoord variant: inside pixels out of the band that match the
	 * right flip, that match the wrong one */
	uint32_t n_flip_right, n_flip_wrong;
	bool counted; /* the classes cover the target and none of in/out is empty */
	bool have_first;
	uint32_t first_x, first_y, first_got, first_want;
};

/* Classify and check every pixel of a width x height RGBA8 image. */
static inline void tri_check(const struct raster *r, const uint8_t *img, uint32_t pitch,
			     uint32_t width, uint32_t height, uint32_t clear_rgba8,
			     struct tri_result *res)
{
	*res = (struct tri_result){ .total = width * height };
	for (uint32_t y = 0; y < height; y++) {
		const uint32_t *p = (const uint32_t *)(img + (size_t)y * pitch);
		for (uint32_t x = 0; x < width; x++) {
			float lambda[3];
			float d = raster_at(r, x + 0.5f, y + 0.5f, lambda);
			uint32_t cand[TRI_MAX_CANDIDATES];
			bool near;
			int nc = candidates(r, lambda, x + 0.5f, y + 0.5f, cand, &near);
			uint32_t want = cand[0], got = p[x];
			uint32_t diff = 0xffffffffu;
			for (int k = 0; k < nc; k++) {
				uint32_t dk = max_diff(got, cand[k]);
				if (dk < diff)
					diff = dk;
			}
			bool bad;
			if (d >= EDGE_PX) {
				res->n_in++;
				if (r->if_variant) {
					if (near)
						res->n_band++;
					else if (interp_red(lambda) > 0.5f)
						res->n_then++;
					else
						res->n_else++;
				}
				if (r->fragcoord_variant) {
					uint32_t wrong = fragcoord_colour(r, lambda, x + 0.5f, y + 0.5f, false);
					if (max_diff(cand[0], wrong) <= COLOR_TOL)
						res->n_band++;
					else if (max_diff(got, cand[0]) <= COLOR_TOL)
						res->n_flip_right++;
					else if (max_diff(got, wrong) <= COLOR_TOL)
						res->n_flip_wrong++;
				}
				if (r->discard_variant) {
					if (near)
						res->n_band++;
					else if (interp_ch(lambda, 1) > 0.25f && interp_ch(lambda, 2) < 0.25f)
						res->n_discarded++;
					else
						res->n_drawn++;
				}
				if (r->int_variant) {
					int i, gs, b_low;
					int_sides(lambda, &i, &gs, &b_low);
					if (near)
						res->n_band++;
					else {
						if (i >= 0 && i < 4)
							res->n_int_i[i]++;
						res->n_int_g[gs > 0]++;
						res->n_int_b[b_low]++;
					}
				}
				if (diff > res->worst_in)
					res->worst_in = diff;
				bad = diff > COLOR_TOL;
				res->bad_in += bad;
			} else if (d <= -EDGE_PX) {
				res->n_out++;
				want = clear_rgba8;
				bad = got != clear_rgba8;
				res->bad_out += bad;
			} else {
				res->n_edge++;
				bool drawn = diff <= COLOR_TOL;
				res->edge_drawn += drawn;
				bad = !drawn && got != clear_rgba8;
				res->bad_edge += bad;
			}
			if (bad && !res->have_first) {
				res->have_first = true;
				res->first_x = x;
				res->first_y = y;
				res->first_got = got;
				res->first_want = want;
			}
		}
	}
	res->counted = res->n_in + res->n_out + res->n_edge == res->total && res->n_in > 0 &&
		       res->n_out > 0;
	/* the if variant proves both arms only when both sides were drawn */
	if (r->if_variant && (res->n_then == 0 || res->n_else == 0))
		res->counted = false;
	/* the int variant proves each operation only when every band of i and
	 * both sides of each comparison were drawn out of every band */
	/* the discard variant proves the discard only with pixels of both kinds */
	if (r->discard_variant && (res->n_discarded == 0 || res->n_drawn == 0))
		res->counted = false;
	/* the fragcoord variant proves the flip only with pixels out of the band */
	if (r->fragcoord_variant && res->n_flip_right + res->n_flip_wrong == 0)
		res->counted = false;
	if (r->int_variant) {
		for (int k = 0; k < 4; k++)
			res->counted &= res->n_int_i[k] > 0;
		res->counted &= res->n_int_g[0] > 0 && res->n_int_g[1] > 0;
		res->counted &= res->n_int_b[0] > 0 && res->n_int_b[1] > 0;
	}
}

static inline bool tri_result_ok(const struct tri_result *res)
{
	return res->counted && !res->bad_in && !res->bad_out && !res->bad_edge;
}

#endif
```
