## CMakeLists.txt
```
# SPDX-License-Identifier: Apache-2.0
# SPDX-FileCopyrightText: 2026 Signal Slot, Inc.
# v3d_gl_femtovg: gl_femtovg's FemtoVG frame, drawn on the Raspberry Pi 4's V3D
# through YakoGL (GL core, in-process compiler, V3D backend, the Zephyr OSAL
# src/osal/zephyr_v3d.c), with every pixel of the known scene read back.
#
# What is shared, by path, never copied:
#   - the Rust staticlib (fvg_zephyr): ../gl_femtovg/rust (the Zephyr allocator
#     and panic handler around fvg_demo's fvg_draw_frame);
#   - the no_std femtovg/glow/fvg_demo workspace: FVG_NOSTD_DIR, recreated from
#     ../slint/nostd (README.md there);
#   - femtovg's own shader text (main-vs.glsl, main-fs.glsl) from that
#     workspace, which src/main.c compiles the way femtovg does, to name each
#     program's refusal before the frame (fvg_draw_frame only returns 1);
#   - the board support of v3d_clear (mailbox framebuffer, HDMI console,
#     bounded-lifetime watchdog), as v3d_gl_triangle compiles it.
# docs/online-shaderc/v3d-backend.md, "M7", is the plan this sample measures.
cmake_minimum_required(VERSION 3.20.0)

get_filename_component(PVR_REPO "${CMAKE_CURRENT_SOURCE_DIR}/../../.." ABSOLUTE)
include("${CMAKE_CURRENT_SOURCE_DIR}/../common/yakogl_dir.cmake")

find_package(Zephyr REQUIRED HINTS $ENV{ZEPHYR_BASE})
project(v3d_gl_femtovg)

execute_process(COMMAND git -C "${PVR_REPO}" describe --always --dirty
                OUTPUT_VARIABLE V3D_BUILD OUTPUT_STRIP_TRAILING_WHITESPACE
                RESULT_VARIABLE describe_rc)
if(NOT describe_rc EQUAL 0 OR V3D_BUILD STREQUAL "")
  set(V3D_BUILD "unknown")
endif()
target_compile_definitions(app PRIVATE V3D_BUILD="${V3D_BUILD}")

set(V3D_BOARD "${CMAKE_CURRENT_SOURCE_DIR}/../../../zephyr/lib/board/rpi4")
target_include_directories(app PRIVATE
  "${V3D_BOARD}"
  "${YAKOGL_DIR}/src/osal"                # struct osal_zephyr_v3d_init
  "${PVR_REPO}/src/v3d"                   # struct v3d_clock_ops (v3d.h)
  "${PVR_REPO}/zephyr/lib/board/common")      # gc_font8x16.h only
target_sources(app PRIVATE
  src/main.c
  "${V3D_BOARD}/rpi_mbox.c"
  "${V3D_BOARD}/fbcon.c")
# The bounded-lifetime watchdog, on by default: every board image carries it.
# V3D_RPI_WDOG=OFF is for a QEMU smoke run only (see v3d_gl_triangle).
option(V3D_RPI_WDOG "the PM watchdog that resets the board ~60 s after boot" ON)
if(V3D_RPI_WDOG)
  target_sources(app PRIVATE "${V3D_BOARD}/rpi_wdog.c")
else()
  message(WARNING "v3d_gl_femtovg: built WITHOUT the watchdog (V3D_RPI_WDOG=OFF): QEMU only, never the board")
  target_compile_definitions(app PRIVATE V3D_NO_RPI_WDOG)
endif()

# ---------------------------------------------------------------------------
# The no_std FemtoVG workspace.
# ---------------------------------------------------------------------------
if(NOT FVG_NOSTD_DIR AND DEFINED ENV{FVG_NOSTD_DIR})
  set(FVG_NOSTD_DIR "$ENV{FVG_NOSTD_DIR}")
endif()
if(NOT FVG_NOSTD_DIR OR NOT EXISTS "${FVG_NOSTD_DIR}/fvg_demo/Cargo.toml")
  message(FATAL_ERROR
    "v3d_gl_femtovg: FVG_NOSTD_DIR='${FVG_NOSTD_DIR}' is not the no_std FemtoVG "
    "workspace (no fvg_demo/Cargo.toml). Recreate it as "
    "../slint/nostd/README.md says and pass -DFVG_NOSTD_DIR=<path>.")
endif()

# femtovg's 30 programs through GL, from the shader text of the femtovg tree
# the Rust archive builds (src/fvg_programs.h).
include("${CMAKE_CURRENT_SOURCE_DIR}/fvg_programs.cmake")
v3d_fvg_programs("${FVG_NOSTD_DIR}/femtovg")

# ---------------------------------------------------------------------------
# The Rust staticlib: gl_femtovg's crate, built here for aarch64-unknown-none.
# ---------------------------------------------------------------------------
find_program(CARGO cargo REQUIRED)
set(CARGO_SRC "${CMAKE_CURRENT_SOURCE_DIR}/../gl_femtovg/rust")
set(cargo_build_dir "${CMAKE_CURRENT_BINARY_DIR}/rust")
set(cargo_target_dir "${cargo_build_dir}/target")
set(RUST_TARGET aarch64-unknown-none)
set(fvg_staticlib "${cargo_target_dir}/${RUST_TARGET}/release/libfvg_zephyr.a")
file(MAKE_DIRECTORY "${cargo_build_dir}")
configure_file("${CARGO_SRC}/Cargo.toml.in" "${cargo_build_dir}/Cargo.toml" @ONLY)

file(GLOB_RECURSE fvg_rust_srcs CONFIGURE_DEPENDS
     "${CARGO_SRC}/src/*.rs"
     "${FVG_NOSTD_DIR}/fvg_demo/src/*.rs"
     "${FVG_NOSTD_DIR}/femtovg/src/*.rs"
     "${FVG_NOSTD_DIR}/femtovg/src/*.glsl"
     "${FVG_NOSTD_DIR}/glow/src/*.rs")

add_custom_command(
  OUTPUT "${fvg_staticlib}"
  COMMAND ${CMAKE_COMMAND} -E env
          "CARGO_TARGET_DIR=${cargo_target_dir}"
          ${CARGO} build --release
          -Z build-std=core,alloc
          --target ${RUST_TARGET}
          --manifest-path "${cargo_build_dir}/Cargo.toml"
  DEPENDS ${fvg_rust_srcs} "${cargo_build_dir}/Cargo.toml"
  WORKING_DIRECTORY "${cargo_build_dir}"
  COMMENT "cargo build fvg_zephyr (${RUST_TARGET}, release)"
  VERBATIM)
add_custom_target(fvg_zephyr_build DEPENDS "${fvg_staticlib}")
add_dependencies(app fvg_zephyr_build)
target_link_libraries(app PRIVATE "${fvg_staticlib}")
```

## prj.conf
```kconfig
# SPDX-License-Identifier: Apache-2.0
# SPDX-FileCopyrightText: 2026 Signal Slot, Inc.
# YakoGL on the Raspberry Pi 4's V3D, with the in-process compiler (the V3D's
# only shader back end). The GL reports ES 2.0, the conformance-tested surface.
CONFIG_YAKOGL=y
CONFIG_YAKOGL_SHADERC_ONLINE=y
CONFIG_YAKOGL_GPU_V3D=y
# 48 MiB of GPU memory (a static of the image; see the board overlay).
CONFIG_YAKOGL_V3D_CARVEOUT_BYTES=50331648

# The console is the HDMI framebuffer (driver/zephyr/lib/board/rpi4/fbcon.c): printk and
# LOG_* are drawn there. The mini UART stays on as well.
CONFIG_PRINTK=y
CONFIG_LOG=y
CONFIG_LOG_MODE_MINIMAL=y
CONFIG_CACHE_MANAGEMENT=y

# The Rust archives are hard-float, and the GL calls and the compiler use the
# FPU; one thread calls GL, but the logging and timer threads exist too.
CONFIG_FPU=y
CONFIG_FPU_SHARING=y

# The compiler runs on the thread that calls glCompileShader/glLinkProgram and
# needs 256 KiB of stack (zephyr/Kconfig, YAKOGL_SHADERC_ONLINE); FemtoVG's
# path flattening runs on it too.
CONFIG_MAIN_STACK_SIZE=262144
# FemtoVG allocates through the C heap (../gl_femtovg/rust: aligned_alloc and
# free); gl_femtovg gives it 16 MiB, and so does this. glShaderSource keeps a
# copy of each source there too.
CONFIG_COMMON_LIBC_MALLOC=y
CONFIG_COMMON_LIBC_MALLOC_ARENA_SIZE=16777216

# Address space: the image (96 MiB of RAM, the overlay), the carve-out's
# non-cacheable alias (48 MiB), the 3.6 MiB framebuffer and the device blocks.
CONFIG_MAX_XLAT_TABLES=64
CONFIG_KERNEL_VM_SIZE=0x10000000
```

## boards/rpi_4b.overlay
```dts
/* SPDX-License-Identifier: Apache-2.0 */
/* SPDX-FileCopyrightText: 2026 Signal Slot, Inc. */
/*
 * The board's sram0 is 512 KiB at 0x200000 (dts/arm64/broadcom/bcm2711.dtsi).
 * This image carries the V3D's 48 MiB carve-out, the compiler's 2 MiB
 * scratch and the 16 MiB C heap FemtoVG allocates from as statics, so it
 * gets 96 MiB from 0x200000. DRAM starts at 0 on the
 * Pi 4 and the firmware keeps its own memory at the top of the first GiB, so
 * this is ARM memory on every Pi 4 (v3d_clear and v3d_triangle ran with the
 * first 32 MiB of it).
 */
#include "../../common/rpi_4b_sram.dtsi"

&sram0 {
	reg = <0x200000 0x6000000>;
};
```

## src/main.c
```c
/* SPDX-License-Identifier: Apache-2.0 */
/* SPDX-FileCopyrightText: 2026 Signal Slot, Inc. */
/*
 * v3d_gl_femtovg: the Raspberry Pi 4 sibling of gl_femtovg -- one FemtoVG
 * frame (fvg_demo's fvg_draw_frame, through gl_femtovg's Rust staticlib),
 * drawn by YakoGL's GL core, its in-process compiler and its V3D backend,
 * with every pixel of the window read back and judged against the scene.
 *
 * The board support is v3d_gl_triangle's: the firmware framebuffer is the
 * console (top half) and the EGL window (bottom half, 1280x360); the
 * watchdog returns the board to Linux.
 *
 * Two steps, each with its own verdict:
 *
 * 1. The programs. femtovg compiles all 30 of its programs when the canvas
 *    is created (renderer/opengl.rs, new_from_context), whether a frame uses
 *    them or not, and fvg_draw_frame then returns 1 with no reason. So this
 *    sample first builds the same 30 programs from femtovg's own shader text
 *    (fvg_programs.h) and prints each program that
 *    does not link with its info log, a histogram keyed on the whole log,
 *    and the program femtovg stops at: the first in its order that fails.
 *
 * 2. The frame. fvg_draw_frame draws fvg_demo's scene (the constants below
 *    mirror fvg_demo/src/lib.rs): a clear to rgb(24,24,32), a solid rounded
 *    rect, a vertical linear gradient rect and a stroked polyline. Every
 *    pixel of the window is put in one class by its position (canvas
 *    coordinates: y down, which is the buffer's row order; pixel centres):
 *
 *      rrect    at least FILL_MARGIN inside the rounded rect: rgb(80,160,240)
 *      grad     at least FILL_MARGIN inside the gradient rect: the colour
 *               mixed at the pixel centre, within GRAD_TOL (femtovg dithers
 *               gradients by +-0.5 of an 8-bit step, main-fs.glsl)
 *      stroke   within STROKE_CORE of a segment's centre line and at least
 *               STROKE_END_GAP from its ends: rgb(120,240,160)
 *      bg       clear of every shape by the margins below: rgb(24,24,32)
 *      edge     everything else (anti-aliased fringes, joins): counted only
 *
 *    and alpha is 255 in every checked class. The row above the window must
 *    keep the value the CPU wrote, and four glReadPixels reads are compared
 *    with memory.
 *
 * Every step prints its raw result; the verdict line names what failed.
 */
#include <zephyr/kernel.h>
#include <zephyr/sys/printk.h>
#include <zephyr/sys/printk-hooks.h>
#include <errno.h>
#include <math.h>
#include <stdio.h>
#include <string.h>

#include <EGL/egl.h>
#include <GLES2/gl2.h>

#include "osal_internal.h" /* struct osal_zephyr_v3d_init */
#include "rpi_mbox.h"
#include "fbcon.h"
#include "rpi_wdog.h"
#include "fvg_programs.h" /* step 1 */

#ifndef V3D_BUILD
#define V3D_BUILD "unknown"
#endif

#define FB_W 1280
#define FB_H 720

#define SENTINEL 0xffff00ffu /* magenta, written by the CPU beforehand */
#define GUARD    0xff0000ffu /* red, the row above the window */

/* ---- the scene: fvg_demo/src/lib.rs, fvg_draw_frame ----------------------- */

#define RGBA8(r, g, b) (0xff000000u | (uint32_t)(b) << 16 | (uint32_t)(g) << 8 | (uint32_t)(r))
#define FVG_BG     RGBA8(24, 24, 32)
#define FVG_RRECT  RGBA8(80, 160, 240)
#define FVG_STROKE RGBA8(120, 240, 160)

/* The console hook before fbcon's (the UART) and fbcon's own. fbcon_attach()
 * replaces the printk hook, so without this the UART gets nothing after it;
 * with it every line goes to both, and the host's UART log has what the screen
 * has (v3d_deqp does the same). */
static printk_hook_fn_t uart_out, fbcon_out;
/* The UART is polled: every character a timed step prints waits for it
 * (86.8 us at 115200 8N1). The time is added up here, so each timed step
 * also reports itself without it (uart_us). */
static uint64_t uart_cycles;

static int console_tee(int c)
{
	if (uart_out) {
		uint32_t t0 = k_cycle_get_32();
		uart_out(c);
		uart_cycles += k_cycle_get_32() - t0;
	}
	return fbcon_out ? fbcon_out(c) : c;
}

static int64_t uart_us(void)
{
	return (int64_t)k_cyc_to_us_floor64(uart_cycles);
}

static const float grad_top[3] = { 240, 80, 120 }, grad_bot[3] = { 250, 210, 90 };
#define FVG_RRECT_RADIUS 16.0f
#define FVG_STROKE_WIDTH 6.0f
/* the polyline's points, as fractions of the window */
static const float stroke_pts[5][2] = {
	{ 0.10f, 0.75f }, { 0.30f, 0.55f }, { 0.50f, 0.80f }, { 0.70f, 0.55f }, { 0.90f, 0.75f },
};

/* femtovg's fringe is 1 px (fringe_width = 1 / dpi): the anti-aliased band of
 * a fill is within 0.5 px of the path, of a stroke within 0.5 px of its outer
 * edge; the margins below keep every checked pixel out of it with room. */
#define FILL_MARGIN    2.0f
#define STROKE_CORE    1.5f  /* strokeMask is 1 up to 2.5 px off the centre line */
#define STROKE_END_GAP 12.0f /* joins (miter) and butt caps stay out of the class */
#define BG_STROKE_GAP  (FVG_STROKE_WIDTH / 2 + 3.0f)
#define BG_JOIN_GAP    24.0f /* a miter tip at these angles is ~3.1 px; generous */
#define EXACT_TOL      1u
#define GRAD_TOL       2u

/* Why the run failed; NULL after a pass. */
static const char *verdict_what = "the run did not reach the check";
static char verdict_buf[200];

static int clk_set(void *ctx, bool on)
{
	ARG_UNUSED(ctx);
	int ret = rpi_clock_state(RPI_FW_CLK_V3D, on);
	printk("  fw clock 5 %s: %d%s\n", on ? "on" : "off", ret, ret ? " (not fatal)" : "");
	return 0; /* as v3d_triangle: which clock the toggle needs is a board question */
}

static struct osal_zephyr_v3d_init plat = { .clock_set = clk_set };

/* ---- step 2: the frame and its check ------------------------------------- */

/* fvg_draw_frame (fvg_demo, re-exported by gl_femtovg/rust): one frame through
 * the current context; 0 on success, 1 when the renderer (its programs) could
 * not be created, 2 when the canvas could not. */
int fvg_draw_frame(const void *(*get_proc)(const char *name), uint32_t width, uint32_t height);

static const void *fvg_get_proc(const char *name)
{
	return (const void *)eglGetProcAddress(name);
}

/* femtovg's sdroundrect (main-fs.glsl) for a rect at (x, y): negative inside */
static float sd_rrect(float px, float py, float x, float y, float w, float h, float r)
{
	float cx = x + w * 0.5f, cy = y + h * 0.5f;
	float dx = fabsf(px - cx) - (w * 0.5f - r), dy = fabsf(py - cy) - (h * 0.5f - r);
	float ox = dx > 0 ? dx : 0, oy = dy > 0 ? dy : 0;
	float in = dx > dy ? dx : dy;
	return (in < 0 ? in : 0) + sqrtf(ox * ox + oy * oy) - r;
}

/* distance from p to segment ab, and where along it (0..len) the foot is */
static float seg_dist(float px, float py, float ax, float ay, float bx, float by, float *along,
		      float *len)
{
	float dx = bx - ax, dy = by - ay;
	float l2 = dx * dx + dy * dy;
	float t = ((px - ax) * dx + (py - ay) * dy) / l2;
	t = t < 0 ? 0 : t > 1 ? 1 : t;
	float fx = ax + t * dx - px, fy = ay + t * dy - py;
	*len = sqrtf(l2);
	*along = t * *len;
	return sqrtf(fx * fx + fy * fy);
}

static uint32_t max_diff(uint32_t a, uint32_t b)
{
	uint32_t m = 0;
	for (int c = 0; c < 4; c++) {
		int d = (int)((a >> (8 * c)) & 0xff) - (int)((b >> (8 * c)) & 0xff);
		uint32_t ad = (uint32_t)(d < 0 ? -d : d);
		if (ad > m)
			m = ad;
	}
	return m;
}

/* The two fringe classes check the anti-aliased edges, which the others
 * leave out: a pixel centre 0.2-0.8 of the way through a 1-px fringe must
 * be drawn partly, strictly between the background and the shape's colour
 * (within FRINGE_TOL of that range, and more than FRINGE_TOL from the
 * background). The stroke's fringe is drawn by femtovg's second stroke pass
 * (stencil EQUAL 0 after a first pass that discards and increments the
 * stencil); the rounded rect's by a plain convex fill, the control. The
 * first Slint frame on the board lost a stroke fringe (the track point). */
enum cls { C_RRECT, C_GRAD, C_STROKE, C_BG, C_SFRINGE, C_RFRINGE, C_EDGE, C_N };
static const char *const cls_name[C_N] = { "rrect", "grad", "stroke", "bg", "sfringe", "rfringe", "edge" };
#define FRINGE_TOL 2u

struct result {
	uint32_t total, n[C_N], bad[C_N], worst[C_N];
	bool have_first;
	enum cls first_cls;
	uint32_t first_x, first_y, first_got, first_want;
};

static void check_window(const uint8_t *win, uint32_t pitch, uint32_t w, uint32_t h,
			 struct result *r)
{
	const float W = (float)w, H = (float)h;
	/* fvg_draw_frame's geometry */
	const float rx = W * 0.08f, ry = H * 0.10f, rw = W * 0.36f, rh = H * 0.30f;
	const float gx = W * 0.54f, gy = H * 0.10f, gw = W * 0.38f, gh = H * 0.30f;
	float sp[5][2];
	for (int i = 0; i < 5; i++) {
		sp[i][0] = stroke_pts[i][0] * W;
		sp[i][1] = stroke_pts[i][1] * H;
	}

	memset(r, 0, sizeof(*r));
	for (uint32_t row = 0; row < h; row++) {
		const uint32_t *p = (const uint32_t *)(win + (size_t)row * pitch);
		float y = (float)row + 0.5f;
		for (uint32_t col = 0; col < w; col++) {
			float x = (float)col + 0.5f;
			uint32_t got = p[col], want = 0, tol = EXACT_TOL;
			enum cls c = C_EDGE;

			float d_rrect = sd_rrect(x, y, rx, ry, rw, rh, FVG_RRECT_RADIUS);
			float gdx = fmaxf(gx - x, x - (gx + gw)), gdy = fmaxf(gy - y, y - (gy + gh));
			float d_grad = fmaxf(gdx, gdy); /* box distance, negative inside */
			float d_line = 1e30f, d_join = 1e30f;
			bool core = false, sfringe = false;
			for (int s = 0; s < 4; s++) {
				float along, len;
				float d = seg_dist(x, y, sp[s][0], sp[s][1], sp[s + 1][0], sp[s + 1][1],
						   &along, &len);
				if (d < d_line)
					d_line = d;
				if (d <= STROKE_CORE && along >= STROKE_END_GAP &&
				    along <= len - STROKE_END_GAP)
					core = true;
				/* femtovg: alpha = 3.5 - d over the outer pixel of a width-6
				 * stroke with a 1-px fringe; 2.7..3.3 is alpha 0.8..0.2 */
				if (d >= 2.7f && d <= 3.3f && along >= STROKE_END_GAP &&
				    along <= len - STROKE_END_GAP)
					sfringe = true;
			}
			for (int i = 0; i < 5; i++) {
				float jx = x - sp[i][0], jy = y - sp[i][1];
				float d = sqrtf(jx * jx + jy * jy);
				if (d < d_join)
					d_join = d;
			}

			if (d_rrect <= -FILL_MARGIN && d_line > BG_STROKE_GAP) {
				c = C_RRECT;
				want = FVG_RRECT;
			} else if (d_grad <= -FILL_MARGIN && d_line > BG_STROKE_GAP) {
				float t = (y - gy) / gh;
				t = t < 0 ? 0 : t > 1 ? 1 : t;
				want = 0xff000000u;
				for (int k = 0; k < 3; k++) {
					float v = grad_top[k] + t * (grad_bot[k] - grad_top[k]);
					want |= (uint32_t)(v + 0.5f) << (8 * k);
				}
				c = C_GRAD;
				tol = GRAD_TOL;
			} else if (core && d_rrect > FILL_MARGIN && d_grad > FILL_MARGIN) {
				c = C_STROKE;
				want = FVG_STROKE;
			} else if (d_rrect >= FILL_MARGIN && d_grad >= FILL_MARGIN &&
				   d_line >= BG_STROKE_GAP && d_join >= BG_JOIN_GAP) {
				c = C_BG;
				want = FVG_BG;
			} else if (sfringe && d_line >= 2.7f && d_join >= STROKE_END_GAP &&
				   d_rrect > FILL_MARGIN && d_grad > FILL_MARGIN) {
				c = C_SFRINGE;
				want = FVG_STROKE;
			} else if (fabsf(d_rrect) <= 0.3f && d_line > BG_STROKE_GAP) {
				/* the fill's fringe is centred on the path: alpha 0.2..0.8 */
				c = C_RFRINGE;
				want = FVG_RRECT;
			}

			r->total++;
			r->n[c]++;
			if (c == C_EDGE)
				continue;
			if (c == C_SFRINGE || c == C_RFRINGE) {
				/* drawn partly: inside [bg, colour] per channel, not bg */
				bool inside = (got >> 24) == 0xff;
				for (int k = 0; k < 3; k++) {
					int g = (int)((got >> (8 * k)) & 0xff), b = (int)((FVG_BG >> (8 * k)) & 0xff),
					    f = (int)((want >> (8 * k)) & 0xff);
					int lo = (b < f ? b : f) - (int)FRINGE_TOL, hi = (b > f ? b : f) + (int)FRINGE_TOL;
					inside &= g >= lo && g <= hi;
				}
				uint32_t from_bg = max_diff(got, FVG_BG);
				if (from_bg > r->worst[c])
					r->worst[c] = from_bg; /* here: the largest distance from bg */
				if (!inside || from_bg <= FRINGE_TOL) {
					r->bad[c]++;
					if (!r->have_first) {
						r->have_first = true;
						r->first_cls = c;
						r->first_x = col;
						r->first_y = row;
						r->first_got = got;
						r->first_want = want;
					}
				}
				continue;
			}
			uint32_t md = max_diff(got, want);
			if (md > r->worst[c])
				r->worst[c] = md;
			if (md > tol || (got >> 24) != 0xff) {
				r->bad[c]++;
				if (!r->have_first) {
					r->have_first = true;
					r->first_cls = c;
					r->first_x = col;
					r->first_y = row;
					r->first_got = got;
					r->first_want = want;
				}
			}
		}
	}
}

/* glReadPixels at GL (x, y) against the window memory at row h - 1 - y. */
static bool read_matches(const uint8_t *win, uint32_t pitch, uint32_t h, GLint x, GLint y)
{
	uint8_t px[4] = { 0 };
	glReadPixels(x, y, 1, 1, GL_RGBA, GL_UNSIGNED_BYTE, px);
	uint32_t via_gl = (uint32_t)px[0] | (uint32_t)px[1] << 8 | (uint32_t)px[2] << 16 |
			  (uint32_t)px[3] << 24;
	uint32_t mem = ((const uint32_t *)(win + (size_t)(h - 1 - (uint32_t)y) * pitch))[x];
	printk("  glReadPixels(%4d,%3d) = 0x%08x, memory 0x%08x%s\n", x, y, via_gl, mem,
	       via_gl == mem ? "" : "  DIFFERENT");
	return via_gl == mem;
}

/* ---- the run --------------------------------------------------------------- */

static struct fvg_survey sv;

static bool egl_up(uint32_t window_phys, uint32_t w, uint32_t h, uint32_t pitch, EGLDisplay *dpy_out,
		   EGLSurface *surf_out)
{
	/* femtovg fills concave paths and strokes through the stencil */
	static const EGLint cfg_attribs[] = {
		EGL_RED_SIZE, 8, EGL_GREEN_SIZE, 8, EGL_BLUE_SIZE, 8, EGL_ALPHA_SIZE, 8,
		EGL_STENCIL_SIZE, 8, EGL_SURFACE_TYPE, EGL_WINDOW_BIT,
		EGL_RENDERABLE_TYPE, EGL_OPENGL_ES2_BIT, EGL_NONE,
	};
	static const EGLint ctx_attribs[] = { EGL_CONTEXT_CLIENT_VERSION, 2, EGL_NONE };
	static struct gles_native_window win;
	win = (struct gles_native_window){
		.phys = window_phys, .width = w, .height = h, .stride_bytes = pitch,
		.format = GLES_NATIVE_FORMAT_RGBA8888,
	};
	EGLDisplay dpy = eglGetDisplay((EGLNativeDisplayType)&plat);
	EGLConfig cfg;
	EGLint n = 0;

	if (!eglInitialize(dpy, NULL, NULL)) {
		printk("  eglInitialize: 0x%x\n", eglGetError());
		verdict_what = "EGL did not initialise (the V3D, the OSAL or the backend)";
		return false;
	}
	if (!eglChooseConfig(dpy, cfg_attribs, &cfg, 1, &n) || n != 1) {
		printk("  eglChooseConfig: 0x%x\n", eglGetError());
		verdict_what = "no EGL config matches an RGBA8888 window with stencil";
		return false;
	}
	/* each call checked on its own: eglGetError reports the LAST call only */
	EGLSurface surf = eglCreateWindowSurface(dpy, cfg, &win, NULL);
	if (surf == EGL_NO_SURFACE) {
		printk("  eglCreateWindowSurface failed: EGL error 0x%x\n", eglGetError());
		verdict_what = "the EGL window surface was not created";
		return false;
	}
	EGLContext ctx = eglCreateContext(dpy, cfg, EGL_NO_CONTEXT, ctx_attribs);
	if (ctx == EGL_NO_CONTEXT) {
		printk("  eglCreateContext failed: EGL error 0x%x\n", eglGetError());
		verdict_what = "the EGL context was not created";
		return false;
	}
	if (!eglMakeCurrent(dpy, surf, surf, ctx)) {
		printk("  eglMakeCurrent failed: EGL error 0x%x\n", eglGetError());
		verdict_what = "the EGL context could not be made current";
		return false;
	}
	printk("  GL_RENDERER %s, GL_VERSION %s\n", (const char *)glGetString(GL_RENDERER),
	       (const char *)glGetString(GL_VERSION));
	*dpy_out = dpy;
	*surf_out = surf;
	return true;
}

static void run(void)
{
	struct rpi_fb fb;
	printk("v3d_gl_femtovg: start (the UART only until the screen console is up)\n");
	int ret = rpi_mbox_init();
	if (ret == 0)
		ret = rpi_fb_alloc(FB_W, FB_H, &fb);
	if (ret)
		return; /* no screen: nothing can be reported */
	uint32_t half = fb.height / 2;
	uart_out = __printk_get_hook();
	fbcon_attach(fb.cpu, fb.width, fb.pitch, half, 1);
	fbcon_out = __printk_get_hook();
	__printk_hook_install(console_tee);
	printk("v3d_gl_femtovg: build %s\n", V3D_BUILD);
#ifdef V3D_NO_RPI_WDOG
	printk("board: NO watchdog (a QEMU build, V3D_RPI_WDOG=OFF)\n");
#else
	rpi_wdog_announce();
#endif
	printk("fb %ux%u pitch %u phys 0x%08x\n", fb.width, fb.height, fb.pitch, fb.phys);

	uint32_t hz = 0, max_hz = 0;
	if (rpi_clock_max_rate(RPI_FW_CLK_V3D, &max_hz) == 0 && max_hz &&
	    rpi_clock_rate(RPI_FW_CLK_V3D, &hz) == 0 && hz != max_hz) {
		ret = rpi_clock_set_rate(RPI_FW_CLK_V3D, max_hz);
		printk("V3D clock %u -> %u Hz (%d)\n", hz, max_hz, ret);
	}

	uint32_t w = fb.width, h = fb.height - half;
	uint8_t *win = fb.cpu + (size_t)half * fb.pitch;
	for (uint32_t y = 0; y < h; y++) {
		uint32_t *p = (uint32_t *)(win + (size_t)y * fb.pitch);
		for (uint32_t x = 0; x < w; x++)
			p[x] = SENTINEL;
	}
	uint32_t *guard = (uint32_t *)(fb.cpu + (size_t)(half - 1) * fb.pitch);
	for (uint32_t x = 0; x < fb.width; x++)
		guard[x] = GUARD;

	EGLDisplay dpy;
	EGLSurface surf;
	if (!egl_up(fb.phys + half * fb.pitch, w, h, fb.pitch, &dpy, &surf))
		return;

	/* step 1 */
	printk("progress: EGL up, survey start\n");
	int64_t u0 = uart_us();
	fvg_survey_run(&sv);
	int64_t survey_uart_us = uart_us() - u0;
	fvg_survey_print(&sv);

	/* step 2: femtovg sets its own viewport (set_size) */
	int64_t t0 = k_uptime_get();
	u0 = uart_us();
	printk("progress: frame start\n");
	int rc = fvg_draw_frame(fvg_get_proc, w, h);
	printk("progress: frame drawn (rc %d)\n", rc);
	GLenum err_draw = glGetError();
	if (rc != 0) {
		fvg_keep_print("after fvg_draw_frame failed (its canvas already dropped)");
		printk("fvg_draw_frame: %d (GL error 0x%x)\n", rc, err_draw);
		snprintf(verdict_buf, sizeof(verdict_buf), "fvg_draw_frame %d: %s", rc,
			 rc == 1 && sv.failed ? "femtovg's programs do not all link (above)" :
			 rc == 1 ? "the renderer did not start, yet every program linked here" :
				   "the canvas could not be created");
		verdict_what = verdict_buf;
		return;
	}
	/* fvg_demo's canvas and renderer are locals of fvg_draw_frame: its 30
	 * programs are already deleted here, so this is what stays resident (the
	 * backend's clear program); the peak includes the canvas. */
	fvg_keep_print("after fvg_draw_frame (its canvas already dropped)");
	/* submits the job and waits for it */
	printk("progress: swap start\n");
	eglSwapBuffers(dpy, surf);
	GLenum err = glGetError();
	printk("progress: swap done\n");
	int64_t frame_ms = k_uptime_get() - t0, frame_uart_us = uart_us() - u0;
	printk("frame: %lld ms, GL error 0x%x after the draw, 0x%x after the swap\n",
	       (long long)frame_ms, err_draw, err);
	printk("without the UART: survey %lld ms, frame %lld ms (the UART took %lld, %lld ms)\n",
	       (long long)(sv.ms - survey_uart_us / 1000), (long long)(frame_ms - frame_uart_us / 1000),
	       (long long)(survey_uart_us / 1000), (long long)(frame_uart_us / 1000));
	if (err_draw != GL_NO_ERROR || err != GL_NO_ERROR) {
		verdict_what = "the GL reported an error during the frame (a refused draw logs its reason above)";
		return;
	}

	struct result r;
	check_window(win, fb.pitch, w, h, &r);
	uint32_t guard_bad = 0;
	for (uint32_t x = 0; x < fb.width; x++)
		guard_bad += guard[x] != GUARD;
	bool reads = read_matches(win, fb.pitch, h, 1, 1) &&
		     read_matches(win, fb.pitch, h, (GLint)(w * 26 / 100), (GLint)(h * 75 / 100)) &&
		     read_matches(win, fb.pitch, h, (GLint)(w * 73 / 100), (GLint)(h * 75 / 100)) &&
		     read_matches(win, fb.pitch, h, (GLint)(w * 40 / 100), (GLint)(h * 35 / 100));

	printk("window %u px:", r.total);
	for (int c = 0; c < C_N; c++)
		printk(" %s %u", cls_name[c], r.n[c]);
	printk("\n");
	for (int c = 0; c < C_SFRINGE; c++)
		printk("  %-6s wrong %u (largest channel diff %u)\n", cls_name[c], r.bad[c], r.worst[c]);
	for (int c = C_SFRINGE; c < C_EDGE; c++)
		printk("  %-7s not drawn partly %u of %u (largest distance from bg %u)\n", cls_name[c], r.bad[c],
		       r.n[c], r.worst[c]);
	if (r.have_first)
		printk("  first wrong (%s) at %u,%u: 0x%08x, expected 0x%08x\n", cls_name[r.first_cls],
		       r.first_x, r.first_y, r.first_got, r.first_want);
	printk("  guard row %u of %u changed\n", guard_bad, fb.width);

	uint32_t sum = 0;
	bool every_class = true;
	for (int c = 0; c < C_N; c++) {
		sum += r.n[c];
		every_class &= r.n[c] > 0;
	}
	verdict_what = sum != r.total || r.total != w * h || !every_class ? "the pixel classes do not add up" :
		       r.bad[C_BG]     ? "background not the clear colour" :
		       r.bad[C_RRECT]  ? "rounded rect colour" :
		       r.bad[C_GRAD]   ? "gradient colour" :
		       r.bad[C_STROKE] ? "stroke colour" :
		       r.bad[C_SFRINGE] ? "the stroke's anti-aliased fringe is not drawn partly" :
		       r.bad[C_RFRINGE] ? "the rounded rect's anti-aliased fringe is not drawn partly" :
		       guard_bad       ? "the guard row changed" :
		       !reads          ? "glReadPixels differs from memory" :
					 NULL;
}

int main(void)
{
	run();
	/* The console scrolls: repeat the build, the program count and the
	 * verdict together so one photo carries all three. */
	printk("v3d_gl_femtovg: build %s\n", V3D_BUILD);
	if (sv.built + sv.failed)
		fvg_survey_print(&sv);
	printk("v3d_gl_femtovg: %s (%s)\n", verdict_what ? "FAIL" : "PASS",
	       verdict_what ? verdict_what : "a FemtoVG frame through YakoGL, every pixel read back");
	for (;;)
		k_sleep(K_FOREVER);
	return 0;
}
```

## src/fvg_programs.c
```c
/* SPDX-License-Identifier: Apache-2.0 */
/* SPDX-FileCopyrightText: 2026 Signal Slot, Inc. */
/* femtovg's 30 programs through GL: see fvg_programs.h. */
#include <zephyr/kernel.h>
#include <zephyr/sys/printk.h>
#include <stdbool.h>
#include <stdio.h>
#include <string.h>

#include <GLES2/gl2.h>

#include "fvg_programs.h"
#include "gles_shaderc.h" /* shc_online_keep_stats */
#include "fvg_glsl.h" /* fvg_main_vs, fvg_main_fs: femtovg's shader text */

/* femtovg's ShaderType numbers (renderer/params.rs) and names */
static const char *const fvg_type_name[10] = {
	"FillGradient", "FillImage", "Stencil", "FillImageGradient", "FilterImage",
	"FillColor", "TextureCopyUnclipped", NULL, "FillGradientConic", "FillImageGradientConic",
};

static char src_buf[16384];

/* The source femtovg's MainProgram::new passes to glShaderSource. */
static const char *fvg_source(bool vs, int type, bool glyph, bool no_discard)
{
	int n;
	if (vs) {
		n = snprintf(src_buf, sizeof(src_buf), "#version 100\n#define EDGE_AA 1\n%s", fvg_main_vs);
	} else {
		n = snprintf(src_buf, sizeof(src_buf),
			     "#version 100\n#define EDGE_AA 1\n#define SELECT_SHADER %d\n%s%s\n%s", type,
			     glyph ? "#define ENABLE_GLYPH_TEXTURE" : "",
			     no_discard ? "\n#define NO_DISCARD" : "", fvg_main_fs);
	}
	return n > 0 && (size_t)n < sizeof(src_buf) ? src_buf : NULL;
}

/* The info log with its line breaks as '|', so one row is one line. */
static void one_line(char *s)
{
	size_t n = strlen(s);
	while (n && (s[n - 1] == '\n' || s[n - 1] == ' '))
		s[--n] = 0;
	for (char *p = s; *p; p++)
		if (*p == '\n')
			*p = '|';
}

/* Build one program as femtovg's Program::new does: compile both stages,
 * attach, bind the attributes, link, then detach and delete the shaders.
 * The program stays alive (*out), as femtovg keeps all 30 at once: what the
 * compiler holds for 30 live programs is what femtovg's canvas needs.
 * 0 when it links, else the log (compile or link) and no program. */
static int fvg_program(int type, bool glyph, bool no_discard, char *log, size_t logsz, GLuint *out)
{
	GLuint sh[2] = { 0, 0 }, prog = 0;
	int rc = 0;
	log[0] = 0;
	for (int s = 0; s < 2 && rc == 0; s++) {
		const char *src = fvg_source(s == 0, type, glyph, no_discard);
		if (!src) {
			snprintf(log, logsz, "(the sample's source buffer is too small)");
			return -1;
		}
		GLint ok = 0;
		sh[s] = glCreateShader(s == 0 ? GL_VERTEX_SHADER : GL_FRAGMENT_SHADER);
		glShaderSource(sh[s], 1, &src, NULL);
		glCompileShader(sh[s]);
		glGetShaderiv(sh[s], GL_COMPILE_STATUS, &ok);
		if (!ok) {
			int k = snprintf(log, logsz, "%s compile: ", s == 0 ? "vs" : "fs");
			glGetShaderInfoLog(sh[s], (GLsizei)(logsz - (size_t)k), NULL, log + k);
			rc = -1;
		}
	}
	if (rc == 0) {
		GLint ok = 0;
		prog = glCreateProgram();
		glAttachShader(prog, sh[0]);
		glAttachShader(prog, sh[1]);
		/* program.rs Program::new binds these before the link */
		glBindAttribLocation(prog, 0, "vertex");
		glBindAttribLocation(prog, 1, "tcoord");
		glLinkProgram(prog);
		glGetProgramiv(prog, GL_LINK_STATUS, &ok);
		if (!ok) {
			int k = snprintf(log, logsz, "link: ");
			glGetProgramInfoLog(prog, (GLsizei)(logsz - (size_t)k), NULL, log + k);
			rc = -1;
		}
	}
	for (int s = 0; s < 2; s++) {
		if (sh[s]) {
			if (prog)
				glDetachShader(prog, sh[s]);
			glDeleteShader(sh[s]);
		}
	}
	if (rc == 0) {
		*out = prog;
	} else if (prog) {
		glDeleteProgram(prog);
	}
	one_line(log);
	return rc;
}

void fvg_survey_run(struct fvg_survey *sv)
{
	/* renderer/opengl.rs new_from_context: (glyph, no_discard) in this order,
	 * each a generate_shader_program_variants array indexed by ShaderType */
	static const bool sets[4][2] = { { true, false }, { false, false }, { true, true }, { false, true } };
	char log[FVG_LOG_KEEP];
	GLuint live[FVG_PROGRAMS];
	unsigned nlive = 0;
	int64_t t0 = k_uptime_get();

	memset(sv, 0, sizeof(*sv));
	for (int set = 0; set < 4; set++) {
		bool glyph = sets[set][0], nd = sets[set][1];
		for (int type = 0; type < 10; type++) {
			/* the None entries: 7 never; Stencil, FilterImage and
			 * TextureCopyUnclipped only without the glyph texture */
			if (type == 7 || (glyph && (type == 2 || type == 4 || type == 6)))
				continue;
			bool prog_nd = type == 6 ? false : nd; /* "has no stroke test to drop" */
			GLuint prog = 0;
			int64_t tp = k_uptime_get();
			printk("  program %2u %s%s%s: ", sv->built + sv->failed + 1, fvg_type_name[type],
			       glyph ? " glyph" : "", prog_nd ? " nodiscard" : "");
			if (fvg_program(type, glyph, prog_nd, log, sizeof(log), &prog) == 0) {
				printk("ok (%lld ms)\n", (long long)(k_uptime_get() - tp));
				sv->built++;
				if (nlive < FVG_PROGRAMS)
					live[nlive++] = prog;
				continue;
			}
			sv->failed++;
			printk("FAIL: %s\n", log);
			if (!sv->first[0])
				snprintf(sv->first, sizeof(sv->first), "%s%s%s: %s", fvg_type_name[type],
					 glyph ? " glyph" : "", prog_nd ? " nodiscard" : "", log);
			unsigned r = 0;
			while (r < sv->nrows && strcmp(sv->rows[r].log, log) != 0)
				r++;
			if (r == sv->nrows && sv->nrows < ARRAY_SIZE(sv->rows)) {
				strncpy(sv->rows[r].log, log, FVG_LOG_KEEP - 1);
				sv->nrows++;
			}
			if (r < sv->nrows)
				sv->rows[r].n++;
		}
	}
	fvg_keep_print("with the survey's programs alive");
	/* femtovg's own programs are built next: give back everything */
	for (unsigned i = 0; i < nlive; i++)
		glDeleteProgram(live[i]);
	sv->ms = k_uptime_get() - t0;
}

void fvg_survey_print(const struct fvg_survey *sv)
{
	printk("femtovg programs: %u of %u link (%lld ms)\n", sv->built, sv->built + sv->failed,
	       (long long)sv->ms);
	for (unsigned r = 0; r < sv->nrows; r++)
		printk("  %2u x %s\n", sv->rows[r].n, sv->rows[r].log);
	if (sv->first[0])
		printk("  femtovg stops at %s\n", sv->first);
}

void fvg_keep_print(const char *when)
{
	size_t in_use = 0, peak = 0;
	int rc = shc_online_keep_stats(&in_use, &peak);
	if (rc != 0) {
		printk("keep: shc_online_keep_stats %d %s\n", rc, when);
		return;
	}
#ifdef CONFIG_YAKOGL_SHADERC_KEEP_BYTES
	printk("keep used %zu (peak %zu) of %d bytes %s\n", in_use, peak, CONFIG_YAKOGL_SHADERC_KEEP_BYTES, when);
#else
	printk("keep used %zu (peak %zu) bytes (the crate's built-in region) %s\n", in_use, peak, when);
#endif
}
```

## src/fvg_programs.h
```c
/* SPDX-License-Identifier: Apache-2.0 */
/* SPDX-FileCopyrightText: 2026 Signal Slot, Inc. */
/*
 * femtovg's 30 programs, built through GL before femtovg builds them itself.
 *
 * femtovg compiles all its programs when a canvas is created
 * (renderer/opengl.rs, new_from_context), whether a frame uses them or not,
 * and a caller then learns only that the renderer did not start
 * (fvg_draw_frame returns 1; Slint's FemtoVGOpenGLRenderer::new returns an
 * error). This builds the same programs from femtovg's own shader text
 * (main-vs.glsl and main-fs.glsl, embedded by fvg_programs.cmake as
 * fvg_glsl.h), in femtovg's order and with its source layout (program.rs,
 * MainProgram::new), and keeps each link failure's log, a histogram keyed on
 * the whole log, and the program femtovg stops at: the first in its order
 * that fails. Like femtovg, it keeps every program alive while it builds the
 * next (the shaders are deleted after each link, the programs are not), so a
 * limit on what the compiler holds for live programs shows here, by name,
 * as it would in femtovg's canvas creation. Every program is deleted again
 * afterwards.
 *
 * Used by v3d_gl_femtovg; v3d_gl_cluster used it too until Step 5 deleted
 * it (Slint's renderer draws through the same no_std femtovg).
 */
#ifndef FVG_PROGRAMS_H
#define FVG_PROGRAMS_H

#include <stdint.h>

#define FVG_LOG_KEEP 160
#define FVG_PROGRAMS 30

struct fvg_fail_row {
	char log[FVG_LOG_KEEP];
	unsigned n;
};

struct fvg_survey {
	unsigned built, failed;
	struct fvg_fail_row rows[FVG_PROGRAMS];
	unsigned nrows;
	char first[FVG_LOG_KEEP + 64]; /* the program femtovg stops at, and why */
	int64_t ms;
};

/* Build the 30 programs on the current context; print each failure. */
void fvg_survey_run(struct fvg_survey *sv);

/* "femtovg programs: N of 30 link (T ms)", the histogram, the first stop. */
void fvg_survey_print(const struct fvg_survey *sv);

/* "keep used N (peak P) of M bytes <when>": what the in-process compiler
 * holds for the shaders and programs alive now (shc_online_keep_stats), and
 * the region's size (CONFIG_YAKOGL_SHADERC_KEEP_BYTES when the image lends
 * it). */
void fvg_keep_print(const char *when);

#endif
```
