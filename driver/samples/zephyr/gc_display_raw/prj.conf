## CMakeLists.txt
```
# SPDX-License-Identifier: Apache-2.0
# SPDX-FileCopyrightText: 2026 Signal Slot, Inc.
cmake_minimum_required(VERSION 3.20.0)

# The driver (repository root) is a Zephyr module; point ZEPHYR_EXTRA_MODULES
# at it unless a west manifest lists it.
get_filename_component(PVR_REPO "${CMAKE_CURRENT_SOURCE_DIR}/../../.." ABSOLUTE)
list(APPEND ZEPHYR_EXTRA_MODULES "${PVR_REPO}")

# The shared sample shape (bounded watchdog service, PASS/FAIL, PSCI reset).
set(ENV{GC_SAMPLE_COMMON_KCONFIG} "${CMAKE_CURRENT_SOURCE_DIR}/../gc_common/Kconfig")

find_package(Zephyr REQUIRED HINTS $ENV{ZEPHYR_BASE})
project(gc_display_raw)

include("${CMAKE_CURRENT_SOURCE_DIR}/../gc_common/gc_sample.cmake")
target_sources(app PRIVATE src/main.c)
```

## Kconfig
```
# SPDX-License-Identifier: Apache-2.0
# SPDX-FileCopyrightText: 2026 Signal Slot, Inc.
mainmenu "gc_display_raw"

source "$(GC_SAMPLE_COMMON_KCONFIG)"
source "Kconfig.zephyr"
```

## prj.conf
```kconfig
# SPDX-License-Identifier: Apache-2.0
# SPDX-FileCopyrightText: 2026 Signal Slot, Inc.
# The display driver alone: no panel console, no GPU. main() fills a buffer
# of its own with a colour ramp and asks the driver to scan it out.
CONFIG_SAFEUI_GPU_VIVANTE=n
CONFIG_GC_COMMON_PANEL_CONSOLE=n
CONFIG_UART_CONSOLE=n
CONFIG_CONSOLE=n
CONFIG_LOG=n
CONFIG_CACHE_MANAGEMENT=y
CONFIG_REBOOT=y
CONFIG_PM_CPU_OPS=y
CONFIG_PM_CPU_OPS_PSCI=y
CONFIG_GPIO=y
CONFIG_I2C=y
CONFIG_PINCTRL=y
CONFIG_SAFEUI_DISPLAY_IMX8MP=y
```

## src/main.c
```c
/* SPDX-License-Identifier: Apache-2.0 */
/* SPDX-FileCopyrightText: 2026 Signal Slot, Inc. */
/*
 * gc_display_raw - the display driver by itself, nothing else in the way.
 * A framebuffer of our own, a colour ramp in it, imx8mp_display_on(), and
 * the verdict in the hold time as every gc sample does it.
 */
#include <zephyr/kernel.h>
#include <zephyr/cache.h>
#include <zephyr/kernel/mm.h>
#include "gc_sample.h"
#include "imx8mp_display.h"

#define W 1280u
#define H 800u
#define PITCH (W * 4u)

static uint8_t fb[PITCH * H] __aligned(4096) __noinit;

int main(void)
{
	int rc;

	gc_sample_service_wdog();
	for (uint32_t y = 0; y < H; y++) {
		uint32_t *row = (uint32_t *)(fb + (size_t)y * PITCH);

		for (uint32_t x = 0; x < W; x++) {
			row[x] = 0xff000000u | ((x * 255u / W) << 16) | ((y * 255u / H) << 8) | 0x40u;
		}
	}
	sys_cache_data_flush_range(fb, sizeof(fb));
	rc = imx8mp_display_on(k_mem_phys_addr(fb), PITCH);
	gc_sample_verdict("gc_display_raw", rc == 0, rc == 0 ? NULL : "imx8mp_display_on failed");
	/* Whatever happened, say which stages are alive: the return time is
	 * 70 s + 3 s * the health bits (imx8mp_display.h), read after a
	 * second so the bridge and PLLs have had time to settle. */
	k_sleep(K_SECONDS(1));
	gc_sample_hold_code(imx8mp_display_health());
	gc_sample_finish();
	return 0;
}
```
