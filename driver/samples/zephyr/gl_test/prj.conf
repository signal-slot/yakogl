## CMakeLists.txt
```
# SPDX-License-Identifier: Apache-2.0
# SPDX-FileCopyrightText: 2026 Signal Slot, Inc.
# gl_test: the one GL suite image for the Verdin AM62P (PowerVR), the Verdin
# iMX8M Plus and Armadillo-X2 (Vivante GC7000UL), the STM32MP257F-DK's A35
# (Vivante GCNanoUltra31) and the Raspberry Pi 4 (V3D).
# tools/pvrlab/gl_test.c is the on-silicon GL test suite of the Linux harness;
# the same source runs here (printk instead of pr_info). The board is chosen by
# the Zephyr board (-b) only; there is no per-board option here. What differs
# per board is the board's main_*.c (the lines that start the back end and the
# board's way to give a verdict), the board layer (driver/zephyr/lib/board) and
# the board files under boards/.
cmake_minimum_required(VERSION 3.20.0)

# The driver (driver/) and YakoGL (the repository root) are Zephyr modules;
# point ZEPHYR_EXTRA_MODULES at both unless a west manifest lists them.
get_filename_component(PVR_REPO "${CMAKE_CURRENT_SOURCE_DIR}/../../.." ABSOLUTE)
include("${CMAKE_CURRENT_SOURCE_DIR}/../common/yakogl_dir.cmake")

# What the two i.MX8M Plus boards share is boards/imx8mp.conf; the Armadillo's
# console (UART2) comes after it, and the direct boot's after that. Zephyr merges EXTRA_CONF_FILE after
# boards/<board>.conf, and after a file named on the command line, so these
# two go first.
if(NOT BOARD AND DEFINED ENV{BOARD})
  set(BOARD "$ENV{BOARD}")
endif()
if(BOARD MATCHES "^(verdin_imx8mp|armadillo_x2)")
  set(_imx8mp_conf "${CMAKE_CURRENT_LIST_DIR}/boards/imx8mp.conf")
  if(BOARD MATCHES "^armadillo_x2")
    list(APPEND _imx8mp_conf "${CMAKE_CURRENT_LIST_DIR}/boards/armadillo_x2.conf")
  endif()
  # The direct boot (armadillo_x2/mimx8ml8/a53/direct) has no display node.
  if(BOARD MATCHES "^armadillo_x2/.*/direct$")
    list(APPEND _imx8mp_conf "${CMAKE_CURRENT_LIST_DIR}/boards/armadillo_x2_direct.conf")
  endif()
  set(EXTRA_CONF_FILE ${_imx8mp_conf} ${EXTRA_CONF_FILE})
endif()
# The STM32MP257F-DK's A35 takes the board layer's own board files, as
# gc_fence and gc_clear do (examples/zephyr.cmake): app.conf here (the
# Vivante driver, OP-TEE's watchdog, no hold), app.overlay through
# boards/stm32mp257f_dk_stm32mp257fxx_a35.overlay, and gl_test's own needs in
# boards/stm32mp257f_dk_stm32mp257fxx_a35.conf.
if(BOARD MATCHES "^stm32mp257f_dk")
  set(EXTRA_CONF_FILE "${PVR_REPO}/zephyr/lib/board/stm32mp2/app.conf" ${EXTRA_CONF_FILE})
endif()

find_package(Zephyr REQUIRED HINTS $ENV{ZEPHYR_BASE})
project(gl_test)

target_sources(app PRIVATE "${PVR_REPO}/tools/pvrlab/gl_test.c")

# Zero warnings in our C files is the rule: tools/check.sh builds this
# sample with -DYAKOGL_WERROR=ON (the "zephyr" rows). Off by default, so an
# application built with another toolchain is not stopped by a new warning.
if(YAKOGL_WERROR)
  target_compile_options(app PRIVATE -Werror)
endif()
target_include_directories(app PRIVATE
  "${PVR_REPO}/tools/pvrlab"
  "${YAKOGL_DIR}/include"
  "${YAKOGL_DIR}/src"
  "${YAKOGL_DIR}/src/osal"
  "${PVR_REPO}/src")

# GL_TEST_ES100=ON compiles the suite against the GL ES 1.00 shader set
# (tools/pvrlab/gl_test_shaders_es100.h) instead of the default GLSL 450 one:
# the set an ES 2.0 application could have written, and so the only one an
# ES 2.0 compiler can be asked to compile. Off by default, because the default
# set is what the offline table has always been measured with and the two must
# stay comparable on the same board. The Pi 4 always takes it (below).
option(GL_TEST_ES100 "Compile gl_test against the GL ES 1.00 shader set" OFF)
if(GL_TEST_ES100)
  target_compile_definitions(app PRIVATE GL_TEST_ES100=1)
  message(STATUS "gl_test: GL ES 1.00 shader set (GL_TEST_ES100=ON)")
endif()

if(CONFIG_YAKOGL_GPU_V3D)
  # ---- Raspberry Pi 4, V3D 4.2 ---------------------------------------------
  # Through YakoGL's GL core, its in-process compiler and its V3D backend
  # (docs/online-shaderc/v3d-backend.md, "M6 step B"). The board support (the
  # firmware framebuffer through the mailbox, the HDMI console, the
  # bounded-lifetime watchdog) is the rpi4 board layer's.
  execute_process(COMMAND git -C "${PVR_REPO}" describe --always --dirty
                  OUTPUT_VARIABLE V3D_BUILD OUTPUT_STRIP_TRAILING_WHITESPACE
                  RESULT_VARIABLE describe_rc)
  if(NOT describe_rc EQUAL 0 OR V3D_BUILD STREQUAL "")
    set(V3D_BUILD "unknown")
  endif()
  target_compile_definitions(app PRIVATE V3D_BUILD="${V3D_BUILD}")

  set(V3D_BOARD "${PVR_REPO}/zephyr/lib/board/rpi4")
  target_sources(app PRIVATE
    src/main_rpi4.c
    "${V3D_BOARD}/rpi_mbox.c"
    "${V3D_BOARD}/fbcon.c")
  target_include_directories(app PRIVATE
    "${V3D_BOARD}"
    "${PVR_REPO}/src/v3d"
    "${PVR_REPO}/zephyr/lib/board/common"       # gc_font8x16.h only (fbcon)
    "${YAKOGL_DIR}/tools/v3d")                  # tex_linear_case.h (case 109)

  # The GL ES 1.00 shader set, always: the in-process compiler is the V3D's only
  # shader back end and takes GLSL ES 1.00 (and 3.00); the default GLSL 450 set
  # exists for the offline table, which this GPU does not have.
  target_compile_definitions(app PRIVATE GL_TEST_ES100=1)

  target_compile_definitions(app PRIVATE GL_TEST_VTL_PASSES=${CONFIG_V3D_GL_TEST_VTL_PASSES})

  # The bounded-lifetime watchdog, on by default: every board image carries it.
  # OFF is for a QEMU smoke run only (QEMU resets as soon as it is armed).
  option(V3D_RPI_WDOG "the PM watchdog that resets the board ~60 s after boot" ON)
  if(V3D_RPI_WDOG)
    target_sources(app PRIVATE "${V3D_BOARD}/rpi_wdog.c")
    # the image's whole lifetime, the run and the frozen record together
    # (CONFIG_V3D_GL_TEST_HOLD_S, bounded; see Kconfig)
    target_compile_definitions(app PRIVATE RPI_WDOG_HOLD_S=${CONFIG_V3D_GL_TEST_HOLD_S})
  else()
    message(WARNING "gl_test: built WITHOUT the watchdog (V3D_RPI_WDOG=OFF): QEMU only, never the board")
    target_compile_definitions(app PRIVATE V3D_NO_RPI_WDOG)
  endif()
elseif(CONFIG_YAKOGL_GPU_VIVANTE AND CONFIG_YAKOGL_STM32MP2)
  # ---- STM32MP257F-DK, A35: Vivante GCNanoUltra31 (0x8000/0x6205) ----------
  # The board layer (yakogl_board.h) powers the GPU, arms OP-TEE's watchdog,
  # prints the yk-record line and resets into ST's Linux at the end
  # (driver/zephyr/lib/board/stm32mp2); the suite is the same C.
  if(NOT CONFIG_YAKOGL_BOARD_STM32MP2)
    message(FATAL_ERROR "gl_test: CONFIG_YAKOGL_BOARD is off (boards/stm32mp257f_dk_stm32mp257fxx_a35.conf turns it on)")
  endif()
  target_sources(app PRIVATE src/main_stm32mp2.c)
  target_include_directories(app PRIVATE
    "${YAKOGL_DIR}/src/vivante"
    "${PVR_REPO}/src/vivante")
elseif(CONFIG_YAKOGL_GPU_VIVANTE)
  # ---- Verdin iMX8M Plus, Armadillo-X2: Vivante GC7000UL -------------------
  # Only the few lines that start the backend know which GPU this is, and they
  # are behind CONFIG_YAKOGL_GPU_VIVANTE. Running the suite here is the point:
  # a triangle proves a pipe, this proves the backend.
  if(NOT CONFIG_YAKOGL_GC_BOARD)
    message(FATAL_ERROR "gl_test: CONFIG_YAKOGL_GC_BOARD is off (boards/imx8mp.conf turns it on)")
  endif()
  target_sources(app PRIVATE src/main_imx8mp.c)
  target_include_directories(app PRIVATE
    "${YAKOGL_DIR}/src/vivante"
    "${PVR_REPO}/src/vivante")

  # The panel console prints these on its first line, so that a photograph of
  # the panel says which sample and which build it is. The stamp comes from
  # CMake rather than __DATE__ so the compiler is never asked for the time of
  # day.
  string(TIMESTAMP GC_BUILD_STAMP "%Y-%m-%dT%H:%M:%SZ" UTC)
  target_compile_definitions(yakogl_gc_board PRIVATE
    GC_SAMPLE_NAME="${PROJECT_NAME}"
    GC_BUILD_STAMP="${GC_BUILD_STAMP}")
else()
  # ---- Verdin AM62P: PowerVR BXS-4-64 --------------------------------------
  target_sources(app PRIVATE src/main_am62p.c)
  target_include_directories(app PRIVATE "${YAKOGL_DIR}/src/pvr")
  include("${CMAKE_CURRENT_SOURCE_DIR}/../common/sample.cmake")
endif()
```

## Kconfig
```
# SPDX-License-Identifier: Apache-2.0
# SPDX-FileCopyrightText: 2026 Signal Slot, Inc.
mainmenu "gl_test"

# One sample for every board: the Zephyr board (-b) picks the GPU and its
# board side. The options below are grouped by the GPU whose main_*.c reads
# them; the first two are shared.

menu "gl_test, every GPU"

config GL_TEST_RUNNER
	bool
	default y
	select YAKOGL_GL_TEST_RUNNER
	help
	  The suite's walker is the gl_test runner (driver/tools/pvrlab/runner,
	  Rust): which cases run, each one's skip and PASS/FAIL/TIMEOUT line,
	  the tally the board's record reads and the "gl_test: all:" line. The
	  case bodies are the C ones of tools/pvrlab/gl_test.c, whose
	  gl_test_run calls the runner, so the image takes the library with it
	  (CONFIG_YAKOGL_GL_TEST_RUNNER). The console text is unchanged, so
	  tools/board.sh parses it as before.

config GL_TEST_KNOBS
	bool
	default y if YAKOGL_GPU_POWERVR || YAKOGL_GPU_VIVANTE
	select YAKOGL_TEST_KNOBS
	help
	  The suite sets the library's test knobs (CONFIG_YAKOGL_TEST_KNOBS).
	  On the GC7000: case 16's 4x scratch probes, case 132's two narrow-L8
	  arms, case 88's flip study. On the PowerVR: the bring-up options
	  (gl_test_run's pretransform and debug arguments, case 62's clip
	  sweep, the primitive budget of the split cases), and the arms of
	  case 123 (pvr_debug_set_split_zs) and case 132
	  (pvr_debug_set_narrow_la). gl_test.c calls them only under
	  CONFIG_YAKOGL_TEST_KNOBS; a product image has none of them. Not on
	  the Pi 4.

config GL_TEST_VSU_UNITS
	int "Case 149 (vsunits): vertex-stage samplers the shader declares"
	range 1 16
	default 16
	help
	  Case 149 declares and draws with this many vertex samplers
	  (u_s0..u_s<N-1>); cells N..15 are not drawn and must stay blue.
	  Used to find the smallest count that faults the GPU (RESULTS 1t).

config GL_TEST_VSU_FS_UNITS
	int "Case 149 (vsunits): fragment-stage samplers beside the vertex ones"
	range 0 16
	default 0
	help
	  The fragment shader also declares and samples this many samplers
	  (u_f0.., magenta 1x1 textures on units 16..) with a zero weight, so
	  the picture is unchanged. On the GC7000 the vertex slots start after
	  the fragment ones: 16 puts vertex sampler k in slot 16 + k. 0 is the
	  case as it was.

endmenu

menu "gl_test on the Verdin AM62P (PowerVR BXS-4-64)"
	depends on YAKOGL_GPU_POWERVR

config GL_TEST_CASE
	int "gl_test case to run (7 = every case, 0..6 and 8..20 single cases)"
	default 7

config GL_TEST_CASES
	string "Cases to run in order on one context, comma-separated (overrides GL_TEST_CASE)"
	default ""
	help
	  When set, the listed case numbers of driver/tools/pvrlab/gl_test.c
	  are walked through gl_test_set_list on one context, as the
	  i.MX8MP's and the Pi 4's samples do, so one image runs a chosen set
	  (for example "169,162,167,168,123"). Empty: GL_TEST_CASE alone.

config GL_TEST_FWCCB_LOSS_SECONDS
	int "Case 174 (fwccbloss): seconds of frames"
	default 25
	help
	  Case 174 reproduces the lost FWCCB command (the AM62P glmark2
	  cell): frames of full-screen quads into a 1024x1024 target, more
	  each phase, so the firmware keeps asking for grows, for this many
	  seconds. Build it with YAKOGL_DRV_GPU_PVR_FL_GROW_ON_DEMAND (every
	  grow served) and YAKOGL_DRV_GPU_PVR_FWCCB_CHECK, and
	  GL_TEST_CASES="174".

config GL_TEST_FORCEDPR_LAYERS
	int "Case 217 (forcedpr): 512x512 rectangles in the one frame"
	default 1220
	range 1 4093
	help
	  Case 217 draws this many overlapping rectangles of known colour
	  and depth into a 1024x1024 target in one kick, to exceed a free
	  list capped at 512 pages (YAKOGL_DRV_GPU_PVR_FL_PROBE_MAX_PAGES),
	  and reads the whole target back. The case sweeps up from here by
	  a quarter a step (to 4093) until the firmware runs out of parameter
	  memory; the default is the AM62P's crossing (976 layers fit the 512
	  pages, 1220 do not: tools/cts/log/2026-11-02-pr-217probe), so the
	  first step asks. Raise it when the case prints "NOT EXERCISED" at
	  4093 (the frame fitted the list). Not in the default list: without
	  YAKOGL_DRV_GPU_PVR_PARTIAL_RENDER it stops the run by design
	  (driver/tools/pvrlab/README.md, "Case 217").

config GL_TEST_FWCCB_LOSS_MAX_LAYERS
	int "Case 174 (fwccbloss): layers a frame at most"
	default 1024
	help
	  The ramp's cap. 30 on the AM62P (v8): v7's held runs survived 47-53
	  phases at 30 layers, and 33 hangs a frame alone (cause 4); a run
	  whose request count missed v7's hold rose to 33 and hung. With 30
	  every run holds at the same load.

config GL_TEST_FWCCB_LOSS_HOLD_GROWS
	int "Case 174 (fwccbloss): served grows after which the load stops rising"
	default 10
	help
	  10 keeps the list below its maximum (v3). The load also stops
	  rising at the first refused grow: with
	  YAKOGL_DRV_GPU_PVR_FL_PROBE_SERVE_MAX=3, three grows are served, the
	  fourth request is refused, and from then on each overlap asks and
	  is refused: glmark2's sequence before its lost command (v5).

config GL_TEST_PANEL
	int "Draw on the panel instead: 1 = demo scene, 2 = spinning MSAA cube (0 = run the case)"
	default 0
	range 0 2

config GL_TEST_DEBUG
	int "Backend debug: 1 = command-stream dumps, 2 = depth/stencil dumps"
	default 0
	range 0 2
	help
	  PVR_BACKEND_OPT_DEBUG / _DS_DUMP, test knobs: they take effect
	  because this image selects CONFIG_YAKOGL_TEST_KNOBS (GL_TEST_KNOBS).

config GL_TEST_PRETRANSFORM
	bool "Case 0 feeds screen-space vertices (TA viewport transform off)"
	help
	  PVR_BACKEND_OPT_PRETRANSFORM, a test knob (see GL_TEST_DEBUG).

config GL_TEST_PVR_FS_TEMPS_MIN
	int "PowerVR: declare at least this many fragment temporaries (PVR_BACKEND_OPT_FS_TEMPS_MIN, a measurement)"
	depends on YAKOGL_GPU_POWERVR
	range 0 252
	default 0
	help
	  Passed to pvr_backend_set_option(PVR_BACKEND_OPT_FS_TEMPS_MIN) at
	  startup: every fragment kick allocates max(the shader's temps, this)
	  temporaries per instance, the program unchanged. 0 is the shader's
	  own count. For the A/B of case 39 perf between the online compiler
	  and the offline table: never a default. A product option until the
	  shader-compiler rename.

endmenu

menu "gl_test on the STM32MP257F-DK (Vivante GCNanoUltra31)"
	depends on YAKOGL_GPU_VIVANTE && YAKOGL_STM32MP2

config GL_TEST_MP2_CASE
	int "Which gl_test case to run (7 = the regression set)"
	default 7
	help
	  The case numbers are tools/pvrlab/gl_test.c's own; its header
	  comment lists them. 7 runs the regression set (SET_ORDER of the
	  runner, driver/tools/pvrlab/runner). Ignored with
	  GL_TEST_MP2_SET_HEAD.

config GL_TEST_MP2_SET_HEAD
	bool "Run only the first cases of the regression set"
	help
	  Runs the first GL_TEST_MP2_SET_HEAD_CASES cases of the regression
	  set, in its order, instead of GL_TEST_MP2_CASE: with the default
	  of 1, case 1 ("uniform": one fragment-uniform draw read back)
	  alone, the DK's first GL run (gc_gl_triangle in
	  docs/notes/pre-study-stm32mp257f-dk.md). One case ends with that
	  case's record, more with the set's summary. Off by default.

config GL_TEST_MP2_SET_HEAD_CASES
	int "How many cases from the head of the regression set"
	depends on GL_TEST_MP2_SET_HEAD
	range 1 50
	default 1

endmenu

menu "gl_test on the i.MX8M Plus (Vivante GC7000UL)"
	depends on YAKOGL_GPU_VIVANTE && YAKOGL_GC_BOARD

config GC_GL_TEST_CASE
	int "Which gl_test case to run (7 = the regression set)"
	default 7
	help
	  The case numbers are tools/pvrlab/gl_test.c's own; its header
	  comment lists them. 7 runs the regression set, whose order[] is in
	  gl_test_run().

config GC_GL_TEST_SWEEP
	bool "Sweep 48 case numbers in one run, each result in the SNVS record"
	help
	  Runs cases GC_GL_TEST_SWEEP_FIRST .. +47 (7, the regression set,
	  counts as skipped) through gl_test's list walker on one context,
	  and after every case rewrites a SWEEP record (gc_result.h) with two
	  bits per case. Cases named in GC_GL_TEST_SKIP report as skipped.
	  GC_GL_TEST_CASE is ignored.

config GC_GL_TEST_SWEEP_FIRST
	int "First case number of the sweep"
	default 0
	depends on GC_GL_TEST_SWEEP

config GC_GL_TEST_SWEEP_LISTS
	string "Case lists a run-time selector can pick (';'-separated)"
	default ""
	depends on GC_GL_TEST_SWEEP
	help
	  Selector 0x200 + k (gc_result.h) runs the k-th list of this table
	  instead of the sweep's range, in the order written, on one context,
	  and ends with the sweep's counters record. A list is comma-separated
	  case numbers and ranges, all inside the sweep's 48: "10-18,19". For
	  finding the earliest case whose presence makes a later one fail.

config GC_GL_TEST_SETTLE_SECONDS
	int "Seconds from boot before the verdict is given"
	default 0
	help
	  0: the verdict is the result record, and the image resets the SoC
	  right after writing it (gc_sample_finish_recorded), so a one-case
	  run costs its boot and its case.

	  Only for the diagnostic knobs that still answer in the return time
	  (REPORT_COUNTERS, REPORT_CHECK, DEPTH_VALUE, DEPTH_PROBE; README
	  "Reading a run"): set it longer than the suite takes, 100 as in the
	  README's readings, so the suite's own duration is not a second
	  unknown in the total. It logs its duration.

config GC_GL_TEST_DEADLINE_SECONDS
	int "Seconds before the supervisor gives up on the suite"
	default 200
	help
	  The watchdog Linux left armed fires at about 128 s and the suite
	  takes longer than that, so a thread of its own feeds it. Past this
	  deadline that thread stops waiting, writes the case it was in as an
	  UNFINISHED record and resets the SoC, so a hung suite is a reading
	  rather than two silent minutes.

config GC_GL_TEST_REPORT_CHECK
	bool "A single case reports the check inside it that failed first"
	help
	  A case is one bit on a board with no console: PASS or FAIL. That is
	  enough to see a fix land and not enough to find one, because a case
	  makes twenty-odd checks and they fail for different reasons. With
	  this the hold carries the first failing check instead: 1 when the
	  case passed, 1 + the check's number when one failed, 63 when it
	  failed without any check saying so (a GL error, or a check past 61).
	  Off by default, so the plain PASS/FAIL holds keep their meaning.

config GC_GL_TEST_REPORT_CHECK_COLOUR
	bool "...and reports the colour it read rather than its number"
	depends on GC_GL_TEST_REPORT_CHECK
	help
	  Once the failing check is known its number is not news any more, but
	  what it read still is: a mip level that comes back green where blue
	  was wanted says the LOD stopped one level short, while black says
	  nothing was drawn at all. The hold then carries the colour as 32 plus
	  one bit per channel at half scale, so 32 is black, 33 blue, 34 green,
	  36 red and 39 white.

config GC_GL_TEST_REPORT_COUNTERS
	bool "Report what the run waited on, rather than how far it got"
	help
	  Every case of the suite finishes in seconds on its own, and the
	  regression set does not finish inside its deadline, so something
	  accumulates across the cases. There are exactly two waits in the path
	  long enough to account for it: the 2 s a fence wait gives up after,
	  and the 1 s a submit waits for one of the thirty hardware events to
	  come free. This puts both in the hold instead of the case number: bit
	  5 is set when a submit ever found every event in flight, and the low
	  five bits are the number of fence timeouts, saturating at 31. So a
	  hold code of 0 says the time went somewhere else entirely.

config GC_GL_TEST_COUNTER_SELECT
	int "Which number GC_GL_TEST_REPORT_COUNTERS puts in the hold"
	depends on GC_GL_TEST_REPORT_COUNTERS
	default 0
	help
	  0 packs both flags: bit 5 when a submit ever found all thirty events
	  in flight, the low five bits the fence timeouts, saturating at 31.
	  1 reports instead the seconds spent inside the two waits, saturating
	  at 63, which is the question the flags only stand in for --
	  gc_event_alloc loops rather than giving up, so a submit can wait a
	  long time for an event without the starvation flag ever being set.
	  3 reports the case the suite was in when a kick first failed to
	  complete, or 63 when none did. A kick that never completes costs two
	  seconds and leaks its hardware event for good, so thirty of them slow
	  every submit that follows: without this, a hang reads from outside as
	  the suite merely being slow, which is how it read for a while.
	  2 reports the same time in units of eight seconds, so the scale
	  reaches the whole deadline a regression set is given: a set saturates
	  select 1 a sixteenth of the way in, and "63 or more" does not say
	  whether the waits are a sixth of the run or all of it.

config GC_GL_TEST_ZPROBE_MILLI
	int "The depth case 53 clears to, in thousandths"
	default 500
	range 0 1000
	help
	  Case 53 clears depth to this value and does nothing else, so that
	  GC_GL_TEST_DEPTH_VALUE can read back what the hardware stored. 500
	  is the 0.5 that gl_test case 13's first check asks for.

	  Set it to 250 to tell a code of 63 meaning "the clear value was
	  ignored" from a code of 63 meaning "the surface is not uniform": a
	  quarter reads back as 15 or 16, and only the first reading moves.

config GC_GL_TEST_DEPTH_VALUE
	bool "Report the value a depth clear actually stored"
	depends on YAKOGL_VIVANTE_DEPTH_GUARD
	help
	  Reads the word the depth surface mostly holds after the case and
	  holds its top six bits, so a run of case 53 -- which clears depth to
	  0.5 and does nothing else -- says what the hardware stored.

	  The code is the stored D24S8 word shifted right by 26. A value near
	  the top of a code's range rounds either way, so each expected value
	  spans two codes: 0.5 reads back as 31 **or** 32, 0.25 as 15 or 16,
	  1.0 as 63 and 0.0 as 0. Reading 31 as a failure because 32 was
	  written down would be the obvious mistake here.

	  62 means the surface holds no single value: the clear did not cover
	  it, and no stored depth can be reported. (62 is also depth
	  0.969..0.984, which nothing in the suite clears to.)

	  So 31 or 32 means the clear landed; 0 means it landed at the near end
	  of the range instead; 63 means the clear value was ignored and the
	  buffer still holds 1.0. 63 also stands for "the surface is not
	  uniform", which is a different finding; to tell the two apart, build
	  again with GC_GL_TEST_ZPROBE_MILLI=250 and see whether the code
	  becomes 15 or 16.

	  41 is the depth guard's own canary, 0xa5a5a5a5, which means the GPU
	  wrote none of the surface -- a different fault again, and one the
	  guard build makes readable for free.

config GC_GL_TEST_DEPTH_PROBE
	bool "Report whether the depth write stayed inside its surface"
	depends on YAKOGL_VIVANTE_DEPTH_GUARD
	help
	  Reads back the canary the guard build lays down around the depth
	  surface and puts the answer in the hold: 0 when nothing was written
	  at all, 1 when the write stayed inside, 2..62 when it ran outside by
	  (code - 1) * 4 KiB, 63 when there was no depth buffer. Turns "may a
	  depth surface be linear on this part" into a reading.

config GC_GL_TEST_SKIP
	string "Cases the regression set leaves out (decimal, comma separated)"
	default ""
	help
	  A case that hangs a kick costs every later case the two seconds each
	  hung kick waits, so one unfixed case can stop the set finishing at
	  all and hide the state of the thirty after it. Listing it here keeps
	  the rest readable while it is worked on. A skipped case counts as
	  neither a pass nor a failure, so the pass count stays honest.

config GL_TEST_GC_TILED_RT
	bool "Turn the GC7000's tiled render targets on (a measurement, off in products)"
	select YAKOGL_TEST_KNOBS
	default n
	help
	  Calls gc_debug_set_tiled_rt(1) before the cases
	  (docs/notes/gc-tiled-wire.md): tiled shadow targets resolved by the
	  RS in the same stream, and early depth into them. Off, the cases run
	  as before.

config GC_GL_TEST_MSAA
	bool "Turn the GC7000's 4x MSAA on (a measurement, off in products)"
	depends on YAKOGL_TEST_KNOBS
	default n
	help
	  Calls gc_debug_set_msaa(1) at startup: the backend's 4x resolve
	  (vivante/backend.rs gc_debug_msaa, a test knob) and with it the EGL
	  4x config, which the GC7000 build otherwise does not offer. Case 16
	  then runs against a real 4x surface. Off by default until the board
	  has measured it (tools/cts/RESULTS.md, "GC7000 4x MSAA via the
	  resolve engine").

config GC_GL_TEST_MSAA_BITS
	int "gc_debug_msaa value case 16 runs with (1 = the 4x resolve)"
	depends on GC_GL_TEST_MSAA
	range 1 31
	default 1
	help
	  The argument of gc_debug_set_msaa. Bit 0 is the 4x path, bit 1
	  etnaviv's SMALL_MSAA settings (PS input and temporary + 1, PE_LOGIC_OP
	  UNK24 = 5), bit 2 a per-draw PS_MSAA_CONFIG, bit 3 the viewport and
	  clip scaled to the 2x scratch surface, bit 4 etnaviv's PE_LOGIC_OP
	  SINGLE_BUFFER value for the supertiled scratch. 19 = bits 0, 1 and 4
	  is what Mesa writes for a 4x target on this core; bits 2 and 3 are not
	  Mesa's (docs/notes/gc-msaa-addresses.md).

config GC_GL_TEST_UNIIDX_NO_CLAMP
	bool "gl_test 108: no clamp before the movar (a measurement)"
	depends on YAKOGL_SHADERC_ONLINE
	default n
	help
	  shc_debug_set_uniidx bit 0: a run-time-indexed uniform read uses its
	  index unclamped in the offset multiply, as Mesa's etnaviv does
	  (select.rs shc_debug_uniidx). Never a default: the clamp is an ir.md
	  rule.

config GC_GL_TEST_WIDTH
	int "Render target width in pixels"
	default 1280

config GC_GL_TEST_HEIGHT
	int "Render target height in pixels"
	default 800
endmenu

menu "gl_test on the Raspberry Pi 4 (V3D 4.2)"
	depends on YAKOGL_GPU_V3D

config V3D_GL_TEST_CASES
	string "The gl_test cases to run, in order, on one context"
	default "5,58,59,66,67,102,3,9,11,12,13,4,178"
	help
	  Comma-separated case numbers of driver/tools/pvrlab/gl_test.c,
	  walked through gl_test_set_list as the i.MX8MP's lists are. The
	  default is M6 step B's evidence (the clears the TLB cannot do) and
	  step C's (3 depth, 9 stencil, 11 persist, 12 stencil2, 13 zls:
	  depth and stencil kept across jobs), and 4 cull (glCullFace and
	  glFrontFace, which no V3D list ran until the winding was found
	  inverted by 12), and 178 heldfree (a depth texture right after a
	  scene's buffers were deleted; it runs on the V3D now);
	  docs/online-shaderc/v3d-backend.md.
	  Ignored when V3D_GL_TEST_CASE is set.

config V3D_GL_TEST_CASE
	int "Run this one case alone instead of the list (-1: the list)"
	default -1
	help
	  One case, on a fresh context, so its lines are the only ones on the
	  screen. 7 is gl_test's own regression set.

config V3D_GL_TEST_MSAA
	bool "Offer the 4x EGL config (a measurement, off in products)"
	default n
	help
	  Calls v3d_debug_set_msaa(1) at startup: the EGL 4x config, which
	  the V3D build otherwise does not offer (src/v3d/backend.rs
	  v3d_debug_msaa). Case 16 then runs against a real 4x surface, and
	  case 145 (sample coverage) has one to draw on. Off by default until
	  the board has measured it (docs/online-shaderc/v3d-backend.md,
	  "Multisampling").

config V3D_GL_TEST_VTL_PASSES
	int "Case 129 (vstexlod): run only its first N passes (0: all)"
	default 0
	range 0 11
	help
	  The case's passes go lightest first; a faulting pass prints the
	  OSAL's fault dump (records, uniform streams, vertex arrays, code),
	  and on the screen record every pass after it scrolls the dump away
	  (the UART keeps all of it). 1 runs the constant look-up alone, 2
	  adds the one-level control.

config V3D_GL_TEST_RECORD
	bool "One frozen record at the end of the run"
	default y
	help
	  The console scrolls and the board's watchdog ends the image, so the
	  first failure of a run can scroll off. With this, every printk line
	  is also kept in a ring, and at the end of the run (or at
	  V3D_GL_TEST_RECORD_AT_S after boot if the run has not ended) the
	  screen is cleared and one record is printed and frozen: the last
	  lines of the run, the OSAL's job record (the registers after the
	  first completed and the first failed job, the timeouts, UIFCFG), and
	  the verdicts.

config V3D_GL_TEST_RECORD_AT_S
	int "The record's deadline, seconds after boot"
	default 75
	depends on V3D_GL_TEST_RECORD

config V3D_GL_TEST_RECORD_LINES
	int "Lines of the run the record replays"
	default 22
	range 0 30
	depends on V3D_GL_TEST_RECORD
	help
	  The 1280x720 console has 44 rows; the job record takes about 10 and
	  the verdicts one per case, so a long case list wants fewer.

config V3D_GL_TEST_HOLD_S
	int "The watchdog's hold, seconds after boot"
	default 200
	range 30 300
	help
	  rpi_wdog resets the board this long after boot (bounded, as every
	  board image is): the run plus the time the record stays readable.
endmenu

rsource "../common/Kconfig"
source "Kconfig.zephyr"
```

## prj.conf
```kconfig
# SPDX-License-Identifier: Apache-2.0
# SPDX-FileCopyrightText: 2026 Signal Slot, Inc.
# gl_test, the same configuration on every board; what a board needs beyond it
# (its GPU driver, console, watchdog, memory) is in boards/, selected by the
# Zephyr board (-b), and in boards/imx8mp.conf and armadillo_x2.conf, which
# CMakeLists.txt adds for the i.MX8M Plus boards.
CONFIG_YAKOGL=y
# The in-process shader compiler, as in every other sample: gl_test.c then
# takes the GLSL ES 1.00 shader set (gl_test_shaders_es100.h).
CONFIG_YAKOGL_SHADERC_ONLINE=y

CONFIG_LOG=y
CONFIG_FPU=y
CONFIG_CACHE_MANAGEMENT=y

# glShaderSource keeps a copy of every source (malloc); the cases compile many
# shaders. The GL core keeps its per-draw scratch static, but gl_test's own
# frames are large.
CONFIG_COMMON_LIBC_MALLOC=y
CONFIG_COMMON_LIBC_MALLOC_ARENA_SIZE=524288
# 256 KiB: the in-process shader compiler runs on this thread when the image
# is built with it (docs/online-shaderc/frontend.md, "Stack"); 64 KiB
# overflowed into the idle thread on the AM62P.
CONFIG_MAIN_STACK_SIZE=262144

# Needs the ES 3.0 report (YakoGL reports ES 2.0 by default): the "#version 300 es" gl_test cases run only on an ES 3.0 context.
CONFIG_YAKOGL_REPORT_ES2=n
```

## prj_sweep.conf
```kconfig
# SPDX-License-Identifier: Apache-2.0
# SPDX-FileCopyrightText: 2026 Signal Slot, Inc.
# The full-list sweep: 48 case numbers per run from GC_GL_TEST_SWEEP_FIRST,
# each result in the SNVS SWEEP record (gc_result.h) as it finishes, with the
# in-process online compiler and the ES 1.00 shader set (build with
# -DGL_TEST_ES100=ON) and the 256 KiB main stack the online compiler needs.
#
#   west build ... gc_gl_test -- -DEXTRA_CONF_FILE=prj_sweep.conf -DGL_TEST_ES100=ON \
#       -DCONFIG_GC_GL_TEST_SWEEP_FIRST=48
CONFIG_GC_GL_TEST_SWEEP=y
CONFIG_YAKOGL_SHADERC_ONLINE=y
CONFIG_MAIN_STACK_SIZE=262144
CONFIG_STACK_SENTINEL=y

# 48 cases on one context take far longer than one; the supervisor's deadline
# is the run's bound (the watchdog stays fed by the supervisor until the
# deadline, then the board comes back).
CONFIG_GC_GL_TEST_DEADLINE_SECONDS=900

# Minutes-long by design, not hung: stress (25), heavy (26) and perf (39) are
# for their own runs.
CONFIG_GC_GL_TEST_SKIP="25,26,39"
```

## boards/armadillo_x2.conf
```kconfig
# SPDX-License-Identifier: Apache-2.0
# SPDX-FileCopyrightText: 2026 Signal Slot, Inc.
# The Armadillo-X2 has its console on UART2, wired to the host: print there,
# not into the picture. The panel console would take printk over. Added by
# CMakeLists.txt after imx8mp.conf.
CONFIG_UART_CONSOLE=y
CONFIG_GC_COMMON_PANEL_CONSOLE=n
# This board is run by tools/board.sh x2 only, which refuses an image that
# does not print "gc_wdog_arm: armed", so every X2 gl_test arms WDOG1 itself
# (a -DCONFIG_GC_BOARD_WDOG_SELF_ARM=n on the command line still wins). The
# YAKOGL_DRV_DISPLAY_RUST it selects only links the yakogl-drivers crate
# (ip::imx_wdog): the display stays the LCDIF3 adopt driver, and the image
# builds as it is (2026-11-06, 1673798c).
CONFIG_GC_BOARD_WDOG_SELF_ARM=y
```

## boards/armadillo_x2_direct.conf
```kconfig
# SPDX-License-Identifier: Apache-2.0
# SPDX-FileCopyrightText: 2026 Signal Slot, Inc.
# Armadillo-X2 started by TF-A at power-on (docs/notes/x2-direct-boot.md): there
# is no display node (nothing powered MEDIAMIX or LCDIF3), so the display driver
# is off; saying so here keeps imx8mp.conf's "y" from becoming a Kconfig warning.
# Added by CMakeLists.txt after armadillo_x2.conf (the console is UART2).
CONFIG_YAKOGL_DRV_DISPLAY_IMX8MP=n
```

## boards/imx8mp.conf
```kconfig
# SPDX-License-Identifier: Apache-2.0
# SPDX-FileCopyrightText: 2026 Signal Slot, Inc.
# The i.MX8M Plus boards (verdin_imx8mp, armadillo_x2): added by CMakeLists.txt.
# The Vivante GC7000UL driver and YakoGL's Vivante backend, and the board
# support of yakogl_gc_board: the GIC EOI fix, the interrupt guard, the
# watchdog, the SNVS result record, the panel console.
CONFIG_YAKOGL_DRV_GPU_VIVANTE=y
CONFIG_YAKOGL_GPU_VIVANTE=y
CONFIG_YAKOGL_GC_BOARD=y

# The console is the DSI panel (the board layer); LOG_* through printk. The
# suite prints one line per case, which is more than a panel holds, so the
# verdict travels in the hold time instead (see src/main_imx8mp.c).
CONFIG_GC_COMMON_PANEL_CONSOLE=y
CONFIG_LOG_MODE_MINIMAL=y
CONFIG_UART_CONSOLE=n
CONFIG_GC_COMMON_PANEL_CONSOLE_SCALE=2

CONFIG_FPU_SHARING=n

# The way back to Linux: reset the SoC through PSCI when done.
CONFIG_REBOOT=y
CONFIG_PM_CPU_OPS=y
CONFIG_PM_CPU_OPS_PSCI=y

CONFIG_GPIO=y
CONFIG_I2C=y
CONFIG_PINCTRL=y
CONFIG_YAKOGL_DRV_DISPLAY_IMX8MP=y
```

## boards/rpi_4b.conf
```kconfig
# SPDX-License-Identifier: Apache-2.0
# SPDX-FileCopyrightText: 2026 Signal Slot, Inc.
# YakoGL on the Raspberry Pi 4's V3D, with the in-process compiler (the V3D's
# only shader back end).
CONFIG_YAKOGL_GPU_V3D=y
# 48 MiB of GPU memory (a static of the image; see the board overlay).
CONFIG_YAKOGL_V3D_CARVEOUT_BYTES=50331648

# The console is the HDMI framebuffer (driver/zephyr/lib/board/rpi4/fbcon.c):
# printk and LOG_* are drawn there. The mini UART stays on as well.
CONFIG_PRINTK=y
CONFIG_LOG_MODE_MINIMAL=y

# The Rust archive is hard-float, and the GL calls and the compiler use the
# FPU; one thread calls GL, but the logging and timer threads exist too.
CONFIG_FPU_SHARING=y

# glShaderSource keeps a copy of the source, and the GL core's staging.
CONFIG_COMMON_LIBC_MALLOC_ARENA_SIZE=1048576

# Address space: the image (96 MiB of RAM, the overlay), the carve-out's
# non-cacheable alias (48 MiB), the 3.6 MiB framebuffer and the device blocks.
CONFIG_MAX_XLAT_TABLES=64
CONFIG_KERNEL_VM_SIZE=0x10000000
```

## boards/stm32mp257f_dk_stm32mp257fxx_a35.conf
```kconfig
# SPDX-License-Identifier: Apache-2.0
# SPDX-FileCopyrightText: 2026 Signal Slot, Inc.
# The STM32MP257F-DK's A35 (Vivante GCNanoUltra31, 0x8000/0x6205). The board
# layer's app.conf (the Vivante driver, OP-TEE's watchdog, no hold) is added
# by CMakeLists.txt; this is what gl_test needs beyond it.
#
# The board layer (yakogl_board.h): the yk-record line on USART2 and the
# end of the run, PSCI SYSTEM_RESET back into ST's Linux (src/main_stm32mp2.c).
CONFIG_YAKOGL_BOARD=y
CONFIG_PRINTK=y
CONFIG_LOG_MODE_MINIMAL=y
# The layer resets the board this long after boot whatever the suite does;
# tools/board-stm32mp2.sh waits RUN_BOUND (120 s) for the image's end. One
# case with its shader compiles takes seconds; a longer list needs both
# raised (README.md).
CONFIG_YAKOGL_STM32MP2_LIFETIME_S=100
```

## boards/rpi_4b.overlay
```dts
/* SPDX-License-Identifier: Apache-2.0 */
/* SPDX-FileCopyrightText: 2026 Signal Slot, Inc. */
/*
 * The board's sram0 is 512 KiB at 0x200000 (dts/arm64/broadcom/bcm2711.dtsi).
 * This image carries the V3D's 48 MiB carve-out and the compiler's 2 MiB
 * scratch as statics, so it gets 96 MiB from 0x200000. DRAM starts at 0 on the
 * Pi 4 and the firmware keeps its own memory at the top of the first GiB, so
 * this is ARM memory on every Pi 4 (v3d_clear and v3d_triangle ran with the
 * first 32 MiB of it).
 */
#include "../../common/rpi_4b_sram.dtsi"

&sram0 {
	reg = <0x200000 0x6000000>;
};
```

## boards/stm32mp257f_dk_stm32mp257fxx_a35.overlay
```dts
/* SPDX-License-Identifier: Apache-2.0 */
/* SPDX-FileCopyrightText: 2026 Signal Slot, Inc. */
/* The STM32MP257F-DK's A35: the board layer's GPU node and carve-out, as
 * gc_fence and gc_clear take them (examples/zephyr.cmake). */
#include "../../../../zephyr/lib/board/stm32mp2/app.overlay"
```

## boards/verdin_imx8mp_mimx8ml8_a53.overlay
```dts
/* SPDX-License-Identifier: Apache-2.0 */
/* SPDX-FileCopyrightText: 2026 Signal Slot, Inc. */
/* The display chain of the Verdin iMX8M Plus on a Mallow carrier. */
#include "../../common/verdin_imx8mp_display.dtsi"
```

## src/main.c
```c
/* SPDX-License-Identifier: Apache-2.0 */
/* SPDX-FileCopyrightText: 2026 Signal Slot, Inc. */
/*
 * gl_test on Zephyr: runs tools/pvrlab/gl_test.c (the on-silicon YakoGL
 * test suite of the Linux harness) on the real GPU, then holds the picture
 * and resets like the other samples. Results go to the console as
 * "gl_test: case N <name>: PASS/FAIL" and "gl_test: all: N of 20 cases failed".
 */
#include <stdlib.h>
#include <zephyr/kernel.h>
#include <zephyr/sys/printk.h>
#include "sample_glue.h"
#include "osal_internal.h" /* osal_zephyr_diag_print */

int gl_test_run(int gl_case, int pretransform, unsigned int ppp_ctrl, int debug, int no_coalesce,
		unsigned int term0, int panel);
int gl_test_set_list(const int *cases, unsigned n, unsigned *stored);

/* CONFIG_GL_TEST_CASES, "169,162,...": the case numbers, or -1 when it is
 * not such a list (as v3d_gl_test's parse_list). */
static int parse_list(const char *s, int *out, unsigned max)
{
	unsigned n = 0;

	while (*s) {
		char *end;
		long v = strtol(s, &end, 10);

		if (end == s || v < 0 || n == max)
			return -1;
		out[n++] = (int)v;
		s = end;
		if (*s == ',')
			s++;
		else if (*s)
			return -1;
	}
	return (int)n;
}

/* The panel modes draw into the same scan-out buffer the Linux harness uses
 * (tidss fb0, XRGB8888 1024x600, pitch 4096); on this board that memory is
 * outside Zephyr's own and the DSS application plane is pointed at it. */
#define PANEL_PHYS 0xE2900000UL
#define PANEL_W 1024
#define PANEL_H 600

#ifdef CONFIG_YAKOGL_GPU_POWERVR
#include "pvr_backend.h"   /* pvr_backend_set_option, PVR_BACKEND_OPT_DBIAS_INT */
void pvr_debug_set_masked_clear(int on);
#endif

int main(void)
{
#ifdef CONFIG_YAKOGL_GPU_POWERVR
	/* on by default (board-verified); n is the off arm of an A/B */
	pvr_debug_set_masked_clear(IS_ENABLED(CONFIG_GL_TEST_PVR_MASKED_CLEAR));
	printk("gl_test: pvr_debug_masked_clear=%d (clears honour glColorMask)\n",
	       IS_ENABLED(CONFIG_GL_TEST_PVR_MASKED_CLEAR));
	/* the A/B switch: -1 leaves the backend's default, and says so */
	if (CONFIG_GL_TEST_PVR_DBIAS_INT >= 0)
		pvr_backend_set_option(PVR_BACKEND_OPT_DBIAS_INT, (uint32_t)CONFIG_GL_TEST_PVR_DBIAS_INT);
	printk("gl_test: PVR_BACKEND_OPT_DBIAS_INT=%d (%s)\n", CONFIG_GL_TEST_PVR_DBIAS_INT,
	       CONFIG_GL_TEST_PVR_DBIAS_INT >= 0 ? "set" : "-1: untouched");
	pvr_backend_set_option(PVR_BACKEND_OPT_FS_TEMPS_MIN, (uint32_t)CONFIG_GL_TEST_PVR_FS_TEMPS_MIN);
	printk("gl_test: PVR_BACKEND_OPT_FS_TEMPS_MIN=%d\n", CONFIG_GL_TEST_PVR_FS_TEMPS_MIN);
	/* on by default; CONFIG_GL_TEST_PVR_KEEP_ZS is the opt-out */
	pvr_backend_set_option(PVR_BACKEND_OPT_SWAP_DROPS_ZS, !IS_ENABLED(CONFIG_GL_TEST_PVR_KEEP_ZS));
	printk("gl_test: PVR_BACKEND_OPT_SWAP_DROPS_ZS=%d\n", !IS_ENABLED(CONFIG_GL_TEST_PVR_KEEP_ZS));
#endif
	int rc;

	if (CONFIG_GL_TEST_PANEL) {
		rc = pvr_sample_show_on_dss(PANEL_PHYS, PANEL_W, PANEL_H, PANEL_W * 4);
		if (rc) {
			return pvr_sample_finish(rc);
		}
	}
	int gl_case = CONFIG_GL_TEST_CASE;

	if (CONFIG_GL_TEST_CASES[0] != '\0') {
		static int list[64];
		int n = parse_list(CONFIG_GL_TEST_CASES, list, 64);
		unsigned stored = 0;

		if (n <= 0) {
			printk("gl_test: FAIL (CONFIG_GL_TEST_CASES \"%s\" is not a list of cases)\n",
			       CONFIG_GL_TEST_CASES);
			return pvr_sample_finish(-1);
		}
		gl_case = gl_test_set_list(list, (unsigned)n, &stored);
		printk("gl_test: the list %s (%u cases) on one context\n", CONFIG_GL_TEST_CASES, stored);
	}
	rc = gl_test_run(gl_case, IS_ENABLED(CONFIG_GL_TEST_PRETRANSFORM), 0,
			 CONFIG_GL_TEST_DEBUG, 0, 0, CONFIG_GL_TEST_PANEL);
	/* the OSAL's close record: the pending-free queue's counters */
	osal_zephyr_diag_print();
	printk("gl_test: %s (rc=%d)\n", rc ? "FAILED" : "OK", rc);
	return pvr_sample_finish(rc);
}
```

## src/main_am62p.c
```c
/* SPDX-License-Identifier: Apache-2.0 */
/* SPDX-FileCopyrightText: 2026 Signal Slot, Inc. */
/*
 * gl_test on Zephyr: runs tools/pvrlab/gl_test.c (the on-silicon YakoGL
 * test suite of the Linux harness) on the real GPU, then holds the picture
 * and resets like the other samples. Results go to the console as
 * "gl_test: case N <name>: PASS/FAIL" and "gl_test: all: N of 20 cases failed".
 */
#include <stdlib.h>
#include <zephyr/kernel.h>
#include <zephyr/sys/printk.h>
#include "sample_glue.h"
#include "osal_internal.h" /* osal_zephyr_diag_print */

int gl_test_run(int gl_case, int pretransform, unsigned int ppp_ctrl, int debug, int no_coalesce, int panel);
int gl_test_set_list(const int *cases, unsigned n, unsigned *stored);

/* CONFIG_GL_TEST_CASES, "169,162,...": the case numbers, or -1 when it is
 * not such a list (as v3d_gl_test's parse_list). */
static int parse_list(const char *s, int *out, unsigned max)
{
	unsigned n = 0;

	while (*s) {
		char *end;
		long v = strtol(s, &end, 10);

		if (end == s || v < 0 || n == max)
			return -1;
		out[n++] = (int)v;
		s = end;
		if (*s == ',')
			s++;
		else if (*s)
			return -1;
	}
	return (int)n;
}

/* The panel modes draw into the same scan-out buffer the Linux harness uses
 * (tidss fb0, XRGB8888 1024x600, pitch 4096); on this board that memory is
 * outside Zephyr's own and the DSS application plane is pointed at it. */
#define PANEL_PHYS 0xE2900000UL
#define PANEL_W 1024
#define PANEL_H 600

#ifdef CONFIG_YAKOGL_GPU_POWERVR
#include "pvr_backend.h"   /* pvr_backend_set_option, PVR_BACKEND_OPT_FS_TEMPS_MIN */
#endif

int main(void)
{
#ifdef CONFIG_YAKOGL_GPU_POWERVR
	pvr_backend_set_option(PVR_BACKEND_OPT_FS_TEMPS_MIN, (uint32_t)CONFIG_GL_TEST_PVR_FS_TEMPS_MIN);
	printk("gl_test: PVR_BACKEND_OPT_FS_TEMPS_MIN=%d\n", CONFIG_GL_TEST_PVR_FS_TEMPS_MIN);
#endif
	int rc;

	if (CONFIG_GL_TEST_PANEL) {
		rc = pvr_sample_show_on_dss(PANEL_PHYS, PANEL_W, PANEL_H, PANEL_W * 4);
		if (rc) {
			return pvr_sample_finish(rc);
		}
	}
	int gl_case = CONFIG_GL_TEST_CASE;

	if (CONFIG_GL_TEST_CASES[0] != '\0') {
		static int list[64];
		int n = parse_list(CONFIG_GL_TEST_CASES, list, 64);
		unsigned stored = 0;

		if (n <= 0) {
			printk("gl_test: FAIL (CONFIG_GL_TEST_CASES \"%s\" is not a list of cases)\n",
			       CONFIG_GL_TEST_CASES);
			return pvr_sample_finish(-1);
		}
		gl_case = gl_test_set_list(list, (unsigned)n, &stored);
		printk("gl_test: the list %s (%u cases) on one context\n", CONFIG_GL_TEST_CASES, stored);
	}
	rc = gl_test_run(gl_case, IS_ENABLED(CONFIG_GL_TEST_PRETRANSFORM), 0, CONFIG_GL_TEST_DEBUG, 0,
			 CONFIG_GL_TEST_PANEL);
	/* the OSAL's close record: the pending-free queue's counters */
	osal_zephyr_diag_print();
	printk("gl_test: %s (rc=%d)\n", rc ? "FAILED" : "OK", rc);
	return pvr_sample_finish(rc);
}
```

## src/main_stm32mp2.c
```c
/* SPDX-License-Identifier: Apache-2.0 */
/* SPDX-FileCopyrightText: 2026 Signal Slot, Inc. */
/*
 * gl_test on the STM32MP257F-DK's A35: tools/pvrlab/gl_test.c on the DK's
 * Vivante GCNanoUltra31 (model 0x8000, revision 0x6205; #1281), through the
 * board layer (yakogl_board.h) as gc_fence and gc_clear are, not the
 * i.MX8MP's yakogl_gc_board.
 *
 * Before main() the board layer has powered the GPU for the driver
 * (stm32mp2/gc_power_mp2.c: SCMI over OP-TEE, the RCC; it refuses any part
 * but 0x8000/0x6205 with a PSCI reset) and armed OP-TEE's watchdog, which it
 * feeds until CONFIG_YAKOGL_STM32MP2_LIFETIME_S; there the layer resets the
 * board whatever the suite is doing. board_finish() ends the run with the
 * record and PSCI SYSTEM_RESET back into ST's Linux.
 *
 * What runs: CONFIG_GL_TEST_MP2_CASE (7, the regression set, by default),
 * or with CONFIG_GL_TEST_MP2_SET_HEAD only the first
 * CONFIG_GL_TEST_MP2_SET_HEAD_CASES cases of the regression set, in its
 * order (1: case 1, "uniform", alone), so a first board run is one small
 * case rather than fifty.
 *
 * The console has every case's "gl_test: case N <name>: PASS/FAIL" line and
 * "gl_test: all:"; the record (yk-record on USART2) is kind CASE, as the
 * i.MX8MP's SNVS record: one case w1 = case << 16 | first bad check << 8 |
 * status (CASE_PASS, CASE_CHECK, CASE_NO_CHECK; check 255 none), w2/w3 the
 * checks made and 0 on a pass, else what the bad check read and wanted; a
 * set or a head of more than one case the set summary (CASE_SET); no GPU
 * CASE_NO_DEVICE with w2 = 0 (the device) or 1 (gc_render_init).
 */
#include <zephyr/kernel.h>
#include <zephyr/device.h>
#include <zephyr/devicetree.h>
#include <zephyr/sys/printk.h>
#include <zephyr/sys/util.h>
#include <errno.h>

#include <yakogl_board.h>
#include <yakogl_record.h>

#include <gc.h>
#include <gc_render.h>

#include "osal_internal.h" /* osal_zephyr_diag_print */
#include "stm32mp2.h"      /* mp2_lifetime_ms */

#define NAME "gl_test"

int gl_test_run(int gl_case, int pretransform, unsigned int ppp_ctrl, int debug, int no_coalesce, int panel);
int gl_test_set_list(const int *cases, unsigned n, unsigned *stored);
unsigned gl_test_set_cases(const int **cases);

extern unsigned int gl_test_passed, gl_test_total, gl_test_skipped;
extern int gl_test_first_fail, gl_test_second_fail, gl_test_first_skip;
extern volatile int gl_test_check_no, gl_test_first_bad_check;
extern volatile uint32_t gl_test_first_bad_got, gl_test_first_bad_want;

/* kind CASE's w1 (driver/rust/src/board/record.rs, case_w1) */
static uint32_t case_w1(int gl_case, int bad_check, uint32_t status)
{
	uint32_t check = bad_check < 0 || bad_check > 254 ? 255u : (uint32_t)bad_check;

	return ((uint32_t)gl_case & 0xffffu) << 16 | check << 8 | (status & 0xffu);
}

/* a case number in a set summary's field, CASE_SET_NONE when there is none */
static uint32_t set_case(int c)
{
	return c < 0 ? YK_RECORD_CASE_SET_NONE : MIN((uint32_t)c, YK_RECORD_CASE_SET_NONE - 1u);
}

static void report(int gl_case, bool one, int rc)
{
	if (!one) {
		/* record.rs SetSummary::words: run = total minus skipped */
		uint32_t run = gl_test_total - MIN(gl_test_skipped, gl_test_total);

		board_result(YK_RECORD_KIND_CASE,
			     set_case(gl_test_first_fail) << 16 | MIN(gl_test_skipped, 0xffu) << 8 |
				     YK_RECORD_CASE_SET,
			     set_case(gl_test_second_fail) << 16 | MIN(gl_test_passed, 0xffffu),
			     set_case(gl_test_first_skip) << 16 | MIN(run, 0xffffu));
	} else if (rc == 0) {
		board_result(YK_RECORD_KIND_CASE, case_w1(gl_case, -1, YK_RECORD_CASE_PASS),
			     (uint32_t)gl_test_check_no, 0);
	} else if (gl_test_first_bad_check < 0) {
		board_result(YK_RECORD_KIND_CASE, case_w1(gl_case, -1, YK_RECORD_CASE_NO_CHECK),
			     (uint32_t)gl_test_check_no, 0);
	} else {
		board_result(YK_RECORD_KIND_CASE,
			     case_w1(gl_case, gl_test_first_bad_check, YK_RECORD_CASE_CHECK),
			     gl_test_first_bad_got, gl_test_first_bad_want);
	}
}

static int run(void)
{
	const struct device *gpu = DEVICE_DT_GET_ONE(vivante_gc);
	int gl_case = CONFIG_GL_TEST_MP2_CASE;
	bool one = gl_case != 7;
	int rc;

#ifdef CONFIG_GL_TEST_MP2_SET_HEAD
	{
		const int *set = NULL;
		unsigned n = MIN(gl_test_set_cases(&set), (unsigned)CONFIG_GL_TEST_MP2_SET_HEAD_CASES);

		if (n == 1u) {
			/* one case alone, without the walk's list */
			gl_case = set[0];
			one = true;
		} else {
			unsigned stored = 0;

			gl_case = gl_test_set_list(set, n, &stored);
			n = stored;
			one = false;
		}
		printk(NAME ": the first %u case(s) of the regression set, from case %d\n", n, set[0]);
	}
#endif
	printk(NAME ": case %d on the STM32MP257F-DK's GPU (lifetime %u ms)\n", gl_case,
	       mp2_lifetime_ms());

	board_progress(YK_RECORD_WHERE_STAGE | YK_RECORD_STAGE_MAIN);
	if (!device_is_ready(gpu) || !gc_alive(gpu)) {
		printk(NAME ": FAIL: the GPU device did not initialise\n");
		board_result(YK_RECORD_KIND_CASE, case_w1(gl_case, -1, YK_RECORD_CASE_NO_DEVICE), 0, 0);
		return -ENODEV;
	}
	/* gl_test_run() brings the OSAL and the backend up itself; the render
	 * service has to exist first because the OSAL forwards to it. */
	rc = gc_render_init(gpu);
	if (rc) {
		printk(NAME ": FAIL: gc_render_init: %d\n", rc);
		board_result(YK_RECORD_KIND_CASE, case_w1(gl_case, -1, YK_RECORD_CASE_NO_DEVICE), 1, 0);
		return rc;
	}
	board_progress(YK_RECORD_WHERE_STAGE | YK_RECORD_STAGE_RENDER_INIT_DONE);

	{
		int64_t t0 = k_uptime_get();

		rc = gl_test_run(gl_case, 0, 0, 0, 0, 0);
		printk(NAME ": the suite took %lld ms\n", (long long)(k_uptime_get() - t0));
	}
	/* the OSAL's close record: the pending-free queue's counters */
	osal_zephyr_diag_print();
	report(gl_case, one, rc);
	if (rc != 0 && gc_render_ready()) {
		gc_render_stall_dump(NAME " failed");
	}
	return rc;
}

int main(void)
{
	board_finish(NAME, run());
}
```
