## CMakeLists.txt
```
# SPDX-License-Identifier: Apache-2.0
# SPDX-FileCopyrightText: 2026 Signal Slot, Inc.
cmake_minimum_required(VERSION 3.20.0)

# The driver (driver/) and YakoGL (the repository root) are Zephyr modules;
# point ZEPHYR_EXTRA_MODULES at both unless a west manifest lists them.
get_filename_component(PVR_REPO "${CMAKE_CURRENT_SOURCE_DIR}/../../.." ABSOLUTE)
list(APPEND ZEPHYR_EXTRA_MODULES "${PVR_REPO}" "${PVR_REPO}/..")

find_package(Zephyr REQUIRED HINTS $ENV{ZEPHYR_BASE})
project(gl_femtovg)

# A board whose board file turns the board layer on (yakogl_board.h; the
# Verdin iMX8M Plus) runs main_board.c. The AM62P keeps main.c and the
# pvr_sample_* glue.
if(CONFIG_YAKOGL_BOARD)
  target_sources(app PRIVATE src/main_board.c)
else()
  target_sources(app PRIVATE src/main.c)
endif()
include("${CMAKE_CURRENT_SOURCE_DIR}/../common/sample.cmake")

# ---------------------------------------------------------------------------
# Rust FemtoVG staticlib (fvg_zephyr) - wraps Agent A's no_std fvg_demo crate,
# provides the global allocator + panic handler, re-exports fvg_draw_frame().
# Built for aarch64-unknown-none (release) with -Z build-std=core,alloc; the
# resulting archive is linked into the Zephyr image with the SDK linker.
# ---------------------------------------------------------------------------
find_program(CARGO cargo REQUIRED)

# The no_std FemtoVG workspace (fvg_demo + patched femtovg/glow forks) lives
# outside the repo (not vendored here); point at it with -DFVG_NOSTD_DIR=... or
# $FVG_NOSTD_DIR.
if(NOT FVG_NOSTD_DIR AND DEFINED ENV{FVG_NOSTD_DIR})
  set(FVG_NOSTD_DIR "$ENV{FVG_NOSTD_DIR}")
endif()
if(NOT FVG_NOSTD_DIR)
  message(FATAL_ERROR
    "gl_femtovg: FVG_NOSTD_DIR is not set. Point it at the no_std FemtoVG "
    "workspace (fvg_demo + patched femtovg/glow): "
    "-DFVG_NOSTD_DIR=<path> or export FVG_NOSTD_DIR=<path>.")
endif()
if(NOT EXISTS "${FVG_NOSTD_DIR}/fvg_demo/Cargo.toml")
  message(FATAL_ERROR
    "gl_femtovg: FVG_NOSTD_DIR='${FVG_NOSTD_DIR}' has no fvg_demo/Cargo.toml. "
    "Set -DFVG_NOSTD_DIR=<path to the no_std FemtoVG workspace>.")
endif()

set(CARGO_SRC "${CMAKE_CURRENT_SOURCE_DIR}/rust")
set(cargo_build_dir "${CMAKE_CURRENT_BINARY_DIR}/rust")
set(cargo_target_dir "${cargo_build_dir}/target")
set(RUST_TARGET aarch64-unknown-none)
set(fvg_staticlib "${cargo_target_dir}/${RUST_TARGET}/release/libfvg_zephyr.a")
file(MAKE_DIRECTORY "${cargo_build_dir}")

# Generate the manifest with the (absolute) source and dependency paths baked in.
configure_file("${CARGO_SRC}/Cargo.toml.in" "${cargo_build_dir}/Cargo.toml" @ONLY)

# The wrapper's own sources AND the no_std crates it pulls in (fvg_demo, and the
# patched femtovg/glow under FVG_NOSTD_DIR): editing any of them must re-run cargo.
file(GLOB_RECURSE fvg_rust_srcs CONFIGURE_DEPENDS
     "${CARGO_SRC}/src/*.rs"
     "${FVG_NOSTD_DIR}/fvg_demo/src/*.rs")

add_custom_command(
  OUTPUT "${fvg_staticlib}"
  COMMAND ${CMAKE_COMMAND} -E env
          "CARGO_TARGET_DIR=${cargo_target_dir}"
          "CARGO_NET_OFFLINE=false"
          ${CARGO} build --release
          -Z build-std=core,alloc
          --target ${RUST_TARGET}
          --manifest-path "${cargo_build_dir}/Cargo.toml"
  DEPENDS ${fvg_rust_srcs} "${cargo_build_dir}/Cargo.toml"
  WORKING_DIRECTORY "${cargo_build_dir}"
  COMMENT "cargo build fvg_zephyr (${RUST_TARGET}, release)"
  VERBATIM)

add_custom_target(fvg_zephyr_build DEPENDS "${fvg_staticlib}")
add_dependencies(app fvg_zephyr_build)

# Link the whole archive: fvg_draw_frame is referenced by main.c, which pulls in
# fvg_demo/femtovg/glow and the allocator/panic objects transitively.
target_link_libraries(app PRIVATE "${fvg_staticlib}")
```

## Kconfig
```
# SPDX-License-Identifier: Apache-2.0
# SPDX-FileCopyrightText: 2026 Signal Slot, Inc.
# Where gl_femtovg draws and what it does afterwards (mirrors gl_triangle).

menu "gl_femtovg"

config GL_FEMTOVG_WINDOW_PHYS
	hex "Physical address of the window buffer (0 = a buffer in the image)"
	default 0
	help
	  Set this to a panel's scan-out buffer to draw on the display, e.g.
	  the framebuffer the previous OS left behind. 0 renders into an
	  XRGB8888/RGBA8888 buffer owned by the program. src/main.c only:
	  on the board layer (src/main_board.c) board_window() places the
	  window and this must stay 0.

config GL_FEMTOVG_WINDOW_WIDTH
	int "Window width in pixels"
	default 256

config GL_FEMTOVG_WINDOW_HEIGHT
	int "Window height in pixels"
	default 256

config GL_FEMTOVG_WINDOW_STRIDE
	int "Window row pitch in bytes (0 = width * 4)"
	default 0

endmenu

rsource "../common/Kconfig"
source "Kconfig.zephyr"
```

## prj.conf
```kconfig
# SPDX-License-Identifier: Apache-2.0
# SPDX-FileCopyrightText: 2026 Signal Slot, Inc.
CONFIG_SAFEUI_GPU_PVR=y
CONFIG_YAKOGL=y

CONFIG_LOG=y
CONFIG_LOG_MODE_IMMEDIATE=y
CONFIG_FPU=y
CONFIG_CACHE_MANAGEMENT=y

# The Rust FemtoVG staticlib allocates through Zephyr's libc heap
# (aligned_alloc/free). FemtoVG's canvas, path and gradient buffers need a few
# MB; give the common-libc malloc arena 16 MB. glShaderSource also copies the
# shader source through this heap.
CONFIG_COMMON_LIBC_MALLOC=y
CONFIG_COMMON_LIBC_MALLOC_ARENA_SIZE=16777216

# FemtoVG has deep call chains (path flattening, font rasteriser); keep the main
# thread stack generous.
# 256 KiB: the in-process shader compiler runs on this thread when the image
# is built with it (docs/online-shaderc/frontend.md, "Stack"); 64 KiB
# overflowed into the idle thread on the AM62P.
CONFIG_MAIN_STACK_SIZE=262144
```

## boards/verdin_am62p_am62p54_a53.conf
```kconfig
# SPDX-License-Identifier: Apache-2.0
# SPDX-FileCopyrightText: 2026 Signal Slot, Inc.
# Verdin AM62P entered from Torizon Linux with tools/kexec-zephyr: bring the
# DSI panel up with the SafeUI display drivers, draw a FemtoVG frame into a
# full-screen XRGB8888 buffer in the image and show it as the DSS application
# plane, keep it for the camera, then reset back into Linux.
CONFIG_GL_FEMTOVG_WINDOW_PHYS=0
CONFIG_GL_FEMTOVG_WINDOW_WIDTH=1024
CONFIG_GL_FEMTOVG_WINDOW_HEIGHT=600
CONFIG_PVR_SAMPLE_HOLD_SECONDS=40
CONFIG_PVR_SAMPLE_REBOOT=y
CONFIG_REBOOT=y
# The RTI watchdog Linux leaves running (kexec entry): fed for 150 s, then a
# hung image is reset by it.
CONFIG_SOC_AM62PX_A53_FEED_INHERITED_WDT=y
# The bound, for whichever feeder runs (common/Kconfig).
CONFIG_YAKOGL_AM62P_WDT_SECONDS=150

# Init order: mailbox 40 -> TISCI 45 -> TISCI power-on 46 -> GPIO 47 ->
# I2C 50 -> DSI 70 -> DSS 80 -> GPU 90 -> panel bridge 95.
CONFIG_MBOX=y
CONFIG_MBOX_TI_SECURE_PROXY=y
CONFIG_TISCI=y
CONFIG_TISCI_INIT_PRIORITY=45
CONFIG_GPIO_INIT_PRIORITY=47
CONFIG_SAFEUI_SN65DSI8X_SELF_START_INIT_PRIORITY=95

# Console on main_uart0 (Verdin UART_3, the X18 debug USB); DDR does not
# survive the reset, so a RAM console would be useless.
CONFIG_LOG_MODE_MINIMAL=y
```

## boards/verdin_imx8mp_mimx8ml8_a53.conf
```kconfig
# SPDX-License-Identifier: Apache-2.0
# SPDX-FileCopyrightText: 2026 Signal Slot, Inc.
# Verdin iMX8M Plus (Mallow): what the board needs for this sample beyond
# prj.conf. The GPU, display and reset lines are slint's
# (slint/boards/verdin_imx8mp_mimx8ml8_a53.conf); this board runs
# src/main_board.c on the board layer (CMakeLists.txt picks it).
#
# prj.conf asks for the PowerVR driver, which is the AM62P's; there is no
# img,img-rogue node here, so turn it off instead of leaving an unmet "y".
CONFIG_SAFEUI_GPU_PVR=n
CONFIG_SAFEUI_GPU_VIVANTE=y
CONFIG_YAKOGL_GPU_VIVANTE=y
# The board layer: window in the GPU carve-out, the panel, the SNVS record,
# the WDOG1 self-arm (YAKOGL_BOARD_IMX8MP selects GC_BOARD_WDOG_SELF_ARM).
CONFIG_YAKOGL_BOARD=y
# FPU sharing off on purpose: with it on, printk from an interrupt handler
# spills argument registers through the FPU, which is disabled in exception
# context on arm64 (gc_slint/prj.conf).
CONFIG_FPU_SHARING=n
# No UART on the Mallow: the console is the board layer's panel console,
# and LOG_* goes through printk to reach it.
CONFIG_UART_CONSOLE=n
CONFIG_LOG_MODE_MINIMAL=y
# The display chain (the LCDIF scans the window, imx8mp_display_on).
CONFIG_GPIO=y
CONFIG_I2C=y
CONFIG_PINCTRL=y
CONFIG_SAFEUI_DISPLAY_IMX8MP=y
# The reset at the end of a run goes through PSCI.
CONFIG_PM_CPU_OPS=y
CONFIG_PM_CPU_OPS_PSCI=y

# The window: slint's 1024x600, which fits the panel.
CONFIG_GL_FEMTOVG_WINDOW_WIDTH=1024
CONFIG_GL_FEMTOVG_WINDOW_HEIGHT=600
```

## boards/verdin_imx8mp_mimx8ml8_a53.overlay
```dts
/* SPDX-License-Identifier: Apache-2.0 */
/* SPDX-FileCopyrightText: 2026 Signal Slot, Inc. */
/* The display chain of the Verdin iMX8M Plus on a Mallow carrier. */
#include "../../gc_common/verdin_imx8mp_display.dtsi"
```

## src/main.c
```c
/* SPDX-License-Identifier: Apache-2.0 */
/* SPDX-FileCopyrightText: 2026 Signal Slot, Inc. */
/*
 * gl_femtovg - draws one FemtoVG frame through YakoGL + EGL. The Rust
 * staticlib (fvg_zephyr, wrapping Agent A's no_std fvg_demo over femtovg/glow)
 * exposes fvg_draw_frame(); we bring up an EGL window surface over a scan-out
 * buffer, make it current, hand FemtoVG a get-proc-address hook, then show the
 * result on the LVDS panel (pvr_sample_show_on_dss).
 */
#include <zephyr/kernel.h>
#include <zephyr/logging/log.h>
#include <zephyr/cache.h>
#include <EGL/egl.h>
#include <GLES2/gl2.h>
#include <stdint.h>
#include "sample_glue.h"

LOG_MODULE_REGISTER(gl_femtovg, LOG_LEVEL_INF);

#define FB_W CONFIG_GL_FEMTOVG_WINDOW_WIDTH
#define FB_H CONFIG_GL_FEMTOVG_WINDOW_HEIGHT

#if CONFIG_GL_FEMTOVG_WINDOW_PHYS == 0
/* The window: a tightly packed buffer in the image, identity-mapped so its
 * address is its physical address. The GPU and the display read/write it
 * directly, so it is not zeroed by the boot code (__noinit) and the CPU cleans
 * its cache lines before use. XRGB8888 when a display scans it out. */
static uint8_t s_fb[FB_W * FB_H * 4] __noinit __aligned(4096);
#define FB_PHYS   ((uintptr_t)s_fb)
#define FB_STRIDE (FB_W * 4)
#ifdef CONFIG_PVR_SAMPLE_SHOW_ON_DSS
#define FB_FORMAT GLES_NATIVE_FORMAT_XRGB8888
#else
#define FB_FORMAT GLES_NATIVE_FORMAT_RGBA8888
#endif
#else
/* A scan-out buffer (XRGB8888 rows) that the display keeps showing. */
#define FB_PHYS   ((uintptr_t)CONFIG_GL_FEMTOVG_WINDOW_PHYS)
#define FB_STRIDE (CONFIG_GL_FEMTOVG_WINDOW_STRIDE ? CONFIG_GL_FEMTOVG_WINDOW_STRIDE : FB_W * 4)
#define FB_FORMAT GLES_NATIVE_FORMAT_XRGB8888
#endif
/* the window is drawn y-up when the display scans it bottom row first */
#define WIN_FORMAT (FB_FORMAT | pvr_sample_window_flags())

/* Rust entry point (fvg_zephyr staticlib, re-exported from fvg_demo). Draws one
 * FemtoVG frame through the currently-current GL ES 2.0 context. */
int fvg_draw_frame(const void *(*get_proc)(const char *name),
		   uint32_t width, uint32_t height);

/* FemtoVG/glow resolve every GL entry point they need through this hook. */
static const void *fvg_get_proc(const char *name)
{
	return (const void *)eglGetProcAddress(name);
}

#if CONFIG_GL_FEMTOVG_WINDOW_PHYS == 0
static void fill_pattern(void)
{
	uint32_t *px = (uint32_t *)s_fb;

	for (int y = 0; y < FB_H; y++) {
		uint32_t c = y < FB_H / 12 ? 0x00ffffffu : 0x00102040u;

		for (int x = 0; x < FB_W; x++) {
			px[y * FB_W + x] = c;
		}
	}
}
#endif

static int draw(void)
{
	static const EGLint cfg_attribs[] = {
		EGL_RED_SIZE, 8, EGL_GREEN_SIZE, 8, EGL_BLUE_SIZE, 8, EGL_ALPHA_SIZE, 8,
		EGL_DEPTH_SIZE, 16, EGL_SURFACE_TYPE, EGL_WINDOW_BIT,
		EGL_RENDERABLE_TYPE, EGL_OPENGL_ES2_BIT, EGL_NONE,
	};
	static const EGLint ctx_attribs[] = { EGL_CONTEXT_CLIENT_VERSION, 2, EGL_NONE };
	struct gles_native_window win = {
		.phys = FB_PHYS, .width = FB_W, .height = FB_H,
		.stride_bytes = FB_STRIDE, .format = WIN_FORMAT,
	};
	EGLDisplay dpy = eglGetDisplay(EGL_DEFAULT_DISPLAY);
	EGLConfig cfg;
	EGLSurface surf;
	EGLContext ctx;
	EGLint n = 0;
	int rc;

	if (!eglInitialize(dpy, NULL, NULL) || !eglChooseConfig(dpy, cfg_attribs, &cfg, 1, &n) || n != 1) {
		LOG_ERR("EGL init failed: 0x%x", eglGetError());
		return 1;
	}
	surf = eglCreateWindowSurface(dpy, cfg, &win, NULL);
	ctx = eglCreateContext(dpy, cfg, EGL_NO_CONTEXT, ctx_attribs);
	if (surf == EGL_NO_SURFACE || ctx == EGL_NO_CONTEXT || !eglMakeCurrent(dpy, surf, surf, ctx)) {
		LOG_ERR("EGL surface/context failed: 0x%x", eglGetError());
		return 1;
	}

	glViewport(0, 0, FB_W, FB_H);
	rc = fvg_draw_frame(fvg_get_proc, FB_W, FB_H);
	if (rc != 0) {
		LOG_ERR("fvg_draw_frame failed: %d (GL error 0x%x)", rc, glGetError());
		return 1;
	}
	eglSwapBuffers(dpy, surf);
	LOG_INF("FemtoVG frame drawn (GL error 0x%x)", glGetError());

	/* Ground-truth read-back: sample known points so the render is verifiable
	 * without a camera. GL origin is bottom-left, so y is flipped from the
	 * fvg_demo layout. Expected (fvg_demo.rs): bg rgb(24,24,32);
	 * blue rounded rect rgb(80,160,240) around screen (26%,25%);
	 * gradient rect top pink rgb(240,80,120) .. bottom yellow rgb(250,210,90)
	 * around screen x 73%. */
	{
		struct { const char *what; int x, y; } pts[] = {
			{ "bg",        FB_W * 1 / 2,  FB_H * 1 / 2 },
			{ "blue-rect", FB_W * 26 / 100, FB_H - 1 - FB_H * 25 / 100 },
			{ "grad-top",  FB_W * 73 / 100, FB_H - 1 - FB_H * 13 / 100 },
			{ "grad-bot",  FB_W * 73 / 100, FB_H - 1 - FB_H * 37 / 100 },
		};
		for (unsigned i = 0; i < sizeof(pts) / sizeof(pts[0]); i++) {
			uint8_t px[4] = { 0, 0, 0, 0 };

			glReadPixels(pts[i].x, pts[i].y, 1, 1, GL_RGBA,
				     GL_UNSIGNED_BYTE, px);
			LOG_INF("readback %-9s (%4d,%4d) = R=%3u G=%3u B=%3u A=%3u",
				pts[i].what, pts[i].x, pts[i].y,
				px[0], px[1], px[2], px[3]);
		}
	}

	return 0;
}

int main(void)
{
	int rc;

	LOG_INF("gl_femtovg: %ux%u window at 0x%lx", FB_W, FB_H, (unsigned long)FB_PHYS);
#if CONFIG_GL_FEMTOVG_WINDOW_PHYS == 0
	/* A CPU-drawn pattern first, so the display path can be judged even when
	 * the GPU draw fails; FemtoVG overwrites it. */
	fill_pattern();
	sys_cache_data_flush_and_invd_range(s_fb, sizeof(s_fb));
#endif
	rc = draw();
	LOG_INF("gl_femtovg: %s", rc ? "FAILED" : "done");
	if (pvr_sample_show_window(FB_PHYS, FB_W, FB_H, FB_STRIDE, WIN_FORMAT) && rc == 0) {
		rc = -EIO;
	}
	return pvr_sample_finish(rc);
}
```

## src/main_board.c
```c
/* SPDX-License-Identifier: Apache-2.0 */
/* SPDX-FileCopyrightText: 2026 Signal Slot, Inc. */
/*
 * gl_femtovg on the board layer (yakogl_board.h): the same FemtoVG frame as
 * main.c (fvg_demo's fvg_draw_frame through the Rust staticlib), for the
 * boards whose board file turns CONFIG_YAKOGL_BOARD on. Today that is the
 * Verdin iMX8M Plus (GC7000); the AM62P keeps main.c and its pvr_sample_*
 * glue until the sample moves to the board layer as a whole
 * (driver/docs/one-method.md, section 5, step 4).
 *
 * The run follows slint/src/main.c:
 *
 *   board_window(W, H)                the GPU carve-out on the i.MX8MP
 *   EGL up (RGBA8888 + stencil 8, ES 2)
 *   fvg_draw_frame, eglSwapBuffers, board_show()
 *   four glReadPixels probes, judged against fvg_demo's scene
 *   board_finish(): the verdict line and the APP record
 *
 * The probes are main.c's four points. Their expected colours come from
 * fvg_demo/src/lib.rs: the clear rgb(24,24,32), the rounded rect
 * rgb(80,160,240), and the vertical gradient from rgb(240,80,120) at the
 * top of its rect to rgb(250,210,90) at the bottom, mixed at the pixel
 * centre. GRAD_TOL is v3d_gl_femtovg's: femtovg dithers gradients by up to
 * half an 8-bit step.
 */
#include <zephyr/kernel.h>
#include <zephyr/sys/printk.h>
#include <errno.h>
#include <stdint.h>
#include <stdlib.h>

#include <EGL/egl.h>
#include <GLES2/gl2.h>

#include <yakogl_board.h>
#include <yakogl_record.h>

#define WIN_W CONFIG_GL_FEMTOVG_WINDOW_WIDTH
#define WIN_H CONFIG_GL_FEMTOVG_WINDOW_HEIGHT

/* board_window() decides where the window is; a fixed address is main.c's. */
BUILD_ASSERT(CONFIG_GL_FEMTOVG_WINDOW_PHYS == 0,
	     "GL_FEMTOVG_WINDOW_PHYS is not used on the board layer: board_window() places the window");

#define GRAD_TOL 2

/* Where a run that died stopped (kind PROGRESS, YK_RECORD_WHERE_STAGE | n). */
enum stage {
	STAGE_WINDOW = 1,
	STAGE_EGL,
	STAGE_DRAW,
	STAGE_SWAPPED,
	STAGE_CHECKED,
};

/* Rust entry point (fvg_zephyr staticlib, re-exported from fvg_demo). Draws one
 * FemtoVG frame through the currently-current GL ES 2.0 context. */
int fvg_draw_frame(const void *(*get_proc)(const char *name), uint32_t width, uint32_t height);

/* FemtoVG/glow resolve every GL entry point they need through this hook. */
static const void *fvg_get_proc(const char *name)
{
	return (const void *)eglGetProcAddress(name);
}

static struct board_window s_win;
static EGLDisplay s_dpy;
static EGLSurface s_surf;

/* Each EGL call is checked on its own: eglGetError reports the LAST call. */
static int egl_fail(const char *call)
{
	printk("gl_femtovg: %s failed: EGL error 0x%x\n", call, eglGetError());
	return -EIO;
}

static int egl_up(void)
{
	/* femtovg fills and strokes through the stencil (as in slint) */
	static const EGLint cfg_attribs[] = {
		EGL_RED_SIZE, 8, EGL_GREEN_SIZE, 8, EGL_BLUE_SIZE, 8, EGL_ALPHA_SIZE, 8,
		EGL_STENCIL_SIZE, 8, EGL_SURFACE_TYPE, EGL_WINDOW_BIT,
		EGL_RENDERABLE_TYPE, EGL_OPENGL_ES2_BIT, EGL_NONE,
	};
	static const EGLint ctx_attribs[] = { EGL_CONTEXT_CLIENT_VERSION, 2, EGL_NONE };
	static struct gles_native_window nw;
	EGLConfig cfg;
	EGLContext ctx;
	EGLint n = 0;

	nw = (struct gles_native_window){
		.phys = s_win.phys, .width = s_win.w, .height = s_win.h,
		.stride_bytes = s_win.stride, .format = s_win.format,
	};
	s_dpy = eglGetDisplay(EGL_DEFAULT_DISPLAY);
	if (!eglInitialize(s_dpy, NULL, NULL)) {
		return egl_fail("eglInitialize");
	}
	if (!eglChooseConfig(s_dpy, cfg_attribs, &cfg, 1, &n)) {
		return egl_fail("eglChooseConfig");
	}
	if (n != 1) {
		printk("gl_femtovg: eglChooseConfig: %d configs for RGBA8888 + stencil 8\n", n);
		return -ENOENT;
	}
	s_surf = eglCreateWindowSurface(s_dpy, cfg, &nw, NULL);
	if (s_surf == EGL_NO_SURFACE) {
		return egl_fail("eglCreateWindowSurface");
	}
	ctx = eglCreateContext(s_dpy, cfg, EGL_NO_CONTEXT, ctx_attribs);
	if (ctx == EGL_NO_CONTEXT) {
		return egl_fail("eglCreateContext");
	}
	if (!eglMakeCurrent(s_dpy, s_surf, s_surf, ctx)) {
		return egl_fail("eglMakeCurrent");
	}
	printk("gl_femtovg: GL_RENDERER %s, GL_VERSION %s\n", (const char *)glGetString(GL_RENDERER),
	       (const char *)glGetString(GL_VERSION));
	return 0;
}

static int draw(void)
{
	int ret;
	GLenum err;

	board_progress(YK_RECORD_WHERE_STAGE | STAGE_DRAW);
	glViewport(0, 0, WIN_W, WIN_H);
	ret = fvg_draw_frame(fvg_get_proc, WIN_W, WIN_H);
	if (ret != 0) {
		printk("gl_femtovg: fvg_draw_frame failed: %d (GL error 0x%x)\n", ret, glGetError());
		return -EIO;
	}
	if (!eglSwapBuffers(s_dpy, s_surf)) {
		return egl_fail("eglSwapBuffers");
	}
	err = glGetError();
	if (err != GL_NO_ERROR) {
		printk("gl_femtovg: GL error 0x%x during the frame\n", err);
		return -EIO;
	}
	board_progress(YK_RECORD_WHERE_STAGE | STAGE_SWAPPED);
	ret = board_show(&s_win);
	if (ret != 0) {
		/* the check reads the window, not the screen: go on */
		printk("gl_femtovg: board_show = %d (the window is not on the screen)\n", ret);
	}
	return 0;
}

/* The gradient of fvg_demo's rect (b) at canvas row y: its rect starts at
 * 10% of the height and is 30% of it tall; the colour is mixed at the pixel
 * centre. */
static uint8_t grad_mix(uint8_t top, uint8_t bottom, int y)
{
	float t = ((float)y + 0.5f - WIN_H * 0.10f) / (WIN_H * 0.30f);

	t = t < 0.0f ? 0.0f : (t > 1.0f ? 1.0f : t);
	return (uint8_t)((float)top + ((float)bottom - (float)top) * t + 0.5f);
}

/* Main.c's four points, now judged. x, y are canvas coordinates (y down);
 * glReadPixels counts rows from the bottom. Returns how many points are off. */
static int check(void)
{
	struct probe {
		const char *what;
		int x, y;
		uint8_t rgb[3];
	} pts[] = {
		{ "bg", WIN_W * 1 / 2, WIN_H * 1 / 2, { 24, 24, 32 } },
		{ "blue-rect", WIN_W * 26 / 100, WIN_H * 25 / 100, { 80, 160, 240 } },
		{ "grad-top", WIN_W * 73 / 100, WIN_H * 13 / 100, { 0 } },
		{ "grad-bot", WIN_W * 73 / 100, WIN_H * 37 / 100, { 0 } },
	};
	static const uint8_t grad_top[3] = { 240, 80, 120 }, grad_bot[3] = { 250, 210, 90 };
	int bad = 0;

	for (int c = 0; c < 3; c++) {
		pts[2].rgb[c] = grad_mix(grad_top[c], grad_bot[c], pts[2].y);
		pts[3].rgb[c] = grad_mix(grad_top[c], grad_bot[c], pts[3].y);
	}
	for (unsigned int i = 0; i < ARRAY_SIZE(pts); i++) {
		uint8_t px[4] = { 0, 0, 0, 0 };
		bool ok;

		glReadPixels(pts[i].x, WIN_H - 1 - pts[i].y, 1, 1, GL_RGBA, GL_UNSIGNED_BYTE, px);
		ok = px[3] == 255;
		for (int c = 0; c < 3; c++) {
			ok = ok && abs((int)px[c] - (int)pts[i].rgb[c]) <= GRAD_TOL;
		}
		printk("gl_femtovg: readback %-9s (%4d,%4d) = R=%3u G=%3u B=%3u A=%3u, "
		       "expected %3u %3u %3u 255: %s\n",
		       pts[i].what, pts[i].x, pts[i].y, px[0], px[1], px[2], px[3], pts[i].rgb[0],
		       pts[i].rgb[1], pts[i].rgb[2], ok ? "ok" : "OFF");
		bad += ok ? 0 : 1;
	}
	return bad;
}

int main(void)
{
	int rc;

	printk("gl_femtovg: one FemtoVG frame at %ux%u on the board layer\n", WIN_W, WIN_H);
	board_progress(YK_RECORD_WHERE_STAGE | STAGE_WINDOW);
	rc = board_window(WIN_W, WIN_H, &s_win);
	if (rc != 0) {
		printk("gl_femtovg: board_window(%u, %u) = %d\n", WIN_W, WIN_H, rc);
	} else {
		printk("gl_femtovg: window %ux%u at phys 0x%lx, stride %u, format 0x%x\n", s_win.w,
		       s_win.h, (unsigned long)s_win.phys, s_win.stride, s_win.format);
		board_progress(YK_RECORD_WHERE_STAGE | STAGE_EGL);
		rc = egl_up();
	}
	if (rc == 0) {
		rc = draw();
	}
	if (rc == 0) {
		int bad = check();

		board_progress(YK_RECORD_WHERE_STAGE | STAGE_CHECKED);
		if (bad != 0) {
			printk("gl_femtovg: %d of 4 readback points off\n", bad);
			rc = -EIO;
		}
	}
	board_finish("gl_femtovg", rc);
}
```
