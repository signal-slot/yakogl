/* SPDX-License-Identifier: Apache-2.0 */
/* SPDX-FileCopyrightText: 2026 Signal Slot, Inc. */
/*
 * The board's sram0 is 512 KiB at 0x200000 (dts/arm64/broadcom/bcm2711.dtsi).
 * This image carries the V3D's 48 MiB carve-out, the compiler's scratch,
 * dEQP (code and 1.1 MB of test data) and a 64 MiB C heap as statics, so it
 * gets 256 MiB from 0x200000. DRAM starts at 0 on the Pi 4 and the firmware
 * keeps its own memory at the top of the first GiB, so this is ARM memory on
 * every Pi 4.
 */
#include "../../common/rpi_4b_sram.dtsi"

&sram0 {
	reg = <0x200000 0x10000000>;
};
