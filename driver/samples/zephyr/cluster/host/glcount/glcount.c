/* SPDX-License-Identifier: Apache-2.0 */
/* SPDX-FileCopyrightText: 2026 Signal Slot, Inc. */
/*
 * glcount: the image's Rust library (rust/, the cluster's UI through Slint's
 * no_std FemtoVG renderer) built for the host and driven with a stub GL that
 * draws nothing and counts the calls. It answers what the renderer asks of
 * GL per frame without a board: here, how many textures a frame creates
 * (glTexImage2D) and how many it only refills (glTexSubImage2D).
 *
 * The stub offers the GL functions YakoGL's eglGetProcAddress answers (its
 * PROCS table, src/gl/egl.rs; gl_names.h, generated by run.sh) and nothing
 * else: FemtoVG takes the paths it would take on the board (the OES vertex
 * arrays, for one).
 * The calls that return something get an answer a working context would give
 * (ids, a "OpenGL ES 2.0" version string, shaders that compile and programs
 * that link); every other call is a no-op returning 0. The no-op is called
 * through the caller's own signature, which the x86-64 System V ABI allows
 * for a function that reads no arguments (host test only).
 *
 * The sequence, printed one line per frame: the check's first two frames
 * (Slint clock 0 and 1000 ms, 400 telemetry ticks between them), then
 * GLCOUNT_FRAMES frames 200 ms apart (4 ticks each), as the demo draws.
 * Textures of 256x1 are FemtoVG's multi-stop gradient tables
 * (femtovg/src/gradient_store.rs: one per distinct set of stops, freed when
 * a frame does not use it), counted apart from the others, which are the
 * Text items' and the images'.
 *
 * The verdict (exit 1 on FAIL): after the warm-up, no steady frame creates
 * a texture, a gradient table included (the fork pools the tables). A frame is steady when it makes as
 * many draws as the frame before it: the same items are on screen, so every
 * Text item had a texture last frame. A frame whose draw count changed may
 * show a new item (an icon appearing makes its image's texture) and is left
 * out, and printed as left out. The pool's own counters
 * (slint_cluster_gradient_pool) must agree with the 256x1 textures the stub
 * saw created (a library without the pool is a FAIL: nothing to compare). And the run must show that it
 * measured something: the speed text changed and textures other than the
 * gradient tables were refilled (a run where neither happens cannot tell a
 * reused texture from an unused one).
 *
 * GLCOUNT_DEMO_S=N replays the demo's own sequence instead (src/main.c): the
 * check's three frames (Slint clock 0, 1000 and 3000 ms, FRAME_TICKS = 400
 * telemetry ticks before the second), then N seconds of demo frames
 * GLCOUNT_STEP_MS apart (default 63, the board's mean frame at 15.8 fps),
 * the ticks due at 50 ms each and the clock 3000 ms + t, as main.c's demo
 * loop sets them. Every GLCOUNT_REPORT_S (default 10) seconds of that time
 * it prints the per-frame means by main.c's definitions: "uploads"
 * (glTexImage2D calls with pixels and glTexSubImage2D calls) and "new
 * textures" (glTexImage2D calls). main.c's "tilings" count the V3D
 * backend's CPU tilings, which a stub GL cannot see; it prints none. No
 * verdict: the numbers are read against the board's report lines.
 */
#include <signal.h>
#include <stdbool.h>
#include <math.h>
#include <stdarg.h>
#include <stdint.h>
#include <stdio.h>
#include <stdlib.h>
#include <malloc.h>
#include <string.h>
#include <unistd.h>

#include <GLES2/gl2.h>

/* the Rust library's entry points and what it asks of the C side */
int slint_cluster_draw_frame(const void *(*get_proc)(const char *), uint32_t w, uint32_t h);
int slint_cluster_advance(uint32_t n);
int slint_cluster_speed_x10(void);
int slint_cluster_stress_frame(const void *(*get_proc)(const char *), uint32_t w, uint32_t h, uint32_t arm,
			       uint32_t n);
/* weak: a library from before the gradient-table pool (d24de064 and older)
 * has no such function, and the run says the pool is absent */
__attribute__((weak)) void slint_cluster_gradient_pool(uint32_t *created, uint32_t *reused, uint32_t *high_water,
						       uint32_t *refused, uint32_t *pool_max);

static uint64_t ui_clock_ms;

uint64_t slint_zephyr_uptime_ms(void)
{
	return ui_clock_ms;
}

/* the Rust heap's bytes in use (malloc_usable_size: an upper bound per
 * block), for GLCOUNT_STRESS's growth check */
static size_t heap_in_use;

void *slint_heap_alloc(size_t alignment, size_t size)
{
	void *p = NULL;
	if (alignment < sizeof(void *))
		alignment = sizeof(void *);
	if (posix_memalign(&p, alignment, size ? size : 1) != 0)
		return NULL;
	heap_in_use += malloc_usable_size(p);
	return p;
}

void slint_heap_free(void *p)
{
	if (p)
		heap_in_use -= malloc_usable_size(p);
	free(p);
}

int printk(const char *fmt, ...)
{
	va_list ap;
	va_start(ap, fmt);
	int n = vprintf(fmt, ap);
	va_end(ap);
	return n;
}

/* ---- the counters --------------------------------------------------------- */

#define IS_GRADIENT(w, h) ((w) == 256 && (h) == 1)

static struct {
	unsigned tex_images, tex_images_data, tex_subs, tex_deletes, draws;
	unsigned gradients_new, other_new, other_subs;
	double area_colour, area_stencil; /* rasterised pixels (triangle area) */
	unsigned draws_unmeasured;        /* draws whose vertices the stub cannot read */
	/* whole-texture refills by the age of the texture's last use: sampled by
	 * the previous frame (in flight under a one-frame pipeline: the refill
	 * must wait for that job), or older (free), split by 256x1 tables */
	unsigned refill_busy_table, refill_busy_other, refill_free_table, refill_free_other;
	uint64_t sub_bytes;
	char sizes[160]; /* the created textures' sizes, "WxH WxH ..." */
} c;

static GLuint next_id = 1;

/* What each draw samples, for the demo replay: FemtoVG binds the paint's
 * texture on unit 0 and the glyph texture on unit 1 before every draw
 * (femtovg renderer/opengl.rs set_uniforms), so a draw's pair of bound
 * textures is well defined. Each texture's content is a hash of what was
 * uploaded to it: a glTexSubImage2D that covers the whole texture replaces
 * the hash (so a refilled texture and a new texture with the same pixels
 * hash the same), a partial one chains onto it, and glTexImage2D without
 * pixels is "empty WxH". The signature folds, per draw, the mode, the count
 * and the two bound textures' contents; texture ids are not in it, so two
 * libraries that draw the same with differently managed textures (a refill
 * or a pooled table instead of a new texture) give the same signature. It
 * cannot see vertex data or uniforms. GLCOUNT_DROP_REFILL is its control. */
#define MAX_TEX_ID (1u << 22)
struct tex_state {
	uint64_t content;
	uint32_t w, h;
	GLenum fmt, min, mag; /* for GLCOUNT_TRACE */
	uint32_t last_drawn;  /* the replay frame (1-based) that last sampled it, 0 never */
	int border_alpha;     /* the largest alpha on the texture's outer ring of texels
			       * at its last whole upload (RGBA only); -1 unknown */
};

/* The largest alpha of the outer ring of a w x h RGBA8 image (the texels an
 * edge fringe or an inset would blend): 0 means the ring is transparent. */
static int ring_alpha(const uint8_t *px, uint32_t w, uint32_t h)
{
	int a = 0;
	for (uint32_t y = 0; y < h; y++)
		for (uint32_t x = 0; x < w; x += (y == 0 || y == h - 1) ? 1 : (w > 1 ? w - 1 : 1)) {
			const int v = px[((size_t)y * w + x) * 4 + 3];
			a = v > a ? v : a;
		}
	return a;
}
static struct tex_state *texs;
static GLuint bound[8];
static unsigned cur_unit;
static uint64_t signature = 0xcbf29ce484222325ull;
static int content_error; /* an id past MAX_TEX_ID or an unknown format: the signature is void */
/* GLCOUNT_DROP_REFILL=N, the signature's control: the Nth whole-texture
 * glTexSubImage2D into a 256x1 gradient table is not applied, as a pooled
 * table handed out without its refill would be; the signature must change. */
static unsigned drop_refill, gradient_refills;
static uint32_t replay_frame; /* the demo replay's frame, 1-based; 0 outside it */

static uint64_t fnv(uint64_t h, const void *p, size_t n)
{
	const uint8_t *b = p;
	for (size_t i = 0; i < n; i++) {
		h ^= b[i];
		h *= 0x100000001b3ull;
	}
	return h;
}
static uint64_t fnv_u64(uint64_t h, uint64_t v)
{
	return fnv(h, &v, sizeof(v));
}
static struct tex_state *bound_tex(void)
{
	GLuint id = cur_unit < 8 ? bound[cur_unit] : 0;
	if (!texs || id == 0)
		return NULL;
	if (id >= MAX_TEX_ID) {
		content_error = 1;
		return NULL;
	}
	return &texs[id];
}
static size_t bytes_per_pixel(GLenum f, GLenum ty)
{
	if (ty != GL_UNSIGNED_BYTE)
		return 0;
	switch (f) {
	case GL_ALPHA:
	case GL_LUMINANCE: return 1;
	case GL_LUMINANCE_ALPHA: return 2;
	case GL_RGB: return 3;
	case GL_RGBA: return 4;
	default: return 0;
	}
}

/* ---- the stub GL ------------------------------------------------------------ */

static long gl_noop(void)
{
	return 0;
}

static const GLubyte *GL_APIENTRY s_GetString(GLenum name)
{
	switch (name) {
	case GL_VERSION: return (const GLubyte *)"OpenGL ES 2.0 glcount";
	case GL_SHADING_LANGUAGE_VERSION: return (const GLubyte *)"OpenGL ES GLSL ES 1.00";
	case GL_VENDOR: return (const GLubyte *)"glcount";
	case GL_RENDERER: return (const GLubyte *)"glcount (counts, draws nothing)";
	default: return (const GLubyte *)"";
	}
}

static void gen(GLsizei n, GLuint *ids)
{
	for (GLsizei i = 0; i < n; i++)
		ids[i] = next_id++;
}
static void GL_APIENTRY s_GenTextures(GLsizei n, GLuint *ids) { gen(n, ids); }
static void GL_APIENTRY s_GenBuffers(GLsizei n, GLuint *ids) { gen(n, ids); }
static void GL_APIENTRY s_GenFramebuffers(GLsizei n, GLuint *ids) { gen(n, ids); }
static void GL_APIENTRY s_GenRenderbuffers(GLsizei n, GLuint *ids) { gen(n, ids); }
static void GL_APIENTRY s_GenVertexArrays(GLsizei n, GLuint *ids) { gen(n, ids); }
/* GLCOUNT_TRACE: what each program is (the defines FemtoVG compiles its
 * fragment shader with: renderer/opengl/program.rs puts "#define
 * SELECT_SHADER n", ENABLE_GLYPH_TEXTURE, NO_DISCARD and EDGE_AA at the top),
 * and its last frag[] uniform (main-fs.glsl: 14 vec4s) */
#define TRACE_SHADERS 128
static struct {
	GLuint id;
	int sel; /* SELECT_SHADER, -1 unknown */
	bool frag, glyph, nodiscard, aa;
} shaders[TRACE_SHADERS];
static unsigned nshaders;
#define TRACE_PROGS 64
static struct {
	GLuint id;
	int sel;
	bool glyph, nodiscard, aa;
	GLint frag_loc;
	float frag[56];
	bool frag_set;
} progs[TRACE_PROGS];
static unsigned nprogs;
static GLuint cur_prog;
static bool blend_on, stencil_on, scissor_on;
static GLenum blend_f[4], stencil_func, stencil_ops[3];
static GLint stencil_ref;
static GLuint stencil_fmask;

static GLuint GL_APIENTRY s_CreateShader(GLenum t)
{
	GLuint id = next_id++;
	if (nshaders < TRACE_SHADERS)
		shaders[nshaders++] = (typeof(shaders[0])){ .id = id, .sel = -1, .frag = t == GL_FRAGMENT_SHADER };
	return id;
}
static GLuint GL_APIENTRY s_CreateProgram(void)
{
	GLuint id = next_id++;
	if (nprogs < TRACE_PROGS)
		progs[nprogs++] = (typeof(progs[0])){ .id = id, .sel = -1, .frag_loc = -1 };
	return id;
}
static void GL_APIENTRY s_ShaderSource(GLuint sh, GLsizei n, const GLchar *const *str, const GLint *len)
{
	for (unsigned i = 0; i < nshaders; i++) {
		if (shaders[i].id != sh)
			continue;
		for (GLsizei k = 0; k < n; k++) {
			const char *t = str[k];
			size_t l = len && len[k] >= 0 ? (size_t)len[k] : strlen(t);
			char buf[4096];
			l = l < sizeof(buf) - 1 ? l : sizeof(buf) - 1;
			memcpy(buf, t, l);
			buf[l] = 0;
			const char *m = strstr(buf, "#define SELECT_SHADER ");
			if (m)
				shaders[i].sel = atoi(m + strlen("#define SELECT_SHADER "));
			shaders[i].glyph |= strstr(buf, "#define ENABLE_GLYPH_TEXTURE") != NULL;
			shaders[i].nodiscard |= strstr(buf, "#define NO_DISCARD") != NULL;
			shaders[i].aa |= strstr(buf, "#define EDGE_AA") != NULL;
		}
	}
}
static void GL_APIENTRY s_AttachShader(GLuint p, GLuint sh)
{
	for (unsigned i = 0; i < nprogs; i++)
		if (progs[i].id == p)
			for (unsigned k = 0; k < nshaders; k++)
				if (shaders[k].id == sh && shaders[k].frag) {
					progs[i].sel = shaders[k].sel;
					progs[i].glyph = shaders[k].glyph;
					progs[i].nodiscard = shaders[k].nodiscard;
					progs[i].aa = shaders[k].aa;
				}
}
static void GL_APIENTRY s_UseProgram(GLuint p)
{
	cur_prog = p;
}
static void GL_APIENTRY s_Uniform4fv(GLint loc, GLsizei n, const GLfloat *v)
{
	for (unsigned i = 0; i < nprogs; i++)
		if (progs[i].id == cur_prog && progs[i].frag_loc == loc && n * 4 <= 56) {
			memcpy(progs[i].frag, v, (size_t)n * 4 * sizeof(float));
			progs[i].frag_set = true;
		}
}
static void set_cap(GLenum cap, bool on)
{
	if (cap == GL_BLEND)
		blend_on = on;
	else if (cap == GL_STENCIL_TEST)
		stencil_on = on;
	else if (cap == GL_SCISSOR_TEST)
		scissor_on = on;
}
static void GL_APIENTRY s_Enable(GLenum cap) { set_cap(cap, true); }
static void GL_APIENTRY s_Disable(GLenum cap) { set_cap(cap, false); }
static void GL_APIENTRY s_BlendFuncSeparate(GLenum a, GLenum b, GLenum c, GLenum d)
{
	blend_f[0] = a, blend_f[1] = b, blend_f[2] = c, blend_f[3] = d;
}
static void GL_APIENTRY s_BlendFunc(GLenum a, GLenum b) { s_BlendFuncSeparate(a, b, a, b); }
static void GL_APIENTRY s_StencilFunc(GLenum f, GLint r, GLuint m)
{
	stencil_func = f, stencil_ref = r, stencil_fmask = m;
}
static void GL_APIENTRY s_StencilOp(GLenum a, GLenum b, GLenum c)
{
	stencil_ops[0] = a, stencil_ops[1] = b, stencil_ops[2] = c;
}
static void GL_APIENTRY s_StencilOpSeparate(GLenum face, GLenum a, GLenum b, GLenum c)
{
	(void)face; /* the trace prints the last face set (FemtoVG sets FRONT then BACK) */
	s_StencilOp(a, b, c);
}

static void GL_APIENTRY s_GetShaderiv(GLuint s, GLenum p, GLint *v)
{
	(void)s;
	*v = p == GL_COMPILE_STATUS ? GL_TRUE : 0;
}
static void GL_APIENTRY s_GetProgramiv(GLuint s, GLenum p, GLint *v)
{
	(void)s;
	*v = p == GL_LINK_STATUS ? GL_TRUE : 0;
}
static void GL_APIENTRY s_GetShaderInfoLog(GLuint s, GLsizei n, GLsizei *len, GLchar *log)
{
	(void)s;
	if (len)
		*len = 0;
	if (log && n > 0)
		log[0] = 0;
}
static void GL_APIENTRY s_GetIntegerv(GLenum p, GLint *v)
{
	memset(v, 0, 4 * sizeof(*v)); /* GL_VIEWPORT and the like take 4 */
	switch (p) {
	case GL_MAX_TEXTURE_SIZE: *v = 4096; break;
	case GL_MAX_VERTEX_ATTRIBS: *v = 16; break;
	case GL_MAX_TEXTURE_IMAGE_UNITS: *v = 16; break;
	case GL_STENCIL_BITS: *v = 8; break;
	default: break;
	}
}
static GLint GL_APIENTRY s_GetUniformLocation(GLuint p, const GLchar *n)
{
	GLint loc = (GLint)(next_id++ & 0xffff);
	if (n && strcmp(n, "frag") == 0)
		for (unsigned i = 0; i < nprogs; i++)
			if (progs[i].id == p)
				progs[i].frag_loc = loc;
	return loc;
}
static GLenum GL_APIENTRY s_CheckFramebufferStatus(GLenum t)
{
	(void)t;
	return GL_FRAMEBUFFER_COMPLETE;
}
static GLint GL_APIENTRY s_GetAttribLocation(GLuint p, const GLchar *n)
{
	(void)p;
	(void)n;
	return 0;
}

static void GL_APIENTRY s_TexImage2D(GLenum t, GLint l, GLint ifmt, GLsizei w, GLsizei h, GLint b, GLenum f,
				     GLenum ty, const void *px)
{
	(void)t, (void)l, (void)ifmt, (void)b;
	struct tex_state *ts = bound_tex();
	if (ts) {
		const size_t bpp = bytes_per_pixel(f, ty);
		content_error |= bpp == 0;
		ts->w = (uint32_t)w;
		ts->h = (uint32_t)h;
		ts->fmt = f;
		ts->border_alpha = px && f == GL_RGBA && ty == GL_UNSIGNED_BYTE ? ring_alpha(px, (uint32_t)w, (uint32_t)h)
									     : -1;
		ts->content = px ? fnv(0x7e, px, (size_t)w * (size_t)h * bpp)
				 : fnv_u64(fnv_u64(0xe0, (uint64_t)w), (uint64_t)h);
	}
	c.tex_images++;
	c.tex_images_data += px != NULL;
	if (IS_GRADIENT(w, h))
		c.gradients_new++;
	else
		c.other_new++;
	size_t n = strlen(c.sizes);
	if (n + 16 < sizeof(c.sizes))
		snprintf(c.sizes + n, sizeof(c.sizes) - n, "%s%dx%d", n ? " " : "", (int)w, (int)h);
}
static void GL_APIENTRY s_TexSubImage2D(GLenum t, GLint l, GLint x, GLint y, GLsizei w, GLsizei h, GLenum f,
					GLenum ty, const void *px)
{
	(void)t, (void)l;
	struct tex_state *ts = bound_tex();
	if (ts) {
		const size_t bpp = bytes_per_pixel(f, ty);
		content_error |= bpp == 0 || px == NULL;
		const uint64_t data = px ? fnv(0x7e, px, (size_t)w * (size_t)h * bpp) : 0;
		const int whole = x == 0 && y == 0 && (uint32_t)w == ts->w && (uint32_t)h == ts->h;
		if (whole && replay_frame && ts->last_drawn) {
			const bool busy = ts->last_drawn + 1 >= replay_frame; /* this frame or the previous */
			if (IS_GRADIENT(w, h))
				busy ? c.refill_busy_table++ : c.refill_free_table++;
			else
				busy ? c.refill_busy_other++ : c.refill_free_other++;
		}
		if (whole && IS_GRADIENT(w, h) && ++gradient_refills == drop_refill)
			; /* the control: this refill is lost */
		else if (whole) {
			ts->content = data;
			ts->border_alpha = f == GL_RGBA && ty == GL_UNSIGNED_BYTE && px
						   ? ring_alpha(px, (uint32_t)w, (uint32_t)h)
						   : -1;
		}
		else
			ts->content = fnv_u64(fnv_u64(fnv_u64(ts->content, ((uint64_t)x << 32) | (uint32_t)y),
						     ((uint64_t)w << 32) | (uint32_t)h),
					      data);
	}
	c.tex_subs++;
	c.other_subs += !IS_GRADIENT(w, h);
	c.sub_bytes += (uint64_t)w * (uint64_t)h * 4u;
}
static void GL_APIENTRY s_DeleteTextures(GLsizei n, const GLuint *ids)
{
	for (GLsizei i = 0; i < n; i++) {
		for (unsigned u = 0; u < 8; u++)
			if (bound[u] == ids[i])
				bound[u] = 0; /* GL: deleting a bound texture unbinds it */
		if (texs && ids[i] < MAX_TEX_ID)
			memset(&texs[ids[i]], 0, sizeof(texs[0]));
	}
	c.tex_deletes += (unsigned)n;
}
/* The pixels a frame rasterises, for the demo replay: FemtoVG uploads the
 * frame's vertices with one glBufferData on GL_ARRAY_BUFFER and points
 * attribute 0 at them (x, y floats, already in window pixels: FemtoVG
 * transforms on the CPU; renderer/opengl.rs), then draws TRIANGLES and
 * TRIANGLE_STRIPs from it. The stub keeps the last buffer data per id and
 * sums each draw's triangle areas, split by whether colour writes were on
 * (glColorMask: the stencil-only passes of a fill have them off). Vertices
 * are clamped to the window, which is not an exact clip, and the scissor and
 * the stencil test are not modelled: this is the rasteriser's input area, an
 * upper bound on the fragments shaded, not a GPU time. */
#define W 1920 /* the window the replay draws (main.c's 1920x720) */
#define H 720
#define W_PX ((float)W)
#define H_PX ((float)H)
#define VBO_SLOTS 8
static struct {
	GLuint id;
	uint8_t *data;
	size_t size;
} vbos[VBO_SLOTS];
static GLuint array_buffer;
static GLint a0_stride, a0_size;
static uintptr_t a0_offset;
static GLenum a0_type;
static bool colour_on = true;

static void GL_APIENTRY s_BindBuffer(GLenum t, GLuint id)
{
	if (t == GL_ARRAY_BUFFER)
		array_buffer = id;
}
static void GL_APIENTRY s_BufferData(GLenum t, GLsizeiptr n, const void *d, GLenum u)
{
	(void)u;
	if (t != GL_ARRAY_BUFFER || array_buffer == 0)
		return;
	unsigned i = 0;
	while (i < VBO_SLOTS && vbos[i].id && vbos[i].id != array_buffer)
		i++;
	if (i == VBO_SLOTS) {
		content_error = 1; /* more vertex buffers than the stub follows */
		return;
	}
	vbos[i].id = array_buffer;
	free(vbos[i].data);
	vbos[i].data = NULL;
	vbos[i].size = 0;
	if (d && n > 0 && (vbos[i].data = malloc((size_t)n)) != NULL) {
		memcpy(vbos[i].data, d, (size_t)n);
		vbos[i].size = (size_t)n;
	}
}
static void GL_APIENTRY s_VertexAttribPointer(GLuint idx, GLint size, GLenum type, GLboolean norm, GLsizei stride,
					      const void *ptr)
{
	(void)norm;
	if (idx != 0)
		return;
	a0_size = size;
	a0_type = type;
	a0_stride = stride;
	a0_offset = (uintptr_t)ptr;
}
static void GL_APIENTRY s_ColorMask(GLboolean r, GLboolean g, GLboolean b, GLboolean a)
{
	colour_on = r || g || b || a;
}

static bool vertex(GLint k, float *x, float *y)
{
	unsigned i = 0;
	while (i < VBO_SLOTS && vbos[i].id != array_buffer)
		i++;
	if (i == VBO_SLOTS || !vbos[i].data || a0_type != GL_FLOAT || a0_size < 2)
		return false;
	const size_t stride = a0_stride ? (size_t)a0_stride : (size_t)a0_size * sizeof(float);
	const size_t at = a0_offset + (size_t)k * stride;
	if (at + 2 * sizeof(float) > vbos[i].size)
		return false;
	memcpy(x, vbos[i].data + at, sizeof(float));
	memcpy(y, vbos[i].data + at + sizeof(float), sizeof(float));
	*x = *x < 0 ? 0 : *x > W_PX ? W_PX : *x;
	*y = *y < 0 ? 0 : *y > H_PX ? H_PX : *y;
	return true;
}

static void area_of_draw(GLenum m, GLint first, GLsizei n)
{
	if (m != GL_TRIANGLES && m != GL_TRIANGLE_STRIP) {
		c.draws_unmeasured++;
		return;
	}
	double a = 0;
	const GLsizei step = m == GL_TRIANGLES ? 3 : 1;
	for (GLsizei k = 0; k + 2 < n; k += step) {
		float x0, y0, x1, y1, x2, y2;
		if (!vertex(first + k, &x0, &y0) || !vertex(first + k + 1, &x1, &y1) ||
		    !vertex(first + k + 2, &x2, &y2)) {
			c.draws_unmeasured++;
			return;
		}
		const double cr = ((double)x1 - x0) * ((double)y2 - y0) - ((double)x2 - x0) * ((double)y1 - y0);
		a += (cr < 0 ? -cr : cr) / 2;
	}
	if (colour_on)
		c.area_colour += a;
	else
		c.area_stencil += a;
}

static uint64_t bound_content(unsigned u)
{
	if (bound[u] == 0)
		return 0;
	if (!texs || bound[u] >= MAX_TEX_ID) {
		content_error = 1;
		return 0;
	}
	return texs[bound[u]].content | 1u; /* never 0, which is "nothing bound" */
}
static void sign_draw(GLenum m, GLsizei n)
{
	for (unsigned u = 0; u < 2; u++)
		if (texs && bound[u] && bound[u] < MAX_TEX_ID)
			texs[bound[u]].last_drawn = replay_frame;
	signature = fnv_u64(signature, ((uint64_t)m << 32) | (uint32_t)n);
	signature = fnv_u64(signature, bound_content(0));
	signature = fnv_u64(signature, bound_content(1));
}
static void GL_APIENTRY s_TexParameteri(GLenum t, GLenum pname, GLint v)
{
	(void)t;
	struct tex_state *ts = bound_tex();
	if (!ts)
		return;
	if (pname == GL_TEXTURE_MIN_FILTER)
		ts->min = (GLenum)v;
	else if (pname == GL_TEXTURE_MAG_FILTER)
		ts->mag = (GLenum)v;
}

static const char *const sel_name[] = { "FillGradient", "FillImage", "Stencil", "FillImageGradient", "FilterImage",
					"FillColor", "TextureCopyUnclipped", "?7", "FillGradientConic",
					"FillImageGradientConic" };
static const char *glname(GLenum e)
{
	switch (e) {
	case GL_ZERO: return "0";
	case GL_ONE: return "1";
	case GL_SRC_ALPHA: return "SA";
	case GL_ONE_MINUS_SRC_ALPHA: return "1-SA";
	case GL_DST_ALPHA: return "DA";
	case GL_ONE_MINUS_DST_ALPHA: return "1-DA";
	case GL_ALWAYS: return "ALWAYS";
	case GL_EQUAL: return "EQUAL";
	case GL_NOTEQUAL: return "NOTEQUAL";
	case GL_KEEP: return "KEEP";
	case GL_INCR: return "INCR";
	case GL_DECR: return "DECR";
	case GL_INCR_WRAP: return "INCR_WRAP";
	case GL_DECR_WRAP: return "DECR_WRAP";
	case GL_NEAREST: return "NEAREST";
	case GL_LINEAR: return "LINEAR";
	case GL_LINEAR_MIPMAP_LINEAR: return "LINEAR_MIPMAP_LINEAR";
	case GL_RGBA: return "RGBA";
	case GL_ALPHA: return "ALPHA";
	case GL_LUMINANCE: return "LUMINANCE";
	case GL_TRIANGLES: return "TRIANGLES";
	case GL_TRIANGLE_STRIP: return "STRIP";
	default: return "?";
	}
}

/* Pixels a draw covers more than once, rasterised at pixel centres with the
 * top-left rule (as GL does), in a hit map over the window: a stencil stroke
 * (3 passes) and a single-pass stroke differ only on such pixels, since the
 * stencil's only job is to blend each pixel once. */
static uint8_t *hitmap;

static bool edge_in(double w, double ax, double ay)
{
	/* top-left rule: an edge is "top" (horizontal, pointing left in y-down
	 * screen space with CCW orientation normalised below) or "left" */
	if (w > 0)
		return true;
	if (w < 0)
		return false;
	return (ay == 0 && ax < 0) || ay > 0;
}

static unsigned overlap_of_draw(GLenum m, GLint first, GLsizei n, unsigned *covered)
{
	if (!hitmap && !(hitmap = calloc((size_t)W * H, 1)))
		return 0;
	memset(hitmap, 0, (size_t)W * H);
	unsigned twice = 0, once = 0;
	const GLsizei step = m == GL_TRIANGLES ? 3 : 1;
	for (GLsizei k = 0; k + 2 < n; k += step) {
		float x[3], y[3];
		bool ok = true;
		for (int v = 0; v < 3; v++)
			ok &= vertex(first + k + v, &x[v], &y[v]);
		if (!ok)
			continue;
		double area = ((double)x[1] - x[0]) * ((double)y[2] - y[0]) - ((double)x[2] - x[0]) * ((double)y[1] - y[0]);
		if (area == 0)
			continue;
		if (area < 0) { /* orient one way so the rule is consistent */
			float tx = x[1], ty = y[1];
			x[1] = x[2], y[1] = y[2], x[2] = tx, y[2] = ty;
		}
		int x0 = (int)floorf(fminf(x[0], fminf(x[1], x[2]))), x1 = (int)ceilf(fmaxf(x[0], fmaxf(x[1], x[2])));
		int y0 = (int)floorf(fminf(y[0], fminf(y[1], y[2]))), y1 = (int)ceilf(fmaxf(y[0], fmaxf(y[1], y[2])));
		x0 = x0 < 0 ? 0 : x0, y0 = y0 < 0 ? 0 : y0, x1 = x1 > W ? W : x1, y1 = y1 > H ? H : y1;
		for (int py = y0; py < y1; py++)
			for (int px = x0; px < x1; px++) {
				const double cx = px + 0.5, cy = py + 0.5;
				bool in = true;
				for (int e = 0; e < 3 && in; e++) {
					const int a = e, b = (e + 1) % 3;
					const double ex = (double)x[b] - x[a], ey = (double)y[b] - y[a];
					const double w = ex * (cy - y[a]) - ey * (cx - x[a]);
					in = edge_in(w, ex, ey);
				}
				if (!in)
					continue;
				uint8_t *h = &hitmap[(size_t)py * W + px];
				if (*h == 1)
					twice++;
				if (*h == 0)
					once++;
				if (*h < 255)
					(*h)++;
			}
	}
	*covered = once;
	return twice;
}

/* GLCOUNT_TRACE=<frame>: one line per draw of that demo frame */
static bool tracing;
static unsigned trace_frame; /* GLCOUNT_TRACE: the demo frame (1-based), 0 none */
static unsigned trace_draw;

static void trace(GLenum m, GLint first, GLsizei n)
{
	float x0 = W_PX, y0 = H_PX, x1 = 0, y1 = 0, x, y;
	for (GLsizei k = 0; k < n; k++)
		if (vertex(first + k, &x, &y)) {
			x0 = x < x0 ? x : x0, y0 = y < y0 ? y : y0;
			x1 = x > x1 ? x : x1, y1 = y > y1 ? y : y1;
		}
	const double a0 = c.area_colour + c.area_stencil;
	area_of_draw(m, first, n);
	const double a = c.area_colour + c.area_stencil - a0;
	c.area_colour -= colour_on ? a : 0; /* area_of_draw is also called by the draw; count once */
	c.area_stencil -= colour_on ? 0 : a;
	unsigned pi = 0;
	while (pi < nprogs && progs[pi].id != cur_prog)
		pi++;
	const struct tex_state *t0 = texs && bound[0] && bound[0] < MAX_TEX_ID ? &texs[bound[0]] : NULL;
	printf("glcount: trace draw %3u: %s %s%s%s%s %s %d verts, bbox %.0f,%.0f-%.0f,%.0f, %.0f px; colour %s; "
	       "blend %s", trace_draw++,
	       pi < nprogs && progs[pi].sel >= 0 && progs[pi].sel <= 9 ? sel_name[progs[pi].sel] : "?",
	       pi < nprogs && progs[pi].glyph ? "glyph " : "", pi < nprogs && progs[pi].nodiscard ? "nodiscard " : "",
	       pi < nprogs && progs[pi].aa ? "aa" : "", "", glname(m), (int)n, x0, y0, x1, y1, a,
	       colour_on ? "on" : "off", blend_on ? "on" : "off");
	if (blend_on)
		printf(" (%s,%s / %s,%s)", glname(blend_f[0]), glname(blend_f[1]), glname(blend_f[2]), glname(blend_f[3]));
	printf("; stencil %s", stencil_on ? "on" : "off");
	if (stencil_on)
		printf(" (%s ref %d mask 0x%x, ops %s,%s,%s)", glname(stencil_func), stencil_ref, stencil_fmask,
		       glname(stencil_ops[0]), glname(stencil_ops[1]), glname(stencil_ops[2]));
	printf("; scissor %s", scissor_on ? "on" : "off");
	if (t0 && t0->w)
		printf("; tex0 %ux%u %s min %s mag %s, border alpha max %d", t0->w, t0->h, glname(t0->fmt),
		       glname(t0->min), glname(t0->mag), t0->border_alpha);
	else
		printf("; tex0 none");
	if (pi < nprogs && progs[pi].frag_set) {
		const float *f = progs[pi].frag;
		printf("; texType %d, innerCol %.2f,%.2f,%.2f,%.2f, strokeThr %.2f, scissorRadius %.1f, "
		       "scissorExt %.0f,%.0f",
		       (int)f[42], f[24], f[25], f[26], f[27], f[41], f[51], f[32], f[33]);
	}
	if (colour_on) {
		unsigned covered = 0, twice = overlap_of_draw(m, first, n, &covered);
		printf("; pixels covered %u, of them more than once %u", covered, twice);
	}
	printf("\n");
}

static void GL_APIENTRY s_BindFramebuffer(GLenum t, GLuint fb)
{
	(void)t;
	if (tracing)
		printf("glcount: trace glBindFramebuffer %u (%s) before draw %u\n", fb, fb ? "render to texture" : "window",
		       trace_draw);
}

static void GL_APIENTRY s_DrawArrays(GLenum m, GLint f, GLsizei n)
{
	if (tracing)
		trace(m, f, n);
	area_of_draw(m, f, n);
	sign_draw(m, n);
	c.draws++;
}
static void GL_APIENTRY s_DrawElements(GLenum m, GLsizei n, GLenum t, const void *i)
{
	(void)t, (void)i;
	c.draws_unmeasured++; /* indexed: FemtoVG does not use it; counted if anything does */
	sign_draw(m, n);
	c.draws++;
}
static void GL_APIENTRY s_ActiveTexture(GLenum unit)
{
	cur_unit = unit - GL_TEXTURE0;
	content_error |= cur_unit >= 8;
}
static void GL_APIENTRY s_BindTexture(GLenum t, GLuint id)
{
	(void)t;
	if (cur_unit < 8)
		bound[cur_unit] = id;
}

static const struct {
	const char *name;
	const void *fn;
} special[] = {
	{ "glGetString", (const void *)s_GetString },
	{ "glGenTextures", (const void *)s_GenTextures },
	{ "glGenBuffers", (const void *)s_GenBuffers },
	{ "glGenFramebuffers", (const void *)s_GenFramebuffers },
	{ "glGenRenderbuffers", (const void *)s_GenRenderbuffers },
	{ "glGenVertexArrays", (const void *)s_GenVertexArrays },
	{ "glGenVertexArraysOES", (const void *)s_GenVertexArrays },
	{ "glCreateShader", (const void *)s_CreateShader },
	{ "glCreateProgram", (const void *)s_CreateProgram },
	{ "glGetShaderiv", (const void *)s_GetShaderiv },
	{ "glGetProgramiv", (const void *)s_GetProgramiv },
	{ "glGetShaderInfoLog", (const void *)s_GetShaderInfoLog },
	{ "glGetProgramInfoLog", (const void *)s_GetShaderInfoLog },
	{ "glGetIntegerv", (const void *)s_GetIntegerv },
	{ "glGetUniformLocation", (const void *)s_GetUniformLocation },
	{ "glGetAttribLocation", (const void *)s_GetAttribLocation },
	{ "glCheckFramebufferStatus", (const void *)s_CheckFramebufferStatus },
	{ "glTexImage2D", (const void *)s_TexImage2D },
	{ "glTexSubImage2D", (const void *)s_TexSubImage2D },
	{ "glDeleteTextures", (const void *)s_DeleteTextures },
	{ "glDrawArrays", (const void *)s_DrawArrays },
	{ "glDrawElements", (const void *)s_DrawElements },
	{ "glBindBuffer", (const void *)s_BindBuffer },
	{ "glBufferData", (const void *)s_BufferData },
	{ "glVertexAttribPointer", (const void *)s_VertexAttribPointer },
	{ "glColorMask", (const void *)s_ColorMask },
	{ "glShaderSource", (const void *)s_ShaderSource },
	{ "glAttachShader", (const void *)s_AttachShader },
	{ "glUseProgram", (const void *)s_UseProgram },
	{ "glUniform4fv", (const void *)s_Uniform4fv },
	{ "glEnable", (const void *)s_Enable },
	{ "glDisable", (const void *)s_Disable },
	{ "glBlendFunc", (const void *)s_BlendFunc },
	{ "glBlendFuncSeparate", (const void *)s_BlendFuncSeparate },
	{ "glStencilFunc", (const void *)s_StencilFunc },
	{ "glStencilOp", (const void *)s_StencilOp },
	{ "glStencilOpSeparate", (const void *)s_StencilOpSeparate },
	{ "glTexParameteri", (const void *)s_TexParameteri },
	{ "glBindFramebuffer", (const void *)s_BindFramebuffer },
	{ "glActiveTexture", (const void *)s_ActiveTexture },
	{ "glBindTexture", (const void *)s_BindTexture },
};

static const char *const yakogl_names[] = {
#include "gl_names.h"
};

static const void *get_proc(const char *name)
{
	for (size_t i = 0; i < sizeof(special) / sizeof(special[0]); i++)
		if (strcmp(name, special[i].name) == 0)
			return special[i].fn;
	for (size_t i = 0; i < sizeof(yakogl_names) / sizeof(yakogl_names[0]); i++)
		if (strcmp(name, yakogl_names[i]) == 0)
			return (const void *)gl_noop;
	return NULL; /* not in YakoGL's table: it answers NULL too */
}

/* ---- the run ---------------------------------------------------------------- */

#define TIMEOUT_S 120
#define DEMO_TIMEOUT_S 1800 /* a 180 s replay is about 2,860 frames */

/* The library's panic handler prints its line and spins (on the board the
 * watchdog ends it): a run that stops answering fails instead of hanging. */
static void timed_out(int sig)
{
	(void)sig;
	static const char msg[] = "glcount: FAIL: no answer in time (a Rust panic spins: its line is above)\n";
	(void)!write(1, msg, sizeof(msg) - 1);
	_exit(1);
}

static unsigned env_u(const char *name, unsigned dflt)
{
	const char *v = getenv(name);
	return v && *v ? (unsigned)strtoul(v, NULL, 10) : dflt;
}

/* The demo's sequence (main.c step 2, then its demo loop); see the header. */
static int demo_replay(unsigned demo_s, unsigned step_ms, unsigned report_s)
{
	static const uint64_t clock_at[3] = { 0, 1000, 3000 }; /* main.c FRAME2_MS, FRAME3_MS */
	/* the overlap counter's controls: one triangle drawn twice covers every
	 * pixel twice; two triangles sharing an edge cover none twice. FemtoVG
	 * rebinds its buffer and attribute 0 before every frame it renders. */
	{
		static const float tri2[] = { 10, 10, 110, 10, 10, 110, 10, 10, 110, 10, 10, 110 };
		static const float quad[] = { 10, 10, 110, 10, 10, 110, 110, 10, 110, 110, 10, 110 };
		unsigned cov = 0, tw;
		s_BindBuffer(GL_ARRAY_BUFFER, 0xfff0);
		s_VertexAttribPointer(0, 2, GL_FLOAT, GL_FALSE, 8, NULL);
		s_BufferData(GL_ARRAY_BUFFER, sizeof(tri2), tri2, GL_STATIC_DRAW);
		tw = overlap_of_draw(GL_TRIANGLES, 0, 6, &cov);
		const bool c1 = cov > 4900 && tw == cov;
		printf("glcount: overlap control 1 (a triangle twice): covered %u, twice %u: %s\n", cov, tw,
		       c1 ? "ok" : "WRONG");
		s_BufferData(GL_ARRAY_BUFFER, sizeof(quad), quad, GL_STATIC_DRAW);
		tw = overlap_of_draw(GL_TRIANGLES, 0, 6, &cov);
		const bool c2 = cov == 10000 && tw == 0;
		printf("glcount: overlap control 2 (a quad as two triangles): covered %u, twice %u: %s\n", cov, tw,
		       c2 ? "ok" : "WRONG");
		if (!c1 || !c2) {
			printf("glcount: FAIL: the overlap counter failed its controls\n");
			return 1;
		}
		s_BindBuffer(GL_ARRAY_BUFFER, 0);
	}
	drop_refill = env_u("GLCOUNT_DROP_REFILL", 0);
	trace_frame = env_u("GLCOUNT_TRACE", 0);
	texs = calloc(MAX_TEX_ID, sizeof(texs[0]));
	if (!texs) {
		printf("glcount: FAIL: no memory for the texture contents\n");
		return 1;
	}
	for (unsigned f = 0; f < 3; f++) {
		if (f == 1)
			slint_cluster_advance(400); /* main.c FRAME_TICKS */
		ui_clock_ms = clock_at[f];
		memset(&c, 0, sizeof(c));
		int rc = slint_cluster_draw_frame(get_proc, W, H);
		printf("glcount: check frame %u (clock %llu ms): rc %d, new textures %u, uploads %u\n", f + 1,
		       (unsigned long long)ui_clock_ms, rc, c.tex_images, c.tex_images_data + c.tex_subs);
		if (rc != 0)
			return 1;
	}
	uint64_t ticks_done = 0, frames = 0, uploads = 0, textures = 0, gradients = 0, total_frames = 0;
	double px_colour = 0, px_stencil = 0;
	uint64_t rb_t = 0, rb_o = 0, rf_t = 0, rf_o = 0;
	uint64_t unmeasured = 0, draws = 0;
	uint64_t next_report = (uint64_t)report_s * 1000u;
	for (uint64_t t = 0; t < (uint64_t)demo_s * 1000u; t += step_ms) {
		const uint64_t due = t / 50u; /* main.c DEMO_TICK_MS */
		if (due > ticks_done) {
			slint_cluster_advance((uint32_t)(due - ticks_done));
			ticks_done = due;
		}
		ui_clock_ms = 3000u + t;
		memset(&c, 0, sizeof(c));
		tracing = trace_frame && frames + total_frames + 1 == trace_frame;
		replay_frame = (uint32_t)(frames + total_frames + 1);
		trace_draw = 0;
		int rc = slint_cluster_draw_frame(get_proc, W, H);
		if (rc != 0) {
			printf("glcount: FAIL: slint_cluster_draw_frame returned %d at t=%llu ms\n", rc,
			       (unsigned long long)t);
			return 1;
		}
		frames++;
		uploads += c.tex_images_data + c.tex_subs;
		textures += c.tex_images;
		gradients += c.gradients_new;
		rb_t += c.refill_busy_table, rb_o += c.refill_busy_other;
		rf_t += c.refill_free_table, rf_o += c.refill_free_other;
		px_colour += c.area_colour;
		px_stencil += c.area_stencil;
		unmeasured += c.draws_unmeasured;
		draws += c.draws;
		if (t + step_ms >= next_report) {
			printf("glcount: demo t=%llus: rasterised per frame (triangle area, clamped to the window; "
			       "scissor and stencil test not modelled): colour %.3f Mpx (%.2f windows), stencil-only "
			       "%.3f Mpx; draws %.1f, of them unmeasured %llu in the interval\n",
			       (unsigned long long)(next_report / 1000u), px_colour / frames / 1e6,
			       px_colour / frames / ((double)W_PX * H_PX), px_stencil / frames / 1e6,
			       (double)draws / frames, (unsigned long long)unmeasured);
			printf("glcount: demo t=%llus: whole-texture refills per frame of a texture sampled by the "
			       "previous frame (in flight with one frame pipelined): tables %.2f, others %.2f; of an "
			       "older one: tables %.2f, others %.2f\n",
			       (unsigned long long)(next_report / 1000u), (double)rb_t / frames, (double)rb_o / frames,
			       (double)rf_t / frames, (double)rf_o / frames);
			rb_t = rb_o = rf_t = rf_o = 0;
			px_colour = px_stencil = 0;
			unmeasured = draws = 0;
			printf("glcount: demo t=%llus: frames %llu; uploads %llu.%02llu, new textures %llu.%02llu "
			       "(of them 256x1 gradient tables %llu.%02llu) per frame; speed x10 %d; draw-texture "
			       "signature %016llx\n",
			       (unsigned long long)(next_report / 1000u), (unsigned long long)frames,
			       (unsigned long long)(uploads / frames), (unsigned long long)(uploads * 100u / frames % 100u),
			       (unsigned long long)(textures / frames),
			       (unsigned long long)(textures * 100u / frames % 100u),
			       (unsigned long long)(gradients / frames),
			       (unsigned long long)(gradients * 100u / frames % 100u), slint_cluster_speed_x10(),
			       (unsigned long long)signature);
			total_frames += frames;
			frames = uploads = textures = gradients = 0;
			next_report += (uint64_t)report_s * 1000u;
		}
	}
	printf("glcount: demo replay done: %llu frames in %u s of Slint time, %u ms apart\n",
	       (unsigned long long)total_frames, demo_s, step_ms);
	if (slint_cluster_gradient_pool) {
		uint32_t gc = 0, gr = 0, ghw = 0, gref = 0, gmax = 0;
		slint_cluster_gradient_pool(&gc, &gr, &ghw, &gref, &gmax);
		printf("glcount: gradient tables since start: created %u, reused %u, refused %u (pool of %u, "
		       "high-water %u)\n",
		       gc, gr, gref, gmax, ghw);
	} else {
		printf("glcount: gradient tables: no pool in this library\n");
	}
	if (total_frames == 0) {
		printf("glcount: FAIL: the replay drew no frame\n");
		return 1;
	}
	if (content_error) {
		printf("glcount: FAIL: a texture the stub could not follow (an id past %u, a unit past 7 or an "
		       "unknown format): the signature says nothing\n",
		       MAX_TEX_ID);
		return 1;
	}
	if (drop_refill && gradient_refills < drop_refill) {
		printf("glcount: FAIL: GLCOUNT_DROP_REFILL=%u, but only %u gradient refills happened: the control "
		       "did not run\n",
		       drop_refill, gradient_refills);
		return 1;
	}
	printf("glcount: draw-texture signature %016llx (compare it between libraries)%s; %u gradient refills\n",
	       (unsigned long long)signature, drop_refill ? " [control: one refill dropped]" : "", gradient_refills);
	return 0;
}

int main(void)
{
	const unsigned frames = getenv("GLCOUNT_FRAMES") ? (unsigned)atoi(getenv("GLCOUNT_FRAMES")) : 20;
	const unsigned warmup = 2; /* the first small-step frame may still size things */
	unsigned created_after_warmup = 0, gradients_after_warmup = 0, refilled = 0, speed_changes = 0;
	unsigned steady = 0, last_draws = 0, gradients_total = 0;
	int last_speed = -1;

	setvbuf(stdout, NULL, _IOLBF, 0); /* each line out before a possible hang */
	signal(SIGALRM, timed_out);
	if (env_u("GLCOUNT_STRESS", 0)) {
		/* STRESS1's steps (main.c stress_steps): each arm's 5th frame, what
		 * it asks of GL; the arms' units must show in the draws and uploads */
		static const uint32_t steps[][2] = { { 0, 50 }, { 0, 200 }, { 0, 500 }, { 0, 1000 }, { 1, 1 },
						     { 1, 2 },  { 1, 4 },   { 1, 6 },   { 1, 8 },    { 2, 200 },
						     { 2, 1000 }, { 2, 3000 }, { 3, 1 }, { 3, 2 } };
		texs = calloc(MAX_TEX_ID, sizeof(texs[0]));
		if (!texs)
			return 1;
		for (unsigned i = 0; i < sizeof(steps) / sizeof(steps[0]); i++)
			for (unsigned f = 0, nf = env_u("GLCOUNT_STRESS_FRAMES", 5); f < nf; f++) {
				memset(&c, 0, sizeof(c));
				const int rc = slint_cluster_stress_frame(get_proc, W, H, steps[i][0], steps[i][1]);
				if (rc != 0) {
					printf("glcount: FAIL: stress arm %u N=%u frame %u returned %d\n", steps[i][0],
					       steps[i][1], f + 1, rc);
					return 1;
				}
				if (f == nf - 1)
					printf("glcount: stress arm %u N=%u, frame %u: draws %u, colour %.3f Mpx, uploads %u, "
					       "new textures %u; Rust heap in use %zu bytes\n",
					       steps[i][0], steps[i][1], nf, c.draws, c.area_colour / 1e6,
					       c.tex_images_data + c.tex_subs, c.tex_images, heap_in_use);
			}
		printf("glcount: PASS\n");
		return 0;
	}
	const unsigned demo_s = env_u("GLCOUNT_DEMO_S", 0);
	if (demo_s) {
		const unsigned step_ms = env_u("GLCOUNT_STEP_MS", 63), report_s = env_u("GLCOUNT_REPORT_S", 10);
		if (step_ms == 0 || report_s == 0) {
			printf("glcount: FAIL: GLCOUNT_STEP_MS and GLCOUNT_REPORT_S must be above 0\n");
			return 1;
		}
		alarm(DEMO_TIMEOUT_S);
		return demo_replay(demo_s, step_ms, report_s);
	}
	alarm(TIMEOUT_S);

	for (unsigned f = 0; f < 2 + frames; f++) {
		if (f == 1) {
			slint_cluster_advance(400);
			ui_clock_ms = 1000;
		} else if (f >= 2) {
			slint_cluster_advance(4);
			ui_clock_ms += 200;
		}
		memset(&c, 0, sizeof(c));
		int rc = slint_cluster_draw_frame(get_proc, W, H);
		int speed = slint_cluster_speed_x10() / 10;
		printf("glcount: frame %u (clock %llu ms): rc %d, speed %d km/h, draws %u, new textures %u (%u "
		       "gradient tables, %u with data), refills %u (%u not gradient tables, %llu B), textures "
		       "deleted %u; created: %s\n",
		       f + 1, (unsigned long long)ui_clock_ms, rc, speed, c.draws, c.tex_images, c.gradients_new,
		       c.tex_images_data, c.tex_subs, c.other_subs, (unsigned long long)c.sub_bytes, c.tex_deletes,
		       c.tex_images ? c.sizes : "none");
		if (rc != 0) {
			printf("glcount: FAIL: slint_cluster_draw_frame returned %d\n", rc);
			return 1;
		}
		gradients_total += c.gradients_new;
		if (f >= 2 + warmup) {
			speed_changes += speed != last_speed;
			if (c.draws != last_draws) {
				printf("glcount: frame %u left out: %u draws after %u (the items on screen changed)\n",
				       f + 1, c.draws, last_draws);
			} else {
				steady++;
				created_after_warmup += c.other_new;
				gradients_after_warmup += c.gradients_new;
				refilled += c.other_subs;
			}
		}
		last_speed = speed;
		last_draws = c.draws;
	}
	printf("glcount: after the warm-up: %u steady frames of %u, %u textures created in them (not gradient "
	       "tables), %u refills (not gradient tables), %u gradient tables created; the speed text changed %u "
	       "times\n",
	       steady, frames - warmup, created_after_warmup, refilled, gradients_after_warmup, speed_changes);
	uint32_t gc = 0, gr = 0, ghw = 0, gref = 0, gmax = 0;
	if (!slint_cluster_gradient_pool) {
		printf("glcount: FAIL: the library has no gradient-table pool (slint_cluster_gradient_pool absent)\n");
		return 1;
	}
	slint_cluster_gradient_pool(&gc, &gr, &ghw, &gref, &gmax);
	printf("glcount: FemtoVG's gradient tables: created %u, reused %u, refused %u (pool of %u, high-water %u); "
	       "the stub saw %u 256x1 textures created\n",
	       gc, gr, gref, gmax, ghw, gradients_total);
	if (gc != gradients_total) {
		printf("glcount: FAIL: the pool's count and the stub's disagree (%u, %u)\n", gc, gradients_total);
		return 1;
	}
	if (steady < (frames - warmup) / 2) {
		printf("glcount: FAIL: fewer than half the frames were steady; the verdict would rest on too few\n");
		return 1;
	}
	if (speed_changes == 0 || refilled == 0) {
		printf("glcount: FAIL: nothing measured (the speed text never changed or no texture was refilled)\n");
		return 1;
	}
	if (created_after_warmup != 0 || gradients_after_warmup != 0) {
		printf("glcount: FAIL: steady frames created %u textures and %u gradient tables\n", created_after_warmup,
		       gradients_after_warmup);
		return 1;
	}
	printf("glcount: PASS\n");
	return 0;
}
