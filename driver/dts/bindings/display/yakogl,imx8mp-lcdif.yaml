## driver/dts/bindings/display/yakogl,imx8mp-lcdif.yaml
```yaml
# SPDX-License-Identifier: Apache-2.0
# SPDX-FileCopyrightText: 2026 Signal Slot, Inc.

description: |
  An i.MX 8M Plus LCDIFv3 (LCDIF1 0x32e80000, LCDIF2 0x32e90000, LCDIF3
  0x32fc6000: one IP) as a Zephyr display device, register logic in Rust
  (driver/rust/src/ip/lcdifv3.rs, written from IMX8MPRM Rev. 3 13.3):
  driver/drivers/display/display_yakogl_imx8mp_lcdif.c. One linear XRGB8888
  layer; Zephyr's display write() of a whole frame flips to that buffer by
  address (no copy), blanking on/off stops and restarts the scan-out, the
  vertical-blanking interrupt gives a semaphore.

  Two uses:
   - Driven by a chain owner (yakogl,imx8mp-display names it in `lcdif`):
     the owner configures and enables it in the chain's order; this node only
     states the LCDIF's own facts (output polarity, panic thresholds).
   - adopt-only: a layer the previous kernel left scanning is taken over
     (re-pointed at our buffers, given back on blanking) and never
     configured; the node then also provides the imx8mp_display_* API when
     no yakogl,imx8mp-display node is enabled. The old
     yakogl,imx8mp-lcdif-adopt nodes are served the same way.

  The LCDIF registers sit inside a power domain (MEDIAMIX, HDMIMIX) this
  device does not own: its init maps them and reads nothing.

  Design and board plan: driver/docs/imx8mp-display-cold.md.

compatible: "yakogl,imx8mp-lcdif"

include: base.yaml

properties:
  reg:
    required: true

  interrupts:
    description: |
      The LCDIF interrupt (LCDIF1: SPI 5, IMX8MPRM Table 7-1). Without it
      flips still wait for the shadow load by polling; only
      yakogl_imx8mp_lcdif_wait_vblank() needs it. LCDIF3's interrupt goes
      through the HDMI block's steering and is not supported here.

  hactive:
    type: int
    required: true
    description: |
      The layer's width: what an adopt-only node expects to find running (and
      reports as geometry before it has adopted), and the display API's
      resolution.

  vactive:
    type: int
    required: true

  adopt-only:
    type: boolean
    description: |
      Never configure the controller: adopt what runs, or fail with -ENODEV.

  pixclk-rising:
    type: boolean
    description: |
      CTRL[INV_PXCK] = 1: the consumer samples data on the rising edge
      (13.3.3.1.2.4). The Verdin's DSIM needs it (the board's Linux has CTRL
      = 0x08; with the bit clear the PLLs lock and no picture comes).

  hsync-active-low:
    type: boolean
  vsync-active-low:
    type: boolean
  de-active-low:
    type: boolean

  desc3-extra:
    type: int
    default: 0
    description: |
      Bits OR-ed into CTRLDESCL0_3 above PITCH, which IMX8MPRM 13.3.3.1.13.4
      marks reserved (risk R1). 0, as NXP's SDK driver writes, unless a
      board run shows underruns; the replaced C driver wrote 0x220000.

  panic-thresholds:
    type: array
    description: |
      PANIC0_THRES low and high, in 128-bit units of the 512-entry input
      FIFO (13.3.3.1.24); with them the panic-driven NoC priority boost is
      enabled (INT_ENABLE_D1). NXP's SDK suggests 1/3 and 2/3: <170 340>.

  dsi-host:
    type: phandle
    description: |
      The yakogl,samsung-dsim this LCDIF feeds. blanking_off() releases its
      data lanes after the layer is on (risk R5: Zephyr's MIPI-DSI API has no
      "start video" step; see the design note).
```

## driver/dts/bindings/display/yakogl,sn65dsi8x.yaml
```yaml
# SPDX-License-Identifier: Apache-2.0
# SPDX-FileCopyrightText: 2026 Signal Slot, Inc.

description: |
  TI SN65DSI83 / SN65DSI84 MIPI DSI to LVDS bridge on I2C, one DSI input and
  one LVDS link (channel A) in use. The register logic is
  driver/rust/src/ip/sn65dsi8x.rs (from TI SLLSEC2H / SLLSEC1I); the device
  shim is driver/drivers/display/bridge_sn65dsi8x.c, its API
  include/yakogl_drv/sn65dsi8x.h.

  With a dsi-host and a mode (pixel-clock-hz and the timings) the device
  starts itself at init: it attaches the DSI host, brings the bridge up and
  checks the link. Without a dsi-host it touches nothing until the display
  controller that owns the chain calls it (sn65dsi8x_claim_enable / _start /
  _check_link / _stop), with the mode and the DSI lane rate it runs.

  Everything here is a fact of the board, the adapter or the panel; what the
  bridge needs to know about the DSI side (its clock) comes from the host.

compatible: "yakogl,sn65dsi8x"

include: [i2c-device.yaml]

properties:
  enable-gpios:
    type: phandle-array
    description: The bridge's EN pin (active high at the pin).

  reset-gpios:
    type: phandle-array
    description: |
      The display adapter's own reset, where it has one (the Verdin AM62P
      DSI-LVDS adapter's global reset). Held asserted at init by a
      self-starting node and released before EN rises.

  backlight-gpios:
    type: phandle-array
    description: |
      A backlight enable line a self-starting node drives high once the link
      is up (the panel's, not the bridge's; carried here because this node
      is the panel's only device on the AM62P).

  data-lanes:
    type: int
    default: 4
    enum: [1, 2, 3, 4]
    description: DSI data lanes wired (CHA_DSI_LANES).

  lvds-24bpp:
    type: boolean
    description: Drive the fourth LVDS data lane (CHA_24BPP_MODE); 18 bpp without it.

  lvds-jeida:
    type: boolean
    description: |
      24 bpp format 1, the two LSB per colour on Y3 (CHA_24BPP_FORMAT1,
      "JEIDA"); without it format 2, the two MSB on Y3 ("SPWG/VESA").

  lvds-termination-ohms:
    type: int
    default: 200
    enum: [100, 200]
    description: |
      Near-end differential termination of LVDS channel A (CHA_LVDS_TERM).
      200 is the part's reset value and what the i.MX8MP board runs; the
      AM62P adapter's driver has always set 100.

  hsync-active-low:
    type: boolean
    description: |
      Drive HS negative on the LVDS side (HS_NEG_POLARITY). This is the
      board's choice of what the panel gets, not necessarily the panel's
      stated timing: on the i.MX8MP board Linux runs the bridge with HS/VS
      positive into a DE-driven panel whose timing says active low.

  vsync-active-low:
    type: boolean
    description: VS_NEG_POLARITY, as hsync-active-low.

  de-active-low:
    type: boolean
    description: DE_NEG_POLARITY (driven 0 during active pixels).

  dsi-host:
    type: phandle
    description: |
      The MIPI DSI host to attach at init. Present: the node starts itself
      (and needs the mode below). Absent: a display controller drives it.

  video-source:
    type: phandle
    description: |
      A self-starting node only: the display device that feeds the DSI
      host. The self-start turns its blanking off (Zephyr display API)
      between bringing the bridge up and checking the link, init seq 8 of
      SLLSEC2H Table 7-2, so the panel receives a valid stream from boot
      instead of from the application's first frame. Absent: whoever owns
      the display starts the stream.

  pixel-clock-hz:
    type: int
  width:
    type: int
  height:
    type: int
  hfront-porch:
    type: int
  hback-porch:
    type: int
  hsync-len:
    type: int
  vfront-porch:
    type: int
  vback-porch:
    type: int
  vsync-len:
    type: int
```

## driver/dts/bindings/display/yakogl,stm32-ltdc.yaml
```yaml
# SPDX-License-Identifier: Apache-2.0
# SPDX-FileCopyrightText: 2026 Signal Slot, Inc.

description: |
  The STM32MP25 LTDC (LCD-TFT display controller, display-controller@48010000
  in ST's stm32mp251.dtsi:2150, mainline stm32mp251.dtsi:1617) as a Zephyr
  display device on the STM32MP257F-DK's A35. Register logic in Rust
  (driver/rust/src/ip/stm32_ltdc.rs, from RM0457's LTDC chapter and Linux's
  drivers/gpu/drm/stm/ltdc.c). One linear layer scans out a caller-provided
  frame buffer; its output feeds the DSI host named in `dsi-host`
  (stm32mp257f-dk.dts:536-547: the LTDC's output endpoint goes to the DSI).

  The LTDC's clocks, reset and RIF (RIFSC) security settings are the chain
  owner's (docs/notes/pre-study-stm32mp257f-dk.md :630, :645: the two LTDC
  secure-layer areas at 0xfe800000 are carveouts); this device's init maps
  the registers only.

  Property names follow Linux's Documentation/devicetree/bindings/display/
  st,stm32-ltdc.yaml where it has one (reg, interrupts).

compatible: "yakogl,stm32-ltdc"

include: base.yaml

properties:
  reg:
    required: true
    description: |
      The LTDC registers, 0x48010000 on the DK (ST stm32mp251.dtsi:2150).

  interrupts:
    description: |
      The LTDC interrupts (st,stm32-ltdc.yaml: line 0 the LTDC, line 1 the
      error one). Without them flips wait for the shadow reload by polling.

  hactive:
    type: int
    required: true
    description: Width in pixels of the active area (the layer's width).

  vactive:
    type: int
    required: true
    description: Height in lines of the active area.

  pixel-format:
    type: string
    default: "argb8888"
    enum: ["argb8888", "rgb888", "rgb565"]
    description: |
      The layer's pixel format (LxPFCR PF, RM0457 LTDC; Linux ltdc.c's
      format table). The shim maps it to Zephyr's PIXEL_FORMAT_*.

  pitch-bytes:
    type: int
    description: |
      Bytes per line of the frame buffer (LxCFBLR CFBP). Absent: hactive times
      the format's bytes per pixel. The LTDC's alignment limits are in
      docs/notes/stm32mp257f-dk-display-bringup.md (Q7).

  fb-size:
    type: int
    description: |
      Bytes of the frame buffer the shim may scan out (pitch-bytes x vactive
      at least). Absent: that product.

  hsync-active-low:
    type: boolean
    description: "GCR HSPOL (Linux ltdc.c: DRM_MODE_FLAG_NHSYNC)."

  vsync-active-low:
    type: boolean
    description: "GCR VSPOL (Linux ltdc.c: DRM_MODE_FLAG_NVSYNC)."

  de-active-low:
    type: boolean
    description: "GCR DEPOL (Linux ltdc.c: bus flag DE_LOW)."

  pixclk-falling:
    type: boolean
    description: "GCR PCPOL (Linux ltdc.c: bus flag PIXDATA_NEGEDGE)."

  dsi-host:
    type: phandle
    description: |
      The yakogl,stm32-dsi this LTDC feeds (stm32mp257f-dk.dts:536-547).
```

## driver/dts/bindings/firmware/yakogl,tisci-power-on.yaml
```yaml
# SPDX-License-Identifier: Apache-2.0
# SPDX-FileCopyrightText: 2026 Signal Slot, Inc.
description: |
  Switches the listed TISCI devices on at boot, before the drivers that use
  them initialise (for cores served by Zephyr's TISCI driver; the polling
  client has power-on-devices built in).
compatible: "yakogl,tisci-power-on"
include: base.yaml
properties:
  tisci:
    type: phandle
    required: true
    description: the TISCI (ti,k2g-sci) device
  devices:
    type: array
    required: true
    description: TISCI device ids to switch on, in order
```

## driver/dts/bindings/gpu/img,img-rogue.yaml
```yaml
# SPDX-License-Identifier: Apache-2.0
# SPDX-FileCopyrightText: 2026 Signal Slot, Inc.

description: |
  Imagination PowerVR Rogue GPU (BXS-4-64 on the TI AM62P) driven by the
  powervr-bxs module: powered and clocked through TISCI, with a physically
  contiguous 64 MiB DDR carveout for the firmware heap, page tables and
  render objects.

compatible: "img,img-rogue"

include: base.yaml

properties:
  reg:
    required: true

  tisci:
    type: phandle
    required: true
    description: "The TISCI (ti,k2g-sci) device that owns the GPU power domains and clock."

  tisci-power-domain-ids:
    type: array
    required: true
    description: "TISCI device ids to power on (AM62P: 237 and 242)."

  tisci-clock-dev-id:
    type: int
    required: true
    description: "TISCI device id the GPU core clock belongs to (AM62P: 237)."

  tisci-clock-id:
    type: int
    required: true
    description: "TISCI clock id of the GPU core clock (AM62P: 3)."

  clock-frequency:
    type: int
    required: true
    description: "GPU core clock in Hz (AM62P: 800000000)."

  memory-region:
    type: phandle
    required: true
    description: |
      The GPU carveout: a reserved-memory node of at least 64 MiB that no
      other Zephyr memory region overlaps (the driver maps it itself).
```

## driver/dts/bindings/gpu/vivante,gc.yaml
```yaml
# SPDX-License-Identifier: Apache-2.0
# SPDX-FileCopyrightText: 2026 Signal Slot, Inc.

description: |
  Vivante GC7000 class GPU (GC7000UL on the NXP i.MX8MP) driven by the
  yakogl-drivers module's Vivante driver (src/vivante/): powered through the GPC
  and clocked through the CCM by the driver itself, with a physically
  contiguous DDR carveout for its page tables, command buffers and render
  objects.

compatible: "vivante,gc"

include: base.yaml

properties:
  reg:
    required: true
    description: |
      Three ranges, named "gpu" (the GPU register block, 32 KiB at 0x38000000
      on the i.MX8MP), "gpc" (the general power controller, 64 KiB at
      0x303a0000) and "ccm" (the clock control module, 64 KiB at 0x30380000).

  reg-names:
    required: true

  interrupts:
    required: true

  clock-frequency:
    type: int
    required: true
    description: "GPU core clock in Hz (i.MX8MP: 800000000, sys_pll1_800m)."

  memory-region:
    type: phandle
    required: true
    description: |
      The GPU carveout: a reserved-memory node of at least 64 MiB that no
      other Zephyr memory region overlaps (the driver maps it itself).
```
