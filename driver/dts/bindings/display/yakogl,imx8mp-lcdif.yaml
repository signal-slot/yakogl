## driver/dts/bindings/i2c/yakogl,stm32mp2-i2c.yaml
```yaml
# SPDX-License-Identifier: Apache-2.0
# SPDX-FileCopyrightText: 2026 Signal Slot, Inc.

description: |
  An STM32MP25 I2C controller (the STM32F7-style I2C IP of RM0457's I2C
  chapter; Linux drivers/i2c/busses/i2c-stm32f7.c, and the MP25's shape in
  Documentation/devicetree/bindings/i2c/st,stm32-i2c.yaml: compatible
  st,stm32mp25-i2c :22,:76, one clock :96-97) as a polled Zephyr I2C master
  on the A35. Zephyr has no I2C driver for the MP2's A35 side. Register
  logic in Rust (driver/rust/src/ip/stm32_i2c.rs); the bus carries the DK's
  ADV7535 (the &i2c2 bus node, stm32mp257f-dk.dts:395; the bridge node
  :428-431).

  The controller's clock gate, reset and RIF settings are the chain owner's;
  this device's init maps the registers only. As the shim has no clock
  driver, the kernel clock rate is a property. `clock-frequency` (the bus
  speed) comes from i2c-controller.yaml; the timing is computed from it as
  i2c-stm32f7.c's stm32f7_i2c_compute_timing does. The SCL rise and fall
  times and the filters are read as stm32f7_i2c_setup_timing does (below);
  ST's DK dts sets i2c-scl-rising-time-ns = <108> and
  i2c-scl-falling-time-ns = <12> on the ADV7535's bus (&i2c2,
  stm32mp257f-dk.dts:399-400) and neither filter property.

compatible: "yakogl,stm32mp2-i2c"

include: [i2c-controller.yaml]

properties:
  reg:
    required: true
    description: |
      The controller registers; the DK's ADV7535 bus is i2c2 at 0x40130000,
      size 0x400 (ST stm32mp251.dtsi:935-936).

  kernel-clock-frequency:
    type: int
    required: true
    description: |
      Hz of the I2C kernel clock the board leaves on the controller, as read
      by the mp2_display_state probe. It is the controller's single clock
      (i2c-stm32f7.c:2210, the "NULL"-id clock; the DK's i2c2 gets
      CK_KER_I2C2, stm32mp251.dtsi:939), whose rate the timing computation
      uses as setup->clock_src (i2c-stm32f7.c:686); it fixes the TIMINGR
      prescaler and SCL counts.

  i2c-scl-rising-time-ns:
    type: int
    default: 25
    description: |
      SCL rise time in ns, as i2c-stm32f7.c's stm32f7_i2c_setup_timing
      reads it through i2c_parse_fw_timings into setup.rise_time; absent it
      keeps STM32F7_I2C_RISE_TIME_DEFAULT, 25. ST's DK sets 108 on i2c2.

  i2c-scl-falling-time-ns:
    type: int
    default: 10
    description: |
      SCL fall time in ns, read like i2c-scl-rising-time-ns into
      setup.fall_time; absent it keeps STM32F7_I2C_FALL_TIME_DEFAULT, 10.
      ST's DK sets 12 on i2c2.

  i2c-analog-filter:
    type: boolean
    description: |
      Leave the analog noise filter on. i2c-stm32f7.c reads it with
      of_property_read_bool("i2c-analog-filter"): absent means the filter is
      off (CR1.ANFOFF set), present clears ANFOFF and adds the filter delay
      to the timing computation. The DK's i2c2 does not set it.

  i2c-digital-filter-width-ns:
    type: int
    default: 0
    description: |
      Digital noise filter width in ns (0: none); the driver turns it into
      CR1.DNF = DIV_ROUND_CLOSEST(width, i2c_clk period), at most 15.
      i2c-stm32f7.c takes the width from i2c_parse_fw_timings but keeps
      STM32F7_I2C_DNF_DEFAULT (0) unless the boolean "i2c-digital-filter"
      is also present, so the stock driver needs both. This binding does not
      define that boolean: the width alone selects the filter here. The DK's
      i2c2 sets neither.
```

## driver/dts/bindings/mipi-dsi/safeui,cdns-dsi-j721e.yaml
```yaml
description: Cadence DSI host with TI K3 wrapper and Cadence D-PHY TX (AM62P dsi0 / dphy_tx0)

compatible: "safeui,cdns-dsi-j721e"

include: base.yaml

properties:
  reg:
    required: true
    description: dsi controller, ti wrapper, dphy
  reg-names:
    required: true
  tisci:
    type: phandle
  tisci-dsi-device-id:
    type: int
    default: 231
  tisci-dsi-pclk-id:
    type: int
    default: 2
  tisci-dsi-sysclk-id:
    type: int
    default: 5
  tisci-dphy-device-id:
    type: int
    default: 238
  tisci-dphy-psm-clk-id:
    type: int
    default: 16
  tisci-dphy-pllref-clk-id:
    type: int
    default: 1
  tisci-dphy-pllref-parent:
    type: int
    default: 2
    description: parent clock index giving a 25 MHz reference (Linux assigned-clock-parents)
  pll-ref-hz:
    type: int
    default: 25000000
  sys-clk-hz:
    type: int
    default: 0
    description: dsi_sys_clk frequency if it cannot be read from TISCI (0 = ask TISCI)
  psm-clk-hz:
    type: int
    default: 0
  pixel-clock-hz:
    type: int
    required: true
  data-lanes:
    type: int
    default: 4
  burst-mode:
    type: boolean
    description: video burst mode (no sync pulses); SN65DSI83 requires this
  eot-packet:
    type: boolean
  "#address-cells":
    const: 1
  "#size-cells":
    const: 0
```

## driver/dts/bindings/mipi-dsi/yakogl,samsung-dsim.yaml
```yaml
# SPDX-License-Identifier: Apache-2.0
# SPDX-FileCopyrightText: 2026 Signal Slot, Inc.

description: |
  The i.MX 8M Plus MIPI DSI host (the Samsung DSIM core, 0x32e60000) and its
  D-PHY as a Zephyr MIPI-DSI device, register logic in Rust
  (driver/rust/src/ip/samsung_dsim.rs and ip/dphy_timing.rs, written from
  IMX8MPRM Rev. 3 13.6 / 13.7 and the MIPI D-PHY v1.2 minimums):
  driver/drivers/mipi_dsi/dsi_yakogl_samsung.c. Video mode, 24-bit RGB.

  mipi_dsi_attach() brings the link up to the clock lane in HS with the data
  lanes held in stop state (ESCMODE[ForceStopstate]) and returns: a bridge
  such as the SN65DSI84 is programmed in that window. The data lanes are
  released by yakogl_samsung_dsim_video_start() (include/yakogl_drv/
  samsung_dsim.h), which the LCDIF's blanking_off() or the chain owner calls
  once the LCDIF scans (risk R5). transfer() is not supported (video only).

  The block's power domain (mipi-dsi1), clocks, resets and PLL reference
  (MEDIA_MIPI_PHY1_REF) are the chain owner's (yakogl,imx8mp-media-pd); this
  device's init maps the registers and reads nothing.

  Design and board plan: driver/docs/imx8mp-display-cold.md.

compatible: "yakogl,samsung-dsim"

include: base.yaml

properties:
  reg:
    required: true

  pll-ref-frequency:
    type: int
    required: true
    description: |
      The PLL's input (MEDIA_MIPI_PHY1_REF), Hz; 6-300 MHz, and P must bring
      it into 2-30 MHz (IMX8MPRM Table 13-27).

  burst-clock-frequency:
    type: int
    default: 0
    description: |
      The lane bit rate, Hz; the PLL runs the nearest setting. 0: the slowest
      rate the PLL makes that carries pixel clock x 24 / lanes. A rate that
      cannot carry the stream is refused at attach.

  esc-clock-frequency:
    type: int
    default: 20000000
    description: The escape clock not to exceed (at most 20 MHz, 13.6.9.1.6).

  data-lanes:
    type: int
    default: 4
    description: Data lanes, 1-4 (a mipi_dsi_device's data_lanes overrides it).

  pixel-clock-frequency:
    type: int
    default: 0
    description: |
      The pixel clock the LCDIF really runs, Hz, used to turn the porches into
      blanking word counts. The chain owner sets the measured rate with
      yakogl_samsung_dsim_set_pixel_clock(); this is the default before it.

  burst-mode:
    type: boolean
    description: Burst mode (else non-burst with sync events), CONFIG[BurstMode].
```

## driver/dts/bindings/mipi-dsi/yakogl,stm32-dsi.yaml
```yaml
# SPDX-License-Identifier: Apache-2.0
# SPDX-FileCopyrightText: 2026 Signal Slot, Inc.

description: |
  The STM32MP25 MIPI DSI host (a Synopsys DesignWare MIPI DSI host plus ST's
  D-PHY wrapper and PLL; dsi@48000000 in ST's stm32mp255.dtsi:123-133, RIFSC
  entry 81) as a Zephyr MIPI-DSI device on the STM32MP257F-DK's A35. Register
  logic in Rust (driver/rust/src/ip/dw_mipi_dsi.rs and ip/stm32_dsi_phy.rs,
  from RM0457's DSI chapter, Linux's drm/bridge/synopsys/dw-mipi-dsi.c and
  drm/stm/dw_mipi_dsi-stm.c). Video mode.

  Its output goes to the bridge in `bridge` (stm32mp257f-dk.dts:328-350,
  :428-433: an ADV7535 with four DSI lanes). The block's clocks, reset and RIF
  settings are the chain owner's; this device's init maps the registers only.

compatible: "yakogl,stm32-dsi"

include: base.yaml

properties:
  reg:
    required: true
    description: |
      The DSI host registers, 0x48000000 on the DK (stm32mp255.dtsi:123-133).

  data-lanes:
    type: int
    default: 4
    enum: [1, 2, 3, 4]
    description: |
      Data lanes wired, as the DK's ADV7535 endpoint has them
      (stm32mp257f-dk.dts:428-433; the ADV7535 side is adi,dsi-lanes).
      A mipi_dsi_device's data_lanes overrides it.

  bridge:
    type: phandle
    description: |
      The device the DSI feeds (yakogl,adv7535 on the DK), attached by the
      host once the link is up (stm32mp257f-dk.dts:328-350).

  pll-ref-frequency:
    type: int
    required: true
    description: |
      Hz of the clock feeding the D-PHY PLL (the DSI "ref" clock of
      dw_mipi_dsi-stm.c, whose PLL input range limits the divider choice).
      Set from the clock the board leaves on it, as read by the
      mp2_display_state probe.

  burst-clock-frequency:
    type: int
    default: 0
    description: |
      The lane bit rate, Hz. 0: the slowest rate the PLL makes that carries
      pixel clock x bits per pixel / lanes (the rate dw_mipi_dsi-stm.c
      derives from the mode).

  pixel-clock-frequency:
    type: int
    default: 0
    description: |
      The pixel clock the LTDC really runs, Hz, for the blanking word counts
      (dw-mipi-dsi.c dw_mipi_dsi_video_packet_config / _timing_config).
```

## driver/dts/bindings/power-domain/yakogl,imx8mp-media-blk-ctrl.yaml
```yaml
# SPDX-License-Identifier: Apache-2.0
# SPDX-FileCopyrightText: 2026 Signal Slot, Inc.

description: |
  The i.MX 8M Plus MEDIAMIX: its GPC power domain, its CCM bus roots and
  clock gate, the MEDIA_BLK_CTRL block control, and VIDEO_PLL1 / the pixel
  and MIPI PHY reference clock roots. Register logic in Rust
  (driver/rust/src/soc/imx8mp/media.rs), written from IMX8MPRM Rev. 3;
  driver/drivers/power_domain/power_domain_yakogl_imx8mp_media.c registers it.

  The node holds the shared state; its children are the power domains a
  display consumer names in its power-domains (yakogl,imx8mp-media-pd):
  "lcdif1" (MEDIAMIX + the LCDIF1 clocks and resets) and "mipi-dsi1"
  (MEDIAMIX + the MIPI_PHY1 domain + the DSI and D-PHY clocks and resets).

  It also opens, at PRE_KERNEL_1, the clock roots and gates a kexec'd image
  needs before any driver runs (early-ccm-roots / early-ccm-gates): Linux
  gates idle peripherals' clocks, and the first register access of a Zephyr
  driver to a gated block faults.

compatible: "yakogl,imx8mp-media-blk-ctrl"

include: [base.yaml]

properties:
  reg:
    required: true
  reg-names:
    required: true
    description: |
      "blkctrl" (MEDIA_BLK_CTRL), "gpc", "ccm", "anatop" (CCM_ANALOG).
  early-ccm-roots:
    type: array
    description: |
      CCM clock root slices (IMX8MPRM Table 5-1) to enable at PRE_KERNEL_1;
      their mux and dividers are kept.
  early-ccm-gates:
    type: array
    description: |
      CCM CCGR indices (IMX8MPRM Table 5-9) to open for domain 0 at
      PRE_KERNEL_1.
```

## driver/dts/bindings/power-domain/yakogl,imx8mp-media-pd.yaml
```yaml
# SPDX-License-Identifier: Apache-2.0
# SPDX-FileCopyrightText: 2026 Signal Slot, Inc.

description: |
  One display power domain under a yakogl,imx8mp-media-blk-ctrl node (its
  parent): a Zephyr power-domain device (PM_DEVICE_DT_INST_DEFINE). Resume
  turns it on (MEDIAMIX first), suspend turns it off (the last one off
  powers MEDIAMIX down). A domain the previous kernel left on is adopted
  without a register write.

compatible: "yakogl,imx8mp-media-pd"

include: [base.yaml]

properties:
  domain:
    type: string
    required: true
    enum:
      - "lcdif1"
      - "mipi-dsi1"
  "#power-domain-cells":
    const: 0
    required: true
```

## driver/dts/bindings/pwm/yakogl,imx-pwm.yaml
```yaml
# SPDX-License-Identifier: Apache-2.0
# SPDX-FileCopyrightText: 2026 Signal Slot, Inc.

description: |
  The i.MX "PWM" block (one output, 16-bit counter, four-word sample FIFO) of
  the i.MX 8M Plus (PWM1-4), as a Zephyr PWM device whose register logic is
  Rust (driver/drivers/pwm/pwm_yakogl_imx.c, driver/rust/src/ip/imx_pwm.rs).

  The driver owns the PWM's clock: on the first enabling request it runs the
  CCM clock root ccm-root from the 24 MHz oscillator undivided and opens clock
  gate ccm-gate for the Cortex-A53, so get_cycles_per_sec is 24000000.
  Index values for the i.MX 8M Plus are hal_nxp fsl_clock.h's (MIMX8ML8):
  PWM1 root 103 gate 40, PWM2 104/41, PWM3 105/42, PWM4 106/43
  (kCLOCK_PwmN = CCM_TUPLE(gate, root)).

  Not fsl,imx27-pwm: that compatible is Zephyr's pwm_imx.c, which builds only
  for the i.MX6SX/7D M4 cores.

compatible: "yakogl,imx-pwm"

include: [pwm-controller.yaml, base.yaml, pinctrl-device.yaml]

properties:
  reg:
    required: true
  reg-names:
    required: true
    description: |
      "pwm" (the PWM block) and "ccm" (the Clock Control Module).
  ccm-root:
    type: int
    required: true
    description: CCM ROOT[] index of this PWM's clock root.
  ccm-gate:
    type: int
    required: true
    description: CCM CCGR[] index of this PWM's clock gate.
  pinctrl-0:
    required: true
  pinctrl-names:
    required: true
  "#pwm-cells":
    const: 3

pwm-cells:
  - channel
  - period
  - flags
```

## driver/dts/bindings/serial/st,stm32h7-uart.yaml
```yaml
# SPDX-License-Identifier: Apache-2.0
# SPDX-FileCopyrightText: 2026 Signal Slot, Inc.

description: |
  STM32 USART of the STM32H7 register layout as Linux names it on the
  STM32MP2 (arch/arm64/boot/dts/st/stm32mp251.dtsi, "st,stm32h7-uart").
  On the STM32MP257F's Cortex-A35 it is driven by the polled driver in
  driver/soc/st/stm32mp2x_a35 on the line setup the previous boot stage
  left (no clocks, resets or pins are described or touched). Zephyr's own
  STM32 USART bindings (st,stm32-uart and friends) require the STM32 clock
  tree, a reset controller and pinctrl, which the A35 build does not have.

compatible: "st,stm32h7-uart"

include: uart-controller.yaml

properties:
  reg:
    required: true

  interrupts:
    required: true
```

## driver/samples/zephyr/v3d_deqp/Kconfig
```kconfig
# SPDX-License-Identifier: Apache-2.0
# SPDX-FileCopyrightText: 2026 Signal Slot, Inc.
menu "v3d_deqp"
config V3D_DEQP_LIFETIME_S
	int "Seconds from boot to the watchdog reset (run and photo)"
	default 240
	help
	  The PM watchdog (driver/zephyr/lib/board/rpi4/rpi_wdog.c) is fed until this many
	  seconds after boot, and resets the board at most 10 s later. The case
	  list must finish inside it with V3D_DEQP_PHOTO_S to spare; a list that
	  does not is split over more images (docs/online-shaderc/v3d-backend.md,
	  "M8").
config V3D_DEQP_PHOTO_S
	int "Seconds the record stays on screen before the reset, at least"
	default 30
	help
	  At V3D_DEQP_LIFETIME_S minus this, a run that has not finished prints
	  the record it has so far, marked INCOMPLETE, and the screen stops
	  scrolling, so there is always a record to photograph.
config V3D_DEQP_QPA_UART
	bool "Copy dEQP's whole test log (QPA) to the UART"
	default n
	help
	  The deqp sample's log stream keeps only one line per case. With this
	  on, every character dEQP writes to its QPA log also goes to the UART:
	  the shader sources, the values, the result, reference and error-mask
	  images (the deqp sample's command line turns images and shader
	  sources off; this option turns them back on). The images make it slow (the UART is 115200 baud), so it is
	  meant for a filter of a few cases, where one case's pixels decide a
	  question. Off for every sweep image.
endmenu
# DEQP_CASE and DEQP_SURFACE_SIZE, the options the deqp sample's main.cpp
# reads (that file also brings the common glue's menu and Zephyr's).
rsource "../deqp/Kconfig"
```
