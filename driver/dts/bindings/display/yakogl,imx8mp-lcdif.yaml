## driver/soc/ti/k3/Kconfig.defconfig
```kconfig
# SPDX-License-Identifier: Apache-2.0
# SPDX-FileCopyrightText: 2026 Signal Slot, Inc.
if SOC_FAMILY_TI_K3
rsource "*/Kconfig.defconfig"
endif
```

## driver/soc/ti/k3/am62px/Kconfig
```kconfig
# SPDX-License-Identifier: Apache-2.0
# SPDX-FileCopyrightText: 2026 Signal Slot, Inc.

config SOC_SERIES_AM62PX_A53
	select ARM64
	select CPU_CORTEX_A53
	select ARM_ARCH_TIMER if SYS_CLOCK_EXISTS
	select SOC_EARLY_INIT_HOOK
	select SOC_PER_CORE_INIT_HOOK

config SOC_SERIES_AM62PX_R5
	select ARM
	select CPU_CORTEX_R5
	select CPU_HAS_ARM_MPU
	select VFP_SP_D16
	select ARM_CUSTOM_INTERRUPT_CONTROLLER
	select TI_VIM
	select TI_DM_TIMER
	select UART_NS16550_ACCESS_WORD_ONLY if UART_NS16550
	select SOC_EARLY_INIT_HOOK

config SOC_AM62PX_BOOT_SPRINGBOARD
	def_bool ($(dt_chosen_reg_addr_hex,$(DT_CHOSEN_Z_SRAM)) >= 0x80000000)
	depends on SOC_SERIES_AM62PX_R5
	help
	  Zephyr code lives in DDR, which the R5F MPU marks execute-never by
	  default: a small springboard in ATCM opens DDR for execution first.

config SOC_AM62PX_A53_BOOT_MARKER
	bool "Raw UART boot markers from the A53 early init (before the console)"
	depends on SOC_SERIES_AM62PX_A53
	help
	  Writes 'H' (early hook) and 'K' (first PRE_KERNEL_1 init) straight to
	  the console UART, for boots that show no banner: tells whether Zephyr's
	  C code ran at all when the image was entered by kexec.

config SOC_AM62PX_A53_FEED_INHERITED_WDT
	bool "Feed the main RTI watchdog a previous boot stage left running (kexec entry)"
	depends on SOC_SERIES_AM62PX_A53
	help
	  Linux (or U-Boot) starts the main-domain RTI watchdog and it cannot
	  be stopped; a Zephyr image entered through kexec must service it in
	  its open window or the SoC resets after one 60 s period. Does nothing
	  when the watchdog is not running (a U-Boot "go" boot).

config SOC_AM62PX_A53_FEED_INHERITED_WDT_SECONDS
	int "Seconds to keep feeding it (0 = for as long as Zephyr runs)"
	default 0
	depends on SOC_AM62PX_A53_FEED_INHERITED_WDT
	help
	  A bounded lifetime lets a hung test image be reset by the watchdog.

config SOC_AM62PX_RSC_TABLE
	bool "Linux remoteproc resource table"
	default y
	depends on SOC_SERIES_AM62PX_R5
	help
	  Emit a minimal ".resource_table" section so the Linux k3_r5 remoteproc
	  driver accepts the firmware.  With RAM_CONSOLE enabled the console
	  buffer is exported as a trace entry (debugfs remoteproc trace0).
```

## driver/soc/ti/k3/am62px/Kconfig.defconfig
```kconfig
# SPDX-License-Identifier: Apache-2.0
# SPDX-FileCopyrightText: 2026 Signal Slot, Inc.

if SOC_SERIES_AM62PX

config NUM_IRQS
	default 512 if SOC_SERIES_AM62PX_R5
	default 992 if SOC_SERIES_AM62PX_A53

config SYS_CLOCK_HW_CYCLES_PER_SEC
	default 25000000 if SOC_SERIES_AM62PX_R5
	default 200000000 if SOC_SERIES_AM62PX_A53

config KERNEL_ENTRY
	default "_vector_table" if SOC_SERIES_AM62PX_R5

configdefault UART_NS16550_TI_K3
	default y

if SERIAL

choice UART_NS16550_VARIANT
	default UART_NS16550_VARIANT_NS16750
endchoice

endif # SERIAL

config BUILD_OUTPUT_BIN
	default n if SOC_SERIES_AM62PX_R5

endif # SOC_SERIES_AM62PX
```
