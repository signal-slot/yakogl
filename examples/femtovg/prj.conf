## CMakeLists.txt
```
# SPDX-License-Identifier: Apache-2.0
# SPDX-FileCopyrightText: 2026 Signal Slot, Inc.
# femtovg: one femtovg frame (the 2D renderer Slint draws with) for the
# Raspberry Pi 4, the Verdin AM62P and the Verdin iMX8M Plus. The board is
# chosen by the Zephyr board (-b) only; there is no per-board option here.
# What differs per board is the board layer's (driver/zephyr/lib/board,
# CONFIG_YAKOGL_BOARD, and its app.conf and app.overlay, which
# ../zephyr.cmake applies).
#
# What is shared, by path:
#   - the femtovg/glow forks (NOSTD_PATCH_DIR), recreated from ../nostd's
#     patches (../nostd/README.md), the same trees the Slint example uses;
#   - femtovg's own shader text (main-vs.glsl, main-fs.glsl) from that tree,
#     which src/programs.c compiles the way femtovg does, to name each
#     program that does not build before the frame;
#   - the scene and the check, ./check (crate yakogl-femtovg-check,
#     host-tested by tools/check.sh), and through it ../triangle/check and
#     driver/rust/src/board/record.rs.
cmake_minimum_required(VERSION 3.20.0)

include("${CMAKE_CURRENT_SOURCE_DIR}/../zephyr.cmake")
project(femtovg)

target_sources(app PRIVATE src/main.c src/programs.c)

# ---------------------------------------------------------------------------
# The femtovg/glow forks.
# ---------------------------------------------------------------------------
if(NOT NOSTD_PATCH_DIR AND DEFINED ENV{NOSTD_PATCH_DIR})
  set(NOSTD_PATCH_DIR "$ENV{NOSTD_PATCH_DIR}")
endif()
if(NOT EXISTS "${NOSTD_PATCH_DIR}/femtovg/Cargo.toml" OR NOT EXISTS "${NOSTD_PATCH_DIR}/glow/Cargo.toml")
  message(FATAL_ERROR
    "femtovg: NOSTD_PATCH_DIR='${NOSTD_PATCH_DIR}' must hold the no_std femtovg/ and "
    "glow/ forks (../nostd/README.md). Pass -DNOSTD_PATCH_DIR=<path>.")
endif()

# femtovg's shader text as C strings (gen/fvg_glsl.h: fvg_main_vs,
# fvg_main_fs), from the tree the staticlib builds femtovg from, so the
# survey's programs are the ones femtovg will build.
set(fvg_glsl_dir "${NOSTD_PATCH_DIR}/femtovg/src/renderer/opengl")
set(fvg_glsl_h "${CMAKE_CURRENT_BINARY_DIR}/gen/fvg_glsl.h")
set(fvg_glsl "/* generated by examples/femtovg/CMakeLists.txt from ${fvg_glsl_dir} */\n")
foreach(pair "main-vs.glsl;fvg_main_vs" "main-fs.glsl;fvg_main_fs")
  list(GET pair 0 file)
  list(GET pair 1 sym)
  if(NOT EXISTS "${fvg_glsl_dir}/${file}")
    message(FATAL_ERROR "femtovg: ${fvg_glsl_dir}/${file} is missing")
  endif()
  set_property(DIRECTORY APPEND PROPERTY CMAKE_CONFIGURE_DEPENDS "${fvg_glsl_dir}/${file}")
  file(READ "${fvg_glsl_dir}/${file}" hex HEX)
  string(REGEX REPLACE "([0-9a-f][0-9a-f])" "0x\\1," bytes "${hex}")
  string(APPEND fvg_glsl "static const char ${sym}[] = { ${bytes} 0 };\n")
endforeach()
file(WRITE "${fvg_glsl_h}.tmp" "${fvg_glsl}")
configure_file("${fvg_glsl_h}.tmp" "${fvg_glsl_h}" COPYONLY)
target_include_directories(app PRIVATE "${CMAKE_CURRENT_BINARY_DIR}/gen")

# ---------------------------------------------------------------------------
# The Rust staticlib (rust/): built for aarch64-unknown-none (release) with
# -Z build-std=core,alloc, as the Slint example's is, and linked whole.
# ---------------------------------------------------------------------------
find_program(CARGO cargo REQUIRED)
set(CARGO_SRC "${CMAKE_CURRENT_SOURCE_DIR}/rust")
set(FEMTOVG_CHECK_DIR "${CMAKE_CURRENT_SOURCE_DIR}/check")
set(cargo_build_dir "${CMAKE_CURRENT_BINARY_DIR}/rust")
set(cargo_target_dir "${cargo_build_dir}/target")
set(RUST_TARGET aarch64-unknown-none)
set(femtovg_staticlib "${cargo_target_dir}/${RUST_TARGET}/release/libfemtovg_example.a")
file(MAKE_DIRECTORY "${cargo_build_dir}")
configure_file("${CARGO_SRC}/Cargo.toml.in" "${cargo_build_dir}/Cargo.toml" @ONLY)

# The crates.io part of the build (what femtovg and glow pull in) is pinned by
# rust/Cargo.lock, used with --locked, as the Slint example's is.
# -DFEMTOVG_CARGO_LOCKED=OFF resolves afresh, to refresh the lock on purpose
# (copy <build>/rust/Cargo.lock over rust/Cargo.lock and commit it).
option(FEMTOVG_CARGO_LOCKED "Build with the committed rust/Cargo.lock and --locked" ON)
set(femtovg_lock "${CARGO_SRC}/Cargo.lock")
set(femtovg_cargo_flags "")
set(femtovg_lock_dep "")
if(FEMTOVG_CARGO_LOCKED)
  configure_file("${femtovg_lock}" "${cargo_build_dir}/Cargo.lock" COPYONLY)
  set(femtovg_cargo_flags --locked)
  set(femtovg_lock_dep "${femtovg_lock}")
endif()

file(GLOB_RECURSE femtovg_rust_srcs CONFIGURE_DEPENDS
     "${CARGO_SRC}/src/*.rs"
     "${FEMTOVG_CHECK_DIR}/src/*.rs"
     "${CMAKE_CURRENT_SOURCE_DIR}/../triangle/check/src/*.rs"
     "${PVR_REPO}/rust/src/board/record.rs"
     "${NOSTD_PATCH_DIR}/femtovg/src/*.rs"
     "${NOSTD_PATCH_DIR}/femtovg/src/*.glsl"
     "${NOSTD_PATCH_DIR}/glow/src/*.rs")

add_custom_command(
  OUTPUT "${femtovg_staticlib}"
  COMMAND ${CMAKE_COMMAND} -E env
          "CARGO_TARGET_DIR=${cargo_target_dir}"
          ${CARGO} build --release ${femtovg_cargo_flags}
          -Z build-std=core,alloc
          --target ${RUST_TARGET}
          --manifest-path "${cargo_build_dir}/Cargo.toml"
  DEPENDS ${femtovg_rust_srcs} "${cargo_build_dir}/Cargo.toml" ${femtovg_lock_dep}
  WORKING_DIRECTORY "${cargo_build_dir}"
  COMMENT "cargo build femtovg_example (${RUST_TARGET}, release)"
  VERBATIM)
add_custom_target(femtovg_example_build DEPENDS "${femtovg_staticlib}")
add_dependencies(app femtovg_example_build)
target_link_libraries(app PRIVATE "${femtovg_staticlib}")
```

## prj.conf
```kconfig
# SPDX-License-Identifier: Apache-2.0
# SPDX-FileCopyrightText: 2026 Signal Slot, Inc.
# The femtovg example: the same configuration on every board. What a board
# needs beyond it (its GPU driver, display path, memory) is the board layer's
# app.conf and app.overlay (driver/zephyr/lib/board/<board>/), which
# ../zephyr.cmake applies for the Zephyr board; the window, the screen, the
# watchdog, the records and the end of the run are the board layer's too
# (yakogl_board.h).
CONFIG_YAKOGL=y
CONFIG_YAKOGL_BOARD=y
# The in-process shader compiler on every board (the V3D has no other back
# end): femtovg's programs are built from its shader text at run time.
CONFIG_YAKOGL_SHADERC_ONLINE=y

CONFIG_PRINTK=y
CONFIG_LOG=y
CONFIG_LOG_MODE_MINIMAL=y
CONFIG_CACHE_MANAGEMENT=y

# femtovg's tessellation is float work; the Rust archive is hard-float.
CONFIG_FPU=y

# femtovg's path flattening has deep call chains, and the online compiler
# runs on this thread and needs 256 KiB (zephyr/Kconfig,
# YAKOGL_SHADERC_ONLINE).
CONFIG_MAIN_STACK_SIZE=262144
CONFIG_STACK_SENTINEL=y

# femtovg allocates through the C heap (rust/src/lib.rs: aligned_alloc and
# free): its canvas, path and gradient buffers, the old samples' 16 MiB.
# glShaderSource keeps a copy of each source there too.
CONFIG_COMMON_LIBC_MALLOC=y
CONFIG_COMMON_LIBC_MALLOC_ARENA_SIZE=16777216
```

## src/main.c
```c
/* SPDX-License-Identifier: Apache-2.0 */
/* SPDX-FileCopyrightText: 2026 Signal Slot, Inc. */
/*
 * femtovg: one femtovg frame, the same source on the Raspberry Pi 4 (V3D),
 * the Verdin AM62P (PowerVR) and the Verdin iMX8M Plus (GC7000). The board
 * is chosen by the Zephyr board only; everything that differs per board is
 * behind yakogl_board.h.
 *
 * femtovg (a 2D vector renderer, the one Slint draws with) draws a clear, a
 * rounded rect, a gradient rect and a stroked polyline through the public
 * OpenGL ES 2.0 API on YakoGL, into a 1024x600 window. This file is the
 * thin part: the window, EGL, the program survey, the screen and the
 * records. What is drawn and what is expected are the check crate's
 * (check/src/lib.rs, through rust/src/lib.rs), one definition for both:
 *
 *   femtovg_scene()                      window size, fill words
 *   board_window(1024, 600 + guard rows) sentinel window, guard rows
 *   EGL up (RGBA8888 + stencil 8, ES 2)  the window's 1024x600 only
 *   programs_run()                       femtovg's 30 programs, each
 *                                        failure named (programs.h)
 *   femtovg_draw(), eglSwapBuffers, board_show()
 *   femtovg_check()                      every pixel classified, guard
 *                                        rows, glReadPixels against
 *                                        memory, and PICTURE's words
 *   board_result(PICTURE)                the frame's fingerprint
 *   board_result(APP, fail)              only after a failed check
 *   board_finish()
 *
 * The records are the triangle's (examples/triangle/src/main.c): the last
 * record of a run is its verdict. A checked frame stores PICTURE. After a
 * pass that is the last record. After a failed check an APP record follows
 * it: w1 = the check's failure code << 8 | 2 (fail), the codes being
 * check/src/lib.rs `Failure`; w2 = 1 frame presented; w3 = the GPU resets.
 * A run that never reached the check stores no PICTURE, and board_finish()
 * stores its APP fail record.
 */
#include <zephyr/kernel.h>
#include <zephyr/sys/printk.h>
#include <errno.h>
#include <stdint.h>

#include <EGL/egl.h>
#include <GLES2/gl2.h>

#include <yakogl_board.h>
#include <yakogl_record.h>

#include "programs.h"

/* Where a run that died stopped (kind PROGRESS, YK_RECORD_WHERE_STAGE | n). */
enum stage {
	STAGE_WINDOW = 1,
	STAGE_EGL,
	STAGE_PROGRAMS,
	STAGE_DRAW,
	STAGE_SWAPPED,
	STAGE_CHECKED,
};

/* ---- rust/src/lib.rs ------------------------------------------------------ */

struct femtovg_scene {
	uint32_t w, h, guard_rows, sentinel, guard;
};
BUILD_ASSERT(sizeof(struct femtovg_scene) == 20, "rust/src/lib.rs Scene");

struct femtovg_result {
	uint32_t status;  /* YK_RECORD_STATUS_PASS / _FAIL */
	uint32_t failure; /* check/src/lib.rs Failure, 0 for a pass */
	uint32_t picture[3];
};
BUILD_ASSERT(sizeof(struct femtovg_result) == 20, "rust/src/lib.rs CheckResult");

typedef void (*femtovg_read_pixels_fn)(GLint x, GLint y, GLsizei w, GLsizei h, GLenum format,
				       GLenum type, void *pixels);
typedef const void *(*femtovg_get_proc_fn)(const char *name);
void femtovg_scene(struct femtovg_scene *out);
int femtovg_draw(femtovg_get_proc_fn get_proc, uint32_t w, uint32_t h);
int femtovg_check(const uint32_t *cpu, uint32_t w, uint32_t h, uint32_t guard_rows,
		  uint32_t format, femtovg_read_pixels_fn read_pixels, struct femtovg_result *out);

/* ---- the run -------------------------------------------------------------- */

static struct femtovg_scene s_scene;
static struct board_window s_win; /* the window as EGL and the screen see it */
static EGLDisplay s_dpy;
static EGLSurface s_surf;
static struct programs_survey s_survey;
static struct femtovg_result s_result;
static bool s_checked;

/* femtovg and glow resolve every GL entry point through this. */
static const void *get_proc(const char *name)
{
	return (const void *)eglGetProcAddress(name);
}

/* Each EGL call is checked on its own: eglGetError reports the LAST call. */
static int egl_fail(const char *call)
{
	printk("femtovg: %s failed: EGL error 0x%x\n", call, eglGetError());
	return -EIO;
}

static int window(void)
{
	const uint32_t w = s_scene.w, h = s_scene.h, guard_rows = s_scene.guard_rows;
	struct board_window full;
	int ret = board_window(w, h + guard_rows, &full);

	if (ret) {
		printk("femtovg: board_window(%u, %u) = %d\n", w, h + guard_rows, ret);
		return ret;
	}
	if (full.stride != w * 4u) {
		printk("femtovg: board_window gave stride %u, not %u\n", full.stride, w * 4u);
		return -EINVAL;
	}
	/* The window starts with the sentinel, the guard rows after it with
	 * the guard word, written through the CPU's view (Normal non-cacheable
	 * on every board, yakogl_board.h: no cache maintenance). */
	uint32_t *px = full.cpu;
	size_t win_px = (size_t)w * h, all_px = (size_t)w * (h + guard_rows);

	for (size_t i = 0; i < all_px; i++)
		px[i] = i < win_px ? s_scene.sentinel : s_scene.guard;
	s_win = full;
	s_win.h = h; /* EGL and the screen get the window, not the guard rows */
	printk("femtovg: window %ux%u at phys 0x%lx, format 0x%x, %u guard rows\n", s_win.w,
	       s_win.h, (unsigned long)s_win.phys, s_win.format, guard_rows);
	return 0;
}

static int egl_up(void)
{
	/* EGL_SINGLE_BUFFER: the window is shown itself (board_show after the
	 * swap) and read back as memory (examples/triangle/src/main.c). */
	static const EGLint single_buffer[] = { EGL_RENDER_BUFFER, EGL_SINGLE_BUFFER, EGL_NONE };
	/* femtovg fills concave paths and strokes through the stencil */
	static const EGLint cfg_attribs[] = {
		EGL_RED_SIZE, 8, EGL_GREEN_SIZE, 8, EGL_BLUE_SIZE, 8, EGL_ALPHA_SIZE, 8,
		EGL_STENCIL_SIZE, 8, EGL_SURFACE_TYPE, EGL_WINDOW_BIT,
		EGL_RENDERABLE_TYPE, EGL_OPENGL_ES2_BIT, EGL_NONE,
	};
	static const EGLint ctx_attribs[] = { EGL_CONTEXT_CLIENT_VERSION, 2, EGL_NONE };
	static struct gles_native_window nw;
	EGLConfig cfg;
	EGLint n = 0;

	nw = (struct gles_native_window){
		.phys = s_win.phys, .width = s_win.w, .height = s_win.h,
		.stride_bytes = s_win.stride, .format = s_win.format,
	};
	s_dpy = eglGetDisplay(EGL_DEFAULT_DISPLAY);
	if (!eglInitialize(s_dpy, NULL, NULL))
		return egl_fail("eglInitialize");
	if (!eglChooseConfig(s_dpy, cfg_attribs, &cfg, 1, &n))
		return egl_fail("eglChooseConfig");
	if (n != 1) {
		printk("femtovg: eglChooseConfig: %d configs for RGBA8888 + stencil 8\n", n);
		return -ENOENT;
	}
	s_surf = eglCreateWindowSurface(s_dpy, cfg, &nw, single_buffer);
	if (s_surf == EGL_NO_SURFACE)
		return egl_fail("eglCreateWindowSurface");
	EGLContext ctx = eglCreateContext(s_dpy, cfg, EGL_NO_CONTEXT, ctx_attribs);
	if (ctx == EGL_NO_CONTEXT)
		return egl_fail("eglCreateContext");
	if (!eglMakeCurrent(s_dpy, s_surf, s_surf, ctx))
		return egl_fail("eglMakeCurrent");
	printk("femtovg: GL_RENDERER %s, GL_VERSION %s\n", (const char *)glGetString(GL_RENDERER),
	       (const char *)glGetString(GL_VERSION));
	return 0;
}

/* The one frame: femtovg's draw, eglSwapBuffers (submits and waits). */
static int draw(void)
{
	int64_t t0 = k_uptime_get();
	int rc = femtovg_draw(get_proc, s_win.w, s_win.h);
	GLenum err_draw = glGetError();

	if (rc != 0) {
		printk("femtovg: femtovg_draw = %d (GL error 0x%x): %s\n", rc, err_draw,
		       rc == 1 && s_survey.failed ? "femtovg's programs do not all link (above)" :
		       rc == 1 ? "the renderer did not start, yet every program linked here" :
				 "the canvas could not be created");
		return -EIO;
	}
	/* the canvas and its programs are gone again: what stays resident */
	programs_keep_print("after femtovg_draw (its canvas already dropped)");
	board_progress(YK_RECORD_WHERE_STAGE | STAGE_DRAW);
	if (!eglSwapBuffers(s_dpy, s_surf))
		return egl_fail("eglSwapBuffers");
	GLenum err = glGetError();

	printk("femtovg: frame %lld ms\n", (long long)(k_uptime_get() - t0));
	if (err_draw != GL_NO_ERROR || err != GL_NO_ERROR) {
		/* a refused draw logs its reason above */
		printk("femtovg: GL error 0x%x after the draw, 0x%x after the swap\n", err_draw, err);
		return -EIO;
	}
	return 0;
}

static int run(void)
{
	int ret;

	board_progress(YK_RECORD_WHERE_STAGE | STAGE_WINDOW);
	ret = window();
	if (ret)
		return ret;
	board_progress(YK_RECORD_WHERE_STAGE | STAGE_EGL);
	ret = egl_up();
	if (ret)
		return ret;
	board_progress(YK_RECORD_WHERE_STAGE | STAGE_PROGRAMS);
	programs_run(&s_survey);
	programs_print(&s_survey);
	ret = draw();
	if (ret)
		return ret;
	board_progress(YK_RECORD_WHERE_STAGE | STAGE_SWAPPED);
	/* the check reads the window, not the screen: go on after an error */
	ret = board_show(&s_win);
	if (ret)
		printk("femtovg: board_show = %d (the window is not on the screen)\n", ret);
	/* the guard rows follow the window in memory: s_win.cpu covers both */
	ret = femtovg_check(s_win.cpu, s_win.w, s_win.h, s_scene.guard_rows, s_win.format,
			    glReadPixels, &s_result);
	s_checked = ret >= 0;
	board_progress(YK_RECORD_WHERE_STAGE | STAGE_CHECKED);
	if (ret < 0)
		return -EINVAL; /* not checked: the reason is printed */
	return ret == 0 ? 0 : -EBADMSG;
}

int main(void)
{
	int rc;

	femtovg_scene(&s_scene);
	printk("femtovg: one femtovg frame through YakoGL, %ux%u window\n", s_scene.w, s_scene.h);
	rc = run();
	if (s_checked) {
		board_result(YK_RECORD_KIND_PICTURE, s_result.picture[0], s_result.picture[1],
			     s_result.picture[2]);
		if (s_result.status != YK_RECORD_STATUS_PASS)
			board_result(YK_RECORD_KIND_APP,
				     s_result.failure << 8 | YK_RECORD_STATUS_FAIL, 1u,
				     board_gpu_resets());
	}
	board_finish("femtovg", rc);
}
```

## src/programs.c
```c
/* SPDX-License-Identifier: Apache-2.0 */
/* SPDX-FileCopyrightText: 2026 Signal Slot, Inc. */
/* femtovg's 30 programs through GL: see programs.h. */
#include <zephyr/kernel.h>
#include <zephyr/sys/printk.h>
#include <stdbool.h>
#include <stdio.h>
#include <string.h>

#include <GLES2/gl2.h>

#include "programs.h"
#include "gles_shaderc.h" /* shc_online_keep_stats */
#include "fvg_glsl.h" /* fvg_main_vs, fvg_main_fs: femtovg's shader text */

/* femtovg's ShaderType numbers (renderer/params.rs) and names */
static const char *const fvg_type_name[10] = {
	"FillGradient", "FillImage", "Stencil", "FillImageGradient", "FilterImage",
	"FillColor", "TextureCopyUnclipped", NULL, "FillGradientConic", "FillImageGradientConic",
};

static char src_buf[16384];

/* The source femtovg's MainProgram::new passes to glShaderSource. */
static const char *fvg_source(bool vs, int type, bool glyph, bool no_discard)
{
	int n;
	if (vs) {
		n = snprintf(src_buf, sizeof(src_buf), "#version 100\n#define EDGE_AA 1\n%s", fvg_main_vs);
	} else {
		n = snprintf(src_buf, sizeof(src_buf),
			     "#version 100\n#define EDGE_AA 1\n#define SELECT_SHADER %d\n%s%s\n%s", type,
			     glyph ? "#define ENABLE_GLYPH_TEXTURE" : "",
			     no_discard ? "\n#define NO_DISCARD" : "", fvg_main_fs);
	}
	return n > 0 && (size_t)n < sizeof(src_buf) ? src_buf : NULL;
}

/* The info log with its line breaks as '|', so one row is one line. */
static void one_line(char *s)
{
	size_t n = strlen(s);
	while (n && (s[n - 1] == '\n' || s[n - 1] == ' '))
		s[--n] = 0;
	for (char *p = s; *p; p++)
		if (*p == '\n')
			*p = '|';
}

/* Build one program as femtovg's Program::new does: compile both stages,
 * attach, bind the attributes, link, then detach and delete the shaders.
 * The program stays alive (*out), as femtovg keeps all 30 at once: what the
 * compiler holds for 30 live programs is what femtovg's canvas needs.
 * 0 when it links, else the log (compile or link) and no program. */
static int fvg_program(int type, bool glyph, bool no_discard, char *log, size_t logsz, GLuint *out)
{
	GLuint sh[2] = { 0, 0 }, prog = 0;
	int rc = 0;
	log[0] = 0;
	for (int s = 0; s < 2 && rc == 0; s++) {
		const char *src = fvg_source(s == 0, type, glyph, no_discard);
		if (!src) {
			snprintf(log, logsz, "(the sample's source buffer is too small)");
			return -1;
		}
		GLint ok = 0;
		sh[s] = glCreateShader(s == 0 ? GL_VERTEX_SHADER : GL_FRAGMENT_SHADER);
		glShaderSource(sh[s], 1, &src, NULL);
		glCompileShader(sh[s]);
		glGetShaderiv(sh[s], GL_COMPILE_STATUS, &ok);
		if (!ok) {
			int k = snprintf(log, logsz, "%s compile: ", s == 0 ? "vs" : "fs");
			glGetShaderInfoLog(sh[s], (GLsizei)(logsz - (size_t)k), NULL, log + k);
			rc = -1;
		}
	}
	if (rc == 0) {
		GLint ok = 0;
		prog = glCreateProgram();
		glAttachShader(prog, sh[0]);
		glAttachShader(prog, sh[1]);
		/* program.rs Program::new binds these before the link */
		glBindAttribLocation(prog, 0, "vertex");
		glBindAttribLocation(prog, 1, "tcoord");
		glLinkProgram(prog);
		glGetProgramiv(prog, GL_LINK_STATUS, &ok);
		if (!ok) {
			int k = snprintf(log, logsz, "link: ");
			glGetProgramInfoLog(prog, (GLsizei)(logsz - (size_t)k), NULL, log + k);
			rc = -1;
		}
	}
	for (int s = 0; s < 2; s++) {
		if (sh[s]) {
			if (prog)
				glDetachShader(prog, sh[s]);
			glDeleteShader(sh[s]);
		}
	}
	if (rc == 0) {
		*out = prog;
	} else if (prog) {
		glDeleteProgram(prog);
	}
	one_line(log);
	return rc;
}

void programs_run(struct programs_survey *sv)
{
	/* renderer/opengl.rs new_from_context: (glyph, no_discard) in this order,
	 * each a generate_shader_program_variants array indexed by ShaderType */
	static const bool sets[4][2] = { { true, false }, { false, false }, { true, true }, { false, true } };
	char log[PROGRAMS_LOG_KEEP];
	GLuint live[PROGRAMS_N];
	unsigned nlive = 0;
	int64_t t0 = k_uptime_get();

	memset(sv, 0, sizeof(*sv));
	for (int set = 0; set < 4; set++) {
		bool glyph = sets[set][0], nd = sets[set][1];
		for (int type = 0; type < 10; type++) {
			/* the None entries: 7 never; Stencil, FilterImage and
			 * TextureCopyUnclipped only without the glyph texture */
			if (type == 7 || (glyph && (type == 2 || type == 4 || type == 6)))
				continue;
			bool prog_nd = type == 6 ? false : nd; /* "has no stroke test to drop" */
			GLuint prog = 0;
			int64_t tp = k_uptime_get();
			printk("  program %2u %s%s%s: ", sv->built + sv->failed + 1, fvg_type_name[type],
			       glyph ? " glyph" : "", prog_nd ? " nodiscard" : "");
			if (fvg_program(type, glyph, prog_nd, log, sizeof(log), &prog) == 0) {
				printk("ok (%lld ms)\n", (long long)(k_uptime_get() - tp));
				sv->built++;
				if (nlive < PROGRAMS_N)
					live[nlive++] = prog;
				continue;
			}
			sv->failed++;
			printk("FAIL: %s\n", log);
			if (!sv->first[0])
				snprintf(sv->first, sizeof(sv->first), "%s%s%s: %s", fvg_type_name[type],
					 glyph ? " glyph" : "", prog_nd ? " nodiscard" : "", log);
			unsigned r = 0;
			while (r < sv->nrows && strcmp(sv->rows[r].log, log) != 0)
				r++;
			if (r == sv->nrows && sv->nrows < ARRAY_SIZE(sv->rows)) {
				strncpy(sv->rows[r].log, log, PROGRAMS_LOG_KEEP - 1);
				sv->nrows++;
			}
			if (r < sv->nrows)
				sv->rows[r].n++;
		}
	}
	programs_keep_print("with the survey's programs alive");
	/* femtovg's own programs are built next: give back everything */
	for (unsigned i = 0; i < nlive; i++)
		glDeleteProgram(live[i]);
	sv->ms = k_uptime_get() - t0;
}

void programs_print(const struct programs_survey *sv)
{
	printk("femtovg programs: %u of %u link (%lld ms)\n", sv->built, sv->built + sv->failed,
	       (long long)sv->ms);
	for (unsigned r = 0; r < sv->nrows; r++)
		printk("  %2u x %s\n", sv->rows[r].n, sv->rows[r].log);
	if (sv->first[0])
		printk("  femtovg stops at %s\n", sv->first);
}

void programs_keep_print(const char *when)
{
	size_t in_use = 0, peak = 0;
	int rc = shc_online_keep_stats(&in_use, &peak);
	if (rc != 0) {
		printk("keep: shc_online_keep_stats %d %s\n", rc, when);
		return;
	}
#ifdef CONFIG_YAKOGL_SHADERC_KEEP_BYTES
	printk("keep used %zu (peak %zu) of %d bytes %s\n", in_use, peak, CONFIG_YAKOGL_SHADERC_KEEP_BYTES, when);
#else
	printk("keep used %zu (peak %zu) bytes (the crate's built-in region) %s\n", in_use, peak, when);
#endif
}
```

## src/programs.h
```c
/* SPDX-License-Identifier: Apache-2.0 */
/* SPDX-FileCopyrightText: 2026 Signal Slot, Inc. */
/*
 * femtovg's 30 programs, built through GL before femtovg builds them itself.
 *
 * femtovg compiles all its programs when a canvas is created
 * (renderer/opengl.rs, new_from_context), whether a frame uses them or not,
 * and a caller then learns only that the renderer did not start
 * (femtovg_draw returns 1; Slint's FemtoVGOpenGLRenderer::new returns an
 * error). This builds the same programs from femtovg's own shader text
 * (main-vs.glsl and main-fs.glsl of the tree the staticlib builds, embedded
 * by ../CMakeLists.txt as fvg_glsl.h), in femtovg's order and with its
 * source layout (program.rs, MainProgram::new), and keeps each link
 * failure's log, a histogram keyed on the whole log, and the program
 * femtovg stops at: the first in its order that fails. Like femtovg, it keeps every program alive while it builds the
 * next (the shaders are deleted after each link, the programs are not), so a
 * limit on what the compiler holds for live programs shows here, by name,
 * as it would in femtovg's canvas creation. Every program is deleted again
 * afterwards.
 */
#ifndef FEMTOVG_PROGRAMS_H
#define FEMTOVG_PROGRAMS_H

#include <stdint.h>

#define PROGRAMS_LOG_KEEP 160
#define PROGRAMS_N 30

struct programs_fail_row {
	char log[PROGRAMS_LOG_KEEP];
	unsigned n;
};

struct programs_survey {
	unsigned built, failed;
	struct programs_fail_row rows[PROGRAMS_N];
	unsigned nrows;
	char first[PROGRAMS_LOG_KEEP + 64]; /* the program femtovg stops at, and why */
	int64_t ms;
};

/* Build the 30 programs on the current context; print each failure. */
void programs_run(struct programs_survey *sv);

/* "femtovg programs: N of 30 link (T ms)", the histogram, the first stop. */
void programs_print(const struct programs_survey *sv);

/* "keep used N (peak P) of M bytes <when>": what the in-process compiler
 * holds for the shaders and programs alive now (shc_online_keep_stats), and
 * the region's size (CONFIG_YAKOGL_SHADERC_KEEP_BYTES when the image lends
 * it). */
void programs_keep_print(const char *when);

#endif
```
